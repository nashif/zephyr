## boards/quark_atp2_prev_gen/Kconfig.board
```kconfig
config  BOARD_QUARK_ATP2_PREV_GEN
        bool "Quark ATP2 Soc Build running on previous generation quark se board"
        select SOC_QUARK_ATP2
	depends on X86
```

## boards/quark_atp2_prev_gen/quark_atp2_prev_gen_defconfig
```kconfig
CONFIG_X86=y
CONFIG_SOC_QUARK_ATP2=y
CONFIG_BOARD_QUARK_ATP2_PREV_GEN=y
CONFIG_CPU_MINUTEIA=y
CONFIG_CONSOLE=y
CONFIG_UART_CONSOLE=y
CONFIG_SERIAL=y
CONFIG_UART_IRQ_RISING_EDGE=y
CONFIG_UART_NS16550=y
CONFIG_PRINTK=y

#>> BEGIN override of SoC defaults for previous generation quark se board.

CONFIG_SYS_CLOCK_HW_CYCLES_PER_SEC=32000000

CONFIG_PHYS_LOAD_ADDR=0x40030000
CONFIG_ROM_SIZE=144

CONFIG_PHYS_RAM_ADDR=0xA8006400
CONFIG_RAM_SIZE=55

CONFIG_UART_NS16550_PORT_0_BASE_ADDR=0xB0002000
CONFIG_UART_NS16550_PORT_0_DLF=0x06
CONFIG_UART_NS16550_PORT_0_CLK_FREQ=32000000
CONFIG_UART_NS16550_PORT_0_IRQ=5

CONFIG_UART_NS16550_PORT_1_BASE_ADDR=0xB0002400
CONFIG_UART_NS16550_PORT_1_DLF=0x06
CONFIG_UART_NS16550_PORT_1_CLK_FREQ=32000000
CONFIG_UART_NS16550_PORT_1_IRQ=6
CONFIG_UART_CONSOLE_IRQ=6

#<< END override of SoC defaults for previous generation quark se board
```

## boards/quark_atp2_sss_dvp/Kconfig
```kconfig
if BOARD_QUARK_ATP2_SSS_DVP

config BOARD
        default "quark_atp2_sss_dvp"

endif # BOARD_QUARK_ATP2_SSS_DVP
```

## boards/quark_atp2_sss_dvp/Kconfig.board
```kconfig
config  BOARD_QUARK_ATP2_SSS_EMU
        bool "Quark ATP2 Silicon Validation Board - Sensor Sub System"
        select SOC_QUARK_ATP2_SS
	depends on ARC
```

## boards/quark_atp2_sss_emu/Kconfig
```kconfig
if BOARD_QUARK_ATP2_SSS_EMU

config BOARD
        default "quark_atp2_sss_emu"

endif # BOARD_QUARK_ATP2_SSS_EMU
```

## boards/quark_atp2_sss_emu/Kconfig.board
```kconfig
config  BOARD_QUARK_ATP2_SSS_EMU
        bool "Quark ATP2 Emulation Board - Sensor Sub System"
        depends on SOC_QUARK_ATP2_SS
```

## boards/quark_atp2_sss_emu/quark_atp2_sss_emu_defconfig
```kconfig
CONFIG_ARC=y
CONFIG_SOC_QUARK_ATP2_SS=y
CONFIG_BOARD_QUARK_ATP2_SSS_EMU=y
CONFIG_SYS_CLOCK_TICKS_PER_SEC=100
CONFIG_SYS_CLOCK_HW_CYCLES_PER_SEC=32000000
CONFIG_XIP=y
CONFIG_NANO_TIMERS=y
CONFIG_PRINTK=y
CONFIG_CPU_ARCEM4=y
CONFIG_CPU_ARCV2=y
CONFIG_ARCV2_INTERRUPT_UNIT=y
CONFIG_ARCV2_TIMER=y
CONFIG_CONSOLE=y

CONFIG_SERIAL=y
CONFIG_UART_NS16550=y

#>> BEGIN override of SoC defaults for emulation board.
CONFIG_SYS_CLOCK_HW_CYCLES_PER_SEC=16000000
CONFIG_CPU_CLOCK_FREQ_MHZ=16

CONFIG_UART_NS16550_PORT_0_CLK_FREQ=16000000
CONFIG_UART_NS16550_PORT_0_DLF=0x0B

CONFIG_UART_NS16550_PORT_1_CLK_FREQ=16000000
CONFIG_UART_NS16550_PORT_1_DLF=0x0B

#<< END override of SoC defaults for emulation board.
```

## boards/quark_atp2_sss_prev_gen/Kconfig
```kconfig
if BOARD_QUARK_ATP2_SSS_PREV_GEN

config BOARD
        default "quark_atp2_sss_prev_gen"

endif # BOARD_QUARK_ATP2_SSS_PREV_GEN
```

## boards/quark_atp2_sss_prev_gen/Kconfig.board
```kconfig
config  BOARD_QUARK_ATP2_SSS_PREV_GEN
        bool "Quark ATP2 Soc Build running on previous generation quark se board - Sensor Sub System"
        select SOC_QUARK_ATP2_SS
	depends on ARC
```

## boards/quark_se2_emu/Kconfig
```kconfig
if BOARD_QUARK_SE2_EMU

config BOARD
	default "quark_se2_emu"

endif # BOARD_QUARK_SE2_EMU
```

## boards/quark_se2_emu/Kconfig.board
```kconfig
config  BOARD_QUARK_SE2_EMU
	bool "Quark SE2 Emulation Board"
	depends on SOC_QUARK_SE2
	depends on X86
```

## boards/quark_se2_sss_emu/Kconfig
```kconfig
if BOARD_QUARK_SE2_SSS_EMU

config BOARD
	default "quark_se2_sss_emu"

endif # BOARD_QUARK_SE2_SSS_EMU
```

## boards/quark_se2_sss_emu/Kconfig.board
```kconfig
config  BOARD_QUARK_SE2_SSS_EMU
	bool "Quark SE2 Emulation Board - Sensor Sub System"
	depends on SOC_QUARK_SE2_SS
	depends on ARC
```

## boards/xtensa/intel_adsp_cavs15/Kconfig.defconfig
```kconfig
# Copyright (c) 2019 Intel Corporation
#
# SPDX-License-Identifier: Apache-2.0

if BOARD_INTEL_ADSP_CAVS15

config BOARD
	default "intel_adsp_cavs15"


endif # BOARD_INTEL_ADSP_CAVS15
```

## boards/xtensa/intel_adsp_cavs18/Kconfig.defconfig
```kconfig
# Copyright (c) 2020 Intel Corporation
#
# SPDX-License-Identifier: Apache-2.0

if BOARD_INTEL_ADSP_CAVS18

config BOARD
	default "intel_adsp_cavs18"

endif # BOARD_INTEL_ADSP_CAVS18
```

## boards/xtensa/intel_adsp_cavs20/Kconfig.defconfig
```kconfig
# Copyright (c) 2020,2022 Intel Corporation
#
# SPDX-License-Identifier: Apache-2.0

if BOARD_INTEL_ADSP_CAVS20 || BOARD_INTEL_ADSP_CAVS20_JSL

config BOARD
	default "intel_adsp_cavs20" if BOARD_INTEL_ADSP_CAVS20
	default "intel_adsp_cavs20_jsl" if BOARD_INTEL_ADSP_CAVS20_JSL

endif # BOARD_INTEL_ADSP_CAVS20 || BOARD_INTEL_ADSP_CAVS20_JSL
```

## drivers/adc/Kconfig
```kconfig
# Kconfig - ADC configuration options

#
# Copyright (c) 2015 Intel Corporation
#
# Licensed under the Apache License, Version 2.0 (the "License");
# you may not use this file except in compliance with the License.
# You may obtain a copy of the License at
#
#     http://www.apache.org/licenses/LICENSE-2.0
#
# Unless required by applicable law or agreed to in writing, software
# distributed under the License is distributed on an "AS IS" BASIS,
# WITHOUT WARRANTIES OR CONDITIONS OF ANY KIND, either express or implied.
# See the License for the specific language governing permissions and
# limitations under the License.
#

#
# ADC options
#
menuconfig ADC
	bool
	prompt "ADC drivers"
	default n
	help
	Enable ADC (Analog to Digital Converter) driver configuration

config  ADC_DEBUG
	bool "ADC drivers debug output"
	depends on ADC
	default n
	help
	Enable debug output for ADC drivers

config DW_ADC
	bool "ARC Designware Driver"
	depends on ADC && ARC
	default n
	help
	Enable the driver implementation of the Designware ADC IP.

choice
	prompt "Input Mode"
	depends on ADC
	default ADC_SINGLE_ENDED
	help
	ADC input mode: single ended or differential.

config ADC_SINGLE_ENDED
	bool "Single ended"

config ADC_DIFFERENTIAL
	bool "Differential"

endchoice

config ADC_INPUT_MODE
	int
	depends on ADC
	default 0 if ADC_SINGLE_ENDED
	default 1 if ADC_DIFFERENTIAL

choice
	prompt "Output Mode"
	depends on ADC
	default ADC_SERIAL
	help
	ADC output mode: parallel or serial.

config ADC_SERIAL
	bool "Serial"

config ADC_PARALLEL
	bool "Parallel"

endchoice

config ADC_OUTPUT_MODE
	int
	depends on ADC
	default 0 if ADC_SERIAL
	default 1 if ADC_PARALLEL

choice
	prompt "Sequence Mode"
	depends on ADC
	default ADC_SINGLESHOT
	help
	ADC sequence mode - single run/repetitive

config ADC_SINGLESHOT
	bool "Single Ended"

config ADC_REPETITIVE
	bool "Differential"

endchoice

config ADC_SEQ_MODE
	int
	depends on ADC
	default 0 if ADC_SINGLESHOT
	default 1 if ADC_REPETITIVE

choice
	prompt "Capture Mode"
	depends on ADC
	default ADC_RISING_EDGE
	help
	ADC controller capture mode:
	by rising or falling edge of adc_clk

config ADC_RISING_EDGE
	bool "Rising Edge"

config ADC_FALLING_EDGE
	bool "Falling Edge"

endchoice

config ADC_CAPTURE_MODE
	int
	depends on ADC
	default 0 if ADC_RISING_EDGE
	default 1 if ADC_FALLING_EDGE

choice
	prompt "Sample Width"
	depends on ADC
	default ADC_WIDTH_6_BIT
	help
	ADC sample width

config ADC_WIDTH_6_BIT
	bool "6 Bit Width"

config ADC_WIDTH_8_BIT
	bool "8 Bit Width"

config ADC_WIDTH_10_BIT
	bool "10 Bit Width"

config ADC_WIDTH_12_BIT
	bool "12 Bit Width"

endchoice

config ADC_WIDTH
	int
	depends on ADC
	default 0 if ADC_WIDTH_6_BIT
	default 1 if ADC_WIDTH_8_BIT
	default 2 if ADC_WIDTH_10_BIT
	default 3 if ADC_WIDTH_12_BIT

config ADC_SERIAL_DELAY
	int "Serial Delay"
	depends on ADC
	default 1
	help
	Number of ADC clock ticks that the first bit of
	the serial output is delayed after the conversion
	has started.

config ADC_CLOCK_RATIO
	int "Clock Ratio"
	depends on ADC
	default 1024
	help
	ADC Clock Ratio


config  ADC_TI_ADC108S102
	bool "TI adc108s102 chip driver"
	depends on ADC
	select SPI
	default n
	help
	Enable support for TI's ADC chip adc108s102 driver.

config  ADC_TI_ADC108S102_0
	bool "First instance of TI's adc108s102 chip"
	depends on ADC_TI_ADC108S102
	default n
	help
	Enalbe first instance of adc108s102 driver.

config  ADC_TI_ADC108S102_0_DRV_NAME
	string "Driver's name"
	depends on ADC_TI_ADC108S102_0
	default "adc108s102_0"

config  ADC_TI_ADC108S102_0_SPI_PORT_NAME
	string "Master SPI port name"
	depends on ADC_TI_ADC108S102_0
	default ""
	help
	Master SPI port name through which adc108s102 chip is accessed.

config  ADC_TI_ADC108S102_0_SPI_CONFIGURATION
	hex "Master SPI port configuration"
	depends on ADC_TI_ADC108S102_0
	default 0x0
	help
	Master SPI port configuration flags used to access adc108s102 chip.

config  ADC_TI_ADC108S102_0_SPI_MAX_FREQ
	int "Master SPI port max frequency"
	depends on ADC_TI_ADC108S102_0
	default 0
	help
	Master SPI port maximum frequency used to access adc108s102 chip.

config  ADC_TI_ADC108S102_0_SPI_SLAVE
	int "SPI slave slot"
	depends on ADC_TI_ADC108S102_0
	default 0
	help
	adc108s102 chip's SPI slave number on master SPI port.
```

## drivers/clock_control/Kconfig
```kconfig
# Kconfig - Clock controller driver configuration options

#
# Copyright (c) 2015 Intel Corporation
#
# Redistribution and use in source and binary forms, with or without
# modification, are permitted provided that the following conditions are met:
#
# 1) Redistributions of source code must retain the above copyright notice,
# this list of conditions and the following disclaimer.
#
# 2) Redistributions in binary form must reproduce the above copyright notice,
# this list of conditions and the following disclaimer in the documentation
# and/or other materials provided with the distribution.
#
# 3) Neither the name of Intel Corporation nor the names of its contributors
# may be used to endorse or promote products derived from this software without
# specific prior written permission.
#
# THIS SOFTWARE IS PROVIDED BY THE COPYRIGHT HOLDERS AND CONTRIBUTORS "AS IS"
# AND ANY EXPRESS OR IMPLIED WARRANTIES, INCLUDING, BUT NOT LIMITED TO, THE
# IMPLIED WARRANTIES OF MERCHANTABILITY AND FITNESS FOR A PARTICULAR PURPOSE
# ARE DISCLAIMED. IN NO EVENT SHALL THE COPYRIGHT HOLDER OR CONTRIBUTORS BE
# LIABLE FOR ANY DIRECT, INDIRECT, INCIDENTAL, SPECIAL, EXEMPLARY, OR
# CONSEQUENTIAL DAMAGES (INCLUDING, BUT NOT LIMITED TO, PROCUREMENT OF
# SUBSTITUTE GOODS OR SERVICES; LOSS OF USE, DATA, OR PROFITS; OR BUSINESS
# INTERRUPTION) HOWEVER CAUSED AND ON ANY THEORY OF LIABILITY, WHETHER IN
# CONTRACT, STRICT LIABILITY, OR TORT (INCLUDING NEGLIGENCE OR OTHERWISE)
# ARISING IN ANY WAY OUT OF THE USE OF THIS SOFTWARE, EVEN IF ADVISED OF THE
# POSSIBILITY OF SUCH DAMAGE.
#

#
# Clock controller drivers
#
menuconfig CLOCK_CONTROL
	bool
	prompt "Hardware clock controller support"
	default n
	help
	  Enable support for hardware clock controller. Such hardware can
	  provide clock for other subsystem, and thus can be also used for
	  power efficiency by controlling their clock. Note that this has
	  nothing to do with RTC.

config  CLOCK_CONTROL_DEBUG
	bool
	prompt "Hardware clock controller drivers debug output"
	depends on CLOCK_CONTROL
	default n

config  CLOCK_CONTROL_ATP
       bool
       prompt "Quark SE Clock controller support"
       depends on CLOCK_CONTROL && PLATFORM_QUARK_SE_X86
       default n
       help
         Enable support for the Quark SE clock driver.

config  CLOCK_CONTROL_ATP_PERIPHERAL
       bool
       prompt "Quark SE peripheral clock support"
       depends on CLOCK_CONTROL_ATP
       default n
       help
         Enable support for Quark SE peripheral clock which controls the
         clock of ATP's I2C, SPI, GPIO controllers and more.

config  CLOCK_CONTROL_ATP_PERIPHERAL_DRV_NAME
       string
       prompt "Quark SE peripheral clock device name"
       depends on CLOCK_CONTROL_ATP_PERIPHERAL
       default "atp_clock_peripheral"

config  CLOCK_CONTROL_ATP_EXTERNAL
       bool
       prompt "Quark SE external clock support"
       depends on CLOCK_CONTROL_ATP
       default n
       help
         Enable support for Quark SE external sub-system clock.

config  CLOCK_CONTROL_ATP_EXTERNAL_DRV_NAME
       string
       prompt "Quark SE external clock device name"
       depends on CLOCK_CONTROL_ATP_PERIPHERAL
       default "atp_clock_external"

config  CLOCK_CONTROL_ATP_SENSOR
       bool
       prompt "Quark SE sensor clock support"
       depends on CLOCK_CONTROL_ATP
       default n
       help
         Enable support for Quark SE sensor sub-system clock.

config  CLOCK_CONTROL_ATP_SENSOR_DRV_NAME
       string
       prompt "Quark SE sensor clock device name"
       depends on CLOCK_CONTROL_ATP_PERIPHERAL
       default "atp_clock_sensor"
```

## drivers/counter/Kconfig.ace
```kconfig
# Copyright (c) 2022 Intel Corporation
#
# SPDX-License-Identifier: Apache-2.0

DT_COMPAT_ACE_RTC_COUNTER := intel,ace-rtc-counter
DT_COMPAT_ACE_ART_COUNTER := intel,ace-art-counter

config ACE_V1X_ART_COUNTER
	bool "DSP ART Wall Clock for ACE V1X"
	default $(dt_compat_enabled,$(DT_COMPAT_ACE_ART_COUNTER))
	help
	  DSP ART Wall Clock used by ACE V1X.

config ACE_V1X_RTC_COUNTER
	bool "DSP RTC Wall Clock for ACE V1X"
	default $(dt_compat_enabled,$(DT_COMPAT_ACE_RTC_COUNTER))
	help
	  DSP RTC Wall Clock used by ACE V1X.V
```

## drivers/i2c/Kconfig.qmsi
```kconfig
# Kconfig.qmsi - QMSI I2C configuration options

#
# Copyright (c) 2016 Intel Corporation
#
# Licensed under the Apache License, Version 2.0 (the "License");
# you may not use this file except in compliance with the License.
# You may obtain a copy of the License at
#
#     http://www.apache.org/licenses/LICENSE-2.0
#
# Unless required by applicable law or agreed to in writing, software
# distributed under the License is distributed on an "AS IS" BASIS,
# WITHOUT WARRANTIES OR CONDITIONS OF ANY KIND, either express or implied.
# See the License for the specific language governing permissions and
# limitations under the License.
#

menuconfig I2C_QMSI
	bool "QMSI I2C driver"
	depends on I2C && QMSI
	default n
	help
	This option enable the QMSI I2C driver.

	This driver is simply a shim driver based on the I2C driver
	provided by the QMSI BSP.

menuconfig I2C_QMSI_SS
        bool "QMSI I2C driver for the Sensor Subsystem"
        depends on QMSI && I2C
        default n
        help
        This option enable the Sensor QMSI I2C driver.

        This driver is simply a shim driver based on the I2C driver
        provided by the QMSI BSP.

if I2C_QMSI || I2C_QMSI_SS

config I2C_QMSI_0
	bool "Enable I2C_0 controller"
	default n

config I2C_QMSI_0_NAME
	string "I2C_0 device name"
	depends on I2C_QMSI_0
	default "I2C_0"

config I2C_QMSI_0_IRQ_PRI
	int "Interrupt priority from I2C_0 controller"
	depends on I2C_QMSI_0 && I2C_QMSI

config I2C_QMSI_0_DEFAULT_CFG
	hex "I2C_0 default configuration"
	depends on I2C_QMSI_0
	default 0x0
	help
	This option specifies a default configuration for I2C_0 device
	(e.g. addressing mode and bus speed) which is set during driver
	initialization. Refer to I2C API for proper values.

config I2C_QMSI_1
	bool "Enable I2C_1 controller"
	default n

config I2C_QMSI_1_NAME
	string "I2C_1 device name"
	depends on I2C_QMSI_1
	default "I2C_1"

config I2C_QMSI_1_IRQ_PRI
	int "Interrupt priority from I2C_1 controller"
	depends on I2C_QMSI_1 && I2C_QMSI

config I2C_QMSI_1_DEFAULT_CFG
	hex "I2C_1 default configuration"
	depends on I2C_QMSI_1
	default 0x0
	help
	This option specifies a default configuration for I2C_1 device
	(e.g. addressing mode and bus speed) which is set during driver
	initialization. Refer to I2C API for proper values.

endif # I2C_QMSI || I2C_QMSI_SS
```
