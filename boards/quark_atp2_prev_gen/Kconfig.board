## drivers/ipi/Kconfig
```kconfig
menuconfig IPI
	bool
	prompt "IPI drivers"
	default n
	help
		Include interrupt-based inter-processor communication
		drivers in system configuration

config IPI_ATP
	bool "Quark SE Mailbox IPI driver"
	default n
	depends on IPI
	help
		IPI driver for Quark SE mailboxes

config IPI_ATP_MASTER
	bool "Quark SE Mailbox IPI master controller"
	default n
	depends on IPI_ATP
	help
		Enable this for the first CPU that initializes IPI.
		Sets up the initial interrupt mask and clears out all
		channels. Only needs to be turned on for one CPU.
```

## drivers/qmi/Kconfig
```kconfig
# Kconfig - QMI drivers configuration options

#
# Copyright (c) 2015 Intel Corporation
#
# Redistribution and use in source and binary forms, with or without
# modification, are permitted provided that the following conditions are met:
#
# 1) Redistributions of source code must retain the above copyright notice,
# this list of conditions and the following disclaimer.
#
# 2) Redistributions in binary form must reproduce the above copyright notice,
# this list of conditions and the following disclaimer in the documentation
# and/or other materials provided with the distribution.
#
# 3) Neither the name of Intel Corporation nor the names of its contributors
# may be used to endorse or promote products derived from this software without
# specific prior written permission.
#
# THIS SOFTWARE IS PROVIDED BY THE COPYRIGHT HOLDERS AND CONTRIBUTORS "AS IS"
# AND ANY EXPRESS OR IMPLIED WARRANTIES, INCLUDING, BUT NOT LIMITED TO, THE
# IMPLIED WARRANTIES OF MERCHANTABILITY AND FITNESS FOR A PARTICULAR PURPOSE
# ARE DISCLAIMED. IN NO EVENT SHALL THE COPYRIGHT HOLDER OR CONTRIBUTORS BE
# LIABLE FOR ANY DIRECT, INDIRECT, INCIDENTAL, SPECIAL, EXEMPLARY, OR
# CONSEQUENTIAL DAMAGES (INCLUDING, BUT NOT LIMITED TO, PROCUREMENT OF
# SUBSTITUTE GOODS OR SERVICES; LOSS OF USE, DATA, OR PROFITS; OR BUSINESS
# INTERRUPTION) HOWEVER CAUSED AND ON ANY THEORY OF LIABILITY, WHETHER IN
# CONTRACT, STRICT LIABILITY, OR TORT (INCLUDING NEGLIGENCE OR OTHERWISE)
# ARISING IN ANY WAY OUT OF THE USE OF THIS SOFTWARE, EVEN IF ADVISED OF THE
# POSSIBILITY OF SUCH DAMAGE.
#

config QMI_DRIVERS
	depends on X86_32
	bool "Enable QMI drivers [EXPERIMENTAL]"
	default n
	help
	This option enables QMI device drivers. These drivers are actually shim
	drivers based on drivers provided by QMI BSP. The BSP provides a static
	library (libqmi) which implements several drivers for peripherals from
	Intel MCUs (e.g. Quark SE and Quark D2000). If unsure, say N.

config LIBQMI_PATH
	depends on QMI_DRIVERS
	string "Path to libqmi"
	help
	Set path to libqmi.
```

## drivers/rtc/Kconfig
```kconfig
menuconfig RTC
	bool "Real-Time Clock"
	default n
	help
	Enable options for Real-Time Clock drivers.

if RTC

config RTC_DW
	bool "Build Designware RTC Driver"
	default n
	help
	Designware RTC driver.

config QMI_RTC
	depends on QMI_DRIVERS && !RTC_DW
	bool "QMI RTC Driver [EXPERIMENTAL]"
	default n
	help
	Build QMI RTC driver.

endif
```

## drivers/watchdog/Kconfig
```kconfig
menuconfig WATCHDOG
	bool
	prompt "Watchdog Support"
	default n
	help
	Include support for watchdogs.

if WATCHDOG
config WDT_DW
	bool "Enable DesignWare Watchdog"
	default n
	help
	Enable watchdog timer.

config QMI_WDT
	depends on QMI_DRIVERS && !WDT_DW
	bool "QMI Watchdog driver [EXPERIMENTAL]"
	default n
	help
	Build QMI Watchdog driver.
endif
```

## drivers/wdt/Kconfig
```kconfig
menu "Watchdog"

config WDT_DW
	bool "Enable DesignWare Watchdog"
	default n
	help
	Enable watchdog timer.

config QMI_WDT
	depends on QMI_DRIVERS && !WDT_DW
	bool "QMI Watchdog driver [EXPERIMENTAL]"
	default n
	help
	Build QMI Watchdog driver.

endmenu
```
