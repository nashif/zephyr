## dts/bindings/arm/arm,idle-state.yaml
```yaml
# SPDX-License-Identifier: (GPL-2.0-only OR BSD-2-Clause)
title: ARM idle states binding description

description: |+
  ==========================================
  1 - Introduction
  ==========================================

compatible: "arm,idle-state"

properties:
  local-timer-stop:
    required: false
    description:
      If present the CPU local timer control logic is
         lost on state entry, otherwise it is retained.
    type: boolean

  entry-latency-us:
    type: int
    required: true
    description:
      Worst case latency in microseconds required to enter the idle state.

  exit-latency-us:
    type: int
    required: true
    description:
      Worst case latency in microseconds required to exit the idle state.
      The exit-latency-us duration may be guaranteed only after
      entry-latency-us has passed.

  min-residency-us:
    type: int
    required: true
    description:
      Minimum residency duration in microseconds, inclusive of preparation
      and entry, for this idle state to be considered worthwhile energy wise
      (refer to section 2 of this document for a complete description).

  wakeup-latency-us:
    type: int
    required: false
    description: |
      Maximum delay between the signaling of a wake-up event and the CPU
      being able to execute normal code again. If omitted, this is assumed
      to be equal to:

        entry-latency-us + exit-latency-us

      It is important to supply this value on systems where the duration of
      PREP phase (see diagram 1, section 2) is non-neglibigle. In such
      systems entry-latency-us + exit-latency-us will exceed
      wakeup-latency-us by this duration.
...
```

## dts/bindings/counter/intel,ace-art-counter.yaml
```yaml
description: ACE wallclock ART counter controller

compatible: "intel,ace-art-counter"

include: base.yaml

properties:
  label:
      required: true
  reg:
      required: true
```

## dts/bindings/counter/intel,ace-rtc-counter.yaml
```yaml
description: ACE wallclock RTC counter controller

compatible: "intel,ace-rtc-counter"

include: base.yaml

properties:
  label:
      required: true
  reg:
      required: true
```

## dts/bindings/cpu/cpu.yaml
```yaml
# Copyright (c) 2019 Nordic Semiconductor ASA
# SPDX-License-Identifier: Apache-2.0

# Common fields for CPUs

include: base.yaml

properties:
    clock-frequency:
      type: int
      required: false
      description: Clock frequency in Hz
    cpu-idle-states:
      type: phandles
      required: false
      description: |
        List of phandles to idle state nodes supported
        by this cpu (see ./idle-states.yaml).
```

## ext/debug/segger/Kconfig
```kconfig
#
# Copyright (c) 2016 Nordic Semiconductor ASA
#
# SPDX-License-Identifier: Apache-2.0
#

config HAS_SEGGER_RTT
	bool
	default n

config SEGGER_SYSTEMVIEW
	bool
	prompt "Segger SystemView support"
	default n
	depends on HAS_SEGGER_RTT
	select RTT_CONSOLE
	select THREAD_MONITOR
	select KERNEL_EVENT_LOGGER
	select KERNEL_EVENT_LOGGER_CONTEXT_SWITCH
	select KERNEL_EVENT_LOGGER_INTERRUPT
	select KERNEL_EVENT_LOGGER_SLEEP
	select KERNEL_EVENT_LOGGER_THREAD
```

## samples/basic/blink_led/sample.yaml
```yaml
sample:
  name: Blink LED (PWM based)
tests:
  - test:
      build_only: true
      tags: apps
      depends_on: pwm
```

## samples/basic/fade_led/sample.yaml
```yaml
sample:
  name: Fade LED
tests:
  - test:
      build_only: true
      tags: apps
      depends_on: pwm
```

## samples/basic/rgb_led/sample.yaml
```yaml
sample:
  name: RGB LED
tests:
  - test:
      build_only: true
      tags: apps
      depends_on: pwm
```

## samples/basic/servo_motor/sample.yaml
```yaml
sample:
  name: Servo Motor using PWM
tests:
  - test:
      build_only: true
      tags: apps
      depends_on: pwm
```

## samples/drivers/charger/sample.yaml
```yaml
sample:
  name: Generic charger
tests:
  sample.drivers.charger:
    tags: charger
```

## samples/kernel/condition_variables/pm/sample.yaml
```yaml
tests:
  sample.kernel.cond_var.pm:
    tags: kernel condition_variables
    harness: console
    harness_config:
      type: one_line
      regex:
        - ".*Waited and joined with 3 threads"
```

## samples/kernel/thread_notify/sample.yaml
```yaml
tests:
  sample.kernel.thread_notify:
    integration_platforms:
      - native_sim
    tags:
      - kernel
      - thread_notify
    harness: console
    harness_config:
      type: multi_line
      regex:
        - ".*\\[main\\] waiting for sensor notification"
        - ".*\\[sensor\\] posting temperature: 23"
        - ".*\\[main\\] received notification: value=0x00000017"
        - ".*\\[producer\\] sending 5 work items"
        - ".*\\[consumer\\] processed 5 work items"
        - ".*Sample complete"
```

## soc/xtensa/intel_adsp/cavs/Kconfig.defconfig.cavs_v25
```kconfig
# Copyright (c) 2020,2022 Intel Corporation
# SPDX-License-Identifier: Apache-2.0

if SOC_INTEL_CAVS_V25

config SOC_TOOLCHAIN_NAME
	string
	default "intel_s1000"

config SOC
	default "intel_tgl_adsp"

# For backward compatibility, to be removed
config SOC_SERIES_INTEL_CAVS_V25
	def_bool y

# Hardware has four cores, limited to two pending test fixes
config MP_NUM_CPUS
	default 2

config SMP
	default y

config XTENSA_TIMER
	default n

config INTEL_ADSP_TIMER
	default y

config SYS_CLOCK_HW_CYCLES_PER_SEC
	default 400000000 if XTENSA_TIMER
	default 38400000 if INTEL_ADSP_TIMER

config SYS_CLOCK_TICKS_PER_SEC
	default 50000

config KERNEL_ENTRY
	default "_MainEntry"

config MULTI_LEVEL_INTERRUPTS
	default y

config 2ND_LEVEL_INTERRUPTS
	default y

config DYNAMIC_INTERRUPTS
	default y

if LOG
config LOG_BACKEND_ADSP
	default y

endif # LOG

if KERNEL_VM_SUPPORT

config KERNEL_VM_SIZE
	default 0x800000

endif

endif # SOC_INTEL_CAVS_V25
```

## subsys/debug/tracing/Kconfig
```kconfig
# Tracing configuration options

# Copyright (c) 2019 Intel Corporation
# SPDX-License-Identifier: Apache-2.0

config TRACING
	bool "Enable System Tracing"
	help
	  Enable system tracing. This option will enable all tracing macros which
	  are defined and set to do nothing when there is no backend enabled. A
	  backend in this context implements the tracing events in a format that is
	  compatible with what an application on the host side would expect.

	  This requires a backend such as SEGGER Systemview or CTF to be enabled.

config TRACING_CPU_STATS
	bool "Enable CPU usage tracing"
	select THREAD_MONITOR
	select THREAD_STACK_INFO
	select TRACING
	help
	  Module provides information about percent of CPU usage based on
	  tracing hooks for threads switching in and out, interrupts enters
	  and exits (only distinguishes between idle thread, non idle thread
	  and scheduler).

	  Use provided API or enable automatic logging to get values.

config TRACING_CPU_STATS_LOG
	bool "Enable current CPU usage logging"
	depends on TRACING_CPU_STATS
	help
	  Periodically displays information about CPU usage.

config TRACING_CPU_STATS_INTERVAL
	int "Logging interval for CPU measurements [ms]"
	default 2000
	depends on TRACING_CPU_STATS_LOG
	help
	  Time period of displaying information about CPU usage.

config TRACING_CTF
	bool "Tracing via Common Trace Format support"
	select THREAD_MONITOR
	 select TRACING
	help
	  Enable tracing to a Common Trace Format stream.

	  In order to use it a CTF bottom layer should be selected,
	  such as TRACING_CTF_BOTTOM_POSIX.

config TRACING_CTF_BOTTOM_POSIX
	bool "CTF backend for the native_posix port, using a file in the host filesystem"
	depends on TRACING_CTF
	depends on ARCH_POSIX
	help
	  Enable POSIX backend for CTF tracing. It will output the CTF stream to a
	  file using fwrite.

config SEGGER_SYSTEMVIEW
	bool "Segger SystemView support"
	depends on USE_SEGGER_RTT
	select RTT_CONSOLE
	select THREAD_MONITOR
	select THREAD_STACK_INFO
	select TRACING
```

## subsys/logging/Kconfig
```kconfig
#
# Copyright (c) 2016 Intel Corporation
#
# SPDX-License-Identifier: Apache-2.0
#
menu "Logging Options"

config SYS_LOG
	bool
	prompt "Enable Logging"
	depends on PRINTK
	default n
	help
	  Global switch for logging, when turned off log calls will not be
	  executed.

config SYS_LOG_SHOW_TAGS
	bool
	prompt "Prepend level tags to logs"
	depends on SYS_LOG
	default y
	help
	  Prefixes all log lines with an identifier to the log level submitted in
	  the C code.

config SYS_LOG_SHOW_COLOR
	bool
	prompt "Use colored logs"
	depends on SYS_LOG
	default n
	help
	  Use color in the logs. This requires an ANSI capable terminal.

config SYS_LOG_DEFAULT_LEVEL
	int
	prompt "Default log level"
	depends on SYS_LOG
	default 0
	range 0 4
	help
	  Sets log level for modules which don't specify it explicitly. When
	  set to 0 it means log wont be activated for those modules.
	  Levels are:
	  0 OFF, do not write by default
	  1 ERROR, default to only write SYS_LOG_ERR
	  2 WARNING, default to write SYS_LOG_WRN in addition to previous level
	  3 INFO, default to write SYS_LOG_INF in addition to previous levels
	  4 DEBUG, default to write SYS_LOG_DBG in addition to previous levels

config SYS_LOG_OVERRIDE_LEVEL
	int
	prompt "Override lowest log level"
	depends on SYS_LOG
	default 0
	range 0 4
	help
	  Forces a minimum log level for all modules. Modules use their
	  specified level if it is greater than this option, otherwise they use
	  the level specified by this option instead of their default or
	  whatever was manually set.
	  Levels are:
	  0 OFF, do not override
	  1 ERROR, override to write SYS_LOG_ERR
	  2 WARNING, override to write SYS_LOG_WRN in addition to previous level
	  3 INFO, override to write SYS_LOG_INF in addition to previous levels
	  4 DEBUG, override to write SYS_LOG_DBG in addition to previous levels

config SYS_LOG_EXT_HOOK
	bool
	prompt "Use external hook function for logging"
	depends on SYS_LOG
	default n
	help
	  Use external hook function for logging.
endmenu

menuconfig KERNEL_EVENT_LOGGER
	bool
	prompt "Enable kernel event logger features"
	default n
	select RING_BUFFER
	help
	  This feature enables the usage of the profiling logger. Provides the
	  logging of sleep events (either entering or leaving low power conditions),
	  context switch events, interrupt events, boot events and a method to
	  collect these event messages.

if KERNEL_EVENT_LOGGER
config KERNEL_EVENT_LOGGER_BUFFER_SIZE
	int
	prompt "Kernel event logger buffer size"
	default 128
	help
	  Buffer size in 32-bit words.

config KERNEL_EVENT_LOGGER_DYNAMIC
	bool
	prompt "Kernel event logger dynamic enabling"
	default n
	help
	  If enabled, kernel event logger is not logging any data to the ring buffer
	  It is up to the application to set the appropriate flags to enable/disable the
	  logging of each event type.

config KERNEL_EVENT_LOGGER_CUSTOM_TIMESTAMP
	bool
	prompt "Kernel event logger custom timestamp"
	default n
	help
	  This flag enables the possibility to set the timer function to be used to
	  populate kernel event logger timestamp. This has to be done at runtime by
	  calling sys_k_event_logger_set_timer and providing the function callback.

menu "Kernel event logging points"

config KERNEL_EVENT_LOGGER_CONTEXT_SWITCH
	bool
	prompt "Context switch event logging point"
	default n
	help
	  Enable the context switch event messages.

config KERNEL_EVENT_LOGGER_INTERRUPT
	bool
	prompt "Interrupt event logging point"
	default n
	help
	  Enable interrupt event messages. These messages provide the following
	  information: The time when interrupts occur.

config KERNEL_EVENT_LOGGER_SLEEP
	bool
	prompt "Sleep event logging point"
	default n
	depends on SYS_POWER_MANAGEMENT
	help
	  Enable low power condition event messages. These messages provide the
	  following information:

		- When the CPU went to sleep mode.
		- When the CPU woke up.
		- The ID of the interrupt that woke the CPU up.

config KERNEL_EVENT_LOGGER_THREAD
	bool
	prompt "Thread event logging point"
	default n
	help
	  Enable thread event messages. These messages provide the following
	  information:

		- When threads are marked as ready to be executed.
		- When threads are marked as pending.
		- When threads end.

	  Context switching messages should be enabled by enabling the
	  CONFIG_KERNEL_EVENT_LOGGER_CONTEXT_SWITCH setting instead.

endmenu

endif
```

## subsys/mctp/Kconfig
```kconfig
config MCTP
	bool "Enable MCTP support"
	default y
	help
	  Enable MCTP support.
if MCTP

module = MCTP
module-str = MCTP
module-help = Sets log level for MCTP support
source "subsys/logging/Kconfig.template.log_config"

endif
```

## subsys/posix/Kconfig
```kconfig
menu "POSIX Compatibility Layer"

config PTHREAD_IPC
	bool
	prompt "POSIX pthread IPC API"
	default n
	help
	  This enables a mostly-standards-compliant implementation of
	  the pthread mutex, condition variable and barrier IPC
	  mechanisms.

if PTHREAD_IPC
config MAX_PTHREAD_COUNT
	int
	prompt "Maximum pthread count in POSIX application"
	default 5
	range 0 255
	help
	  Mention maximum number of threads in POSIX compliant application.

config SEM_VALUE_MAX
	int
	prompt "Maximum semaphore limit"
	default 32767
	range 1 32767
	help
	  Maximum semaphore count in POSIX compliant Application.

config MAX_TIMER_COUNT
	int
	prompt "Maximum timer count in POSIX application"
	default 5
	range 0 255
	help
	  Mention maximum number of timers in POSIX compliant application.
endif
endmenu
```

## subsys/process/Kconfig
```kconfig
# Copyright (c) 2026 The Zephyr Project Contributors
# SPDX-License-Identifier: Apache-2.0

menuconfig PROCESS
	bool "Zephyr Process Model"
	depends on LLEXT
	select THREAD_NAME
	help
	  Enable the Zephyr process model subsystem.

	  The process model combines three Zephyr subsystems to create a
	  cohesive abstraction for isolated, dynamically-loaded application
	  processes:

	    - LLEXT for loading ELF binaries at runtime
	    - Memory Domains for per-process hardware memory isolation
	      (requires CONFIG_USERSPACE)
	    - Userspace to run process threads in unprivileged mode

	  A simple API (z_process_load / z_process_start / z_process_join /
	  z_process_unload) hides the internal complexity of each subsystem.

if PROCESS

config PROCESS_NAME_MAX_LEN
	int "Maximum length of a process name"
	default 15
	range 8 31
	help
	  Maximum number of characters in a process name, not counting the
	  null terminator.  Truncation is silent.

config PROCESS_STACK_SIZE_DEFAULT
	int "Default process thread stack size (bytes)"
	default 2048
	help
	  Stack size used when z_process_opts.stack_size is 0.

config PROCESS_PRIORITY_DEFAULT
	int "Default process thread scheduling priority"
	default 5
	range -16 14
	help
	  Scheduling priority applied to a new process thread when
	  z_process_opts.priority is not overridden.

module = PROCESS
module-str = process
source "subsys/logging/Kconfig.template.log_config"

endif # PROCESS
```
