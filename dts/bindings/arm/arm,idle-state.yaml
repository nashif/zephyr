## subsys/tracing/Kconfig
```kconfig
# Copyright (c) 2015 Wind River Systems, Inc.
# SPDX-License-Identifier: Apache-2.0

config TRACING
	bool "Enabling Tracing"
	help
	  Enable system tracing. This requires a backend such as SEGGER
	  Systemview to be enabled as well.


config TRACING_CPU_STATS
	bool "Enable CPU usage tracing"
	select THREAD_MONITOR
	select THREAD_STACK_INFO
	select TRACING
	help
	  Module provides information about percent of CPU usage based on
	  tracing hooks for threads switching in and out, interrupts enters
	  and exits (only distinguishes between idle thread, non idle thread
	  and scheduler). Use provided API or enable automatic logging to
	  get values.

config TRACING_CPU_STATS_LOG
	bool "Enable current CPU usage logging"
	depends on TRACING_CPU_STATS
	help
	  Periodically displays information about CPU usage.

config TRACING_CPU_STATS_INTERVAL
	int "Logging interval for CPU measurements [ms]"
	default 2000
	depends on TRACING_CPU_STATS_LOG
	help
	  Time period of displaying information about CPU usage.

config TRACING_CTF
	bool "Tracing via Common Trace Format support"
	select THREAD_MONITOR
	select TRACING
	help
	  Enable tracing to a Common Trace Format stream. In order to use it a
	  CTF bottom layer should be selected, such as TRACING_CTF_BOTTOM_POSIX.

config TRACING_CTF_BOTTOM_POSIX
	bool "CTF backend for the native_posix port, using a file in the host filesystem"
	depends on TRACING_CTF
	depends on ARCH_POSIX
	help
	  Enable POSIX backend for CTF tracing. It will output the CTF stream to a
	  file using fwrite.

source "subsys/tracing/Kconfig.systemview"
```

## subsys/tracing/Kconfig.systemview
```kconfig
# Copyright (c) 2016 Nordic Semiconductor ASA
# SPDX-License-Identifier: Apache-2.0

config SEGGER_SYSTEMVIEW
	bool "Segger SystemView support"
	depends on USE_SEGGER_RTT
	select CONSOLE
	select THREAD_MONITOR
	select THREAD_STACK_INFO
	select TRACING

config SEGGER_SYSTEMVIEW_BOOT_ENABLE
	bool "Start logging SystemView events on system start"
	depends on SEGGER_SYSTEMVIEW

config SEGGER_SYSVIEW_RTT_BUFFER_SIZE
	int "Buffer size for SystemView RTT"
	depends on SEGGER_SYSTEMVIEW
	default 4096
```

## tests/crypto/aes/testcase.yaml
```yaml
common:
  cases:
    - key_chain
    - vectors
    - fixed_key_variable_text
    - variable_key_fixed_text
tests:
  crypto.aes:
    tags: crypto aes
```

## tests/crypto/cbc_mode/testcase.yaml
```yaml
common:
  cases:
    - sp_800_38a_encrypt_decrypt
tests:
  crypto.cbc_mode:
    tags: crypto aes cbc
```

## tests/crypto/ccm_mode/testcase.yaml
```yaml
common:
  cases:
    - vector_1
    - vector_2
    - vector_3
    - vector_4
    - vector_5
    - vector_6
    - vector_7
    - vector_8
tests:
  crypto.ccm_mode:
    tags: crypto aes ccm
```

## tests/crypto/cmac_mode/testcase.yaml
```yaml
common:
  cases:
    - cmac_mode
tests:
  crypto.cmac_mode:
    tags: crypto aes cmac
```

## tests/crypto/ctr_mode/testcase.yaml
```yaml
common:
  cases:
    - 1_and_2
tests:
  crypto.ctr_mode:
    tags: crypto aes ctr
```
