## arch/x86/platforms/quark_se-x86/Kconfig
```kconfig
# Kconfig - Quark SE configuration options

#
# Copyright (c) 2015 Intel Corp.
#
# Licensed under the Apache License, Version 2.0 (the "License");
# you may not use this file except in compliance with the License.
# You may obtain a copy of the License at
#
#     http://www.apache.org/licenses/LICENSE-2.0
#
# Unless required by applicable law or agreed to in writing, software
# distributed under the License is distributed on an "AS IS" BASIS,
# WITHOUT WARRANTIES OR CONDITIONS OF ANY KIND, either express or implied.
# See the License for the specific language governing permissions and
# limitations under the License.
#

config PLATFORM
        string
        default quark_se-x86
        help
        This option holds the directory name used by the build system to locate
        the correct linker file.

choice
        prompt "Board Type"
        depends on PLATFORM_QUARK_SE_X86
        default BOARD_CTB

        config BOARD_CTB
        bool "CTB - Curie Platform"

        config BOARD_APP
        bool "APP - Quark SE Platform"

        config BOARD_AAE
        bool "AAE - Quark SE AtlasEdge"
endchoice

config  LOAPIC_TIMER_FREQ
        default 32000000

config	SYS_CLOCK_HW_CYCLES_PER_SEC
	default 32000000

config  PHYS_LOAD_ADDR
	default 0x40030000 if XIP
	default 0xA8006400 if !XIP

config IOAPIC_NUM_RTES
	default 64

config LOAPIC_TIMER_IRQ
	default 64

config PINMUX
        default y

if PINMUX
config PINMUX_BASE
        default 0xB0800930

config PINMUX_NUM_PINS
	default 69
endif

config DW_AIO_COMPARATOR_BASE_ADDR
	hex
	depends on DW_AIO_COMPARATOR
	default 0xb0800300

config ARC_INIT
	bool "Quark SE ARC Kickoff"
	default n
	help
	Allows x86 processor to kickoff the ARC slave processor.

config ARC_INIT_DEBUG
	bool "Allows the usage of GDB with the ARC processor."
	depends on ARC_INIT
	default n
	help
	This option will stop the master processor from boot-strapping
	the ARC slave processor. This will allow GDB to halt and
	engage the ARC processor to proceed step by step execution.

if GPIO_DW

config GPIO_DW_BOTHEDGES_SUPPORT
	default y

config GPIO_DW_0_BASE_ADDR
	default 0xB0000C00
config GPIO_DW_0_IRQ
	default 8

config GPIO_DW_1_BASE_ADDR
	default 0xB0001700
config GPIO_DW_1_IRQ
	default 8

endif

if I2C_DW
config I2C_DW_0
        default y

config I2C_DW_0_BASE
        default 0xb0002800

config I2C_DW_0_NAME
        default "I2C0"

config I2C_DW_0_INT_PRIORITY
        default 0

config I2C_DW_1
        default y

config I2C_DW_1_BASE
        default 0xb0002c00

config I2C_DW_1_NAME
        default "I2C1"

config I2C_DW_1_INT_PRIORITY
        default 0
endif

if CLOCK_CONTROL_QUARK_SE

config  CLOCK_CONTROL_QUARK_SE_PERIPHERAL
       default n

config  CLOCK_CONTROL_QUARK_SE_PERIPHERAL_DRV_NAME
       default "clk_peripheral"

config  CLOCK_CONTROL_QUARK_SE_EXTERNAL
       default n

config  CLOCK_CONTROL_QUARK_SE_EXTERNAL_DRV_NAME
       default "clk_external"

config  CLOCK_CONTROL_QUARK_SE_SENSOR
       default n

config  CLOCK_CONTROL_QUARK_SE_SENSOR_DRV_NAME
       default "clk_sensor"
endif
```

## arch/x86/soc/quark_atp2/Kconfig
```kconfig
# Kconfig - atlas peak 2 configuration options

#
# Copyright (c) 2015 Intel Corp.
#
# Redistribution and use in source and binary forms, with or without
# modification, are permitted provided that the following conditions are met:
#
# 1) Redistributions of source code must retain the above copyright notice,
# this list of conditions and the following disclaimer.
#
# 2) Redistributions in binary form must reproduce the above copyright notice,
# this list of conditions and the following disclaimer in the documentation
# and/or other materials provided with the distribution.
#
# 3) Neither the name of Wind River Systems nor the names of its contributors
# may be used to endorse or promote products derived from this software without
# specific prior written permission.
#
# THIS SOFTWARE IS PROVIDED BY THE COPYRIGHT HOLDERS AND CONTRIBUTORS "AS IS"
# AND ANY EXPRESS OR IMPLIED WARRANTIES, INCLUDING, BUT NOT LIMITED TO, THE
# IMPLIED WARRANTIES OF MERCHANTABILITY AND FITNESS FOR A PARTICULAR PURPOSE
# ARE DISCLAIMED. IN NO EVENT SHALL THE COPYRIGHT HOLDER OR CONTRIBUTORS BE
# LIABLE FOR ANY DIRECT, INDIRECT, INCIDENTAL, SPECIAL, EXEMPLARY, OR
# CONSEQUENTIAL DAMAGES (INCLUDING, BUT NOT LIMITED TO, PROCUREMENT OF
# SUBSTITUTE GOODS OR SERVICES; LOSS OF USE, DATA, OR PROFITS; OR BUSINESS
# INTERRUPTION) HOWEVER CAUSED AND ON ANY THEORY OF LIABILITY, WHETHER IN
# CONTRACT, STRICT LIABILITY, OR TORT (INCLUDING NEGLIGENCE OR OTHERWISE)
# ARISING IN ANY WAY OUT OF THE USE OF THIS SOFTWARE, EVEN IF ADVISED OF THE
# POSSIBILITY OF SUCH DAMAGE.
#

if SOC_QUARK_ATP2
config SOC
        default quark_atp2

config  PHYS_RAM_ADDR
	default 0xA8000800

config  PHYS_LOAD_ADDR
	default 0x40008000 if XIP

config RAM_SIZE
	default 126

config ROM_SIZE
	default 256

config	SYS_CLOCK_HW_CYCLES_PER_SEC
	default 120000000

config IOAPIC_NUM_RTES
	default 64

config LOAPIC_TIMER_IRQ
	default 64


config EOI_FORWARDING_BUG
	bool
	default y
	help
	Quark SE LOAPIC has issues with forwarding EOI to the IOAPIC for level
	triggered interrupts, this is a SW workaround.


config TOOLCHAIN_VARIANT
	default "iamcu"

config KERNEL_INIT_PRIORITY_DEFAULT
	default 40

config KERNEL_INIT_PRIORITY_DEVICE
	default 50

config UART_CONSOLE_PRIORITY
	default 60

if UART_NS16550

config UART_NS16550_DLF
	def_bool y

config UART_NS16550_PORT_0
	def_bool n

if UART_NS16550_PORT_0

config UART_NS16550_PORT_0_NAME
	default "UART_0"
config UART_NS16550_PORT_0_BASE_ADDR
	default 0xB0000800
config UART_NS16550_PORT_0_IRQ
	default 15
config UART_NS16550_PORT_0_IRQ_PRI
	default 3
config UART_NS16550_PORT_0_BAUD_RATE
	default 115200
config UART_NS16550_PORT_0_CLK_FREQ
	default 120000000
config UART_NS16550_PORT_0_OPTIONS
	default 0
config UART_NS16550_PORT_0_DLF
	default 0x02

endif # UART_NS16550_PORT_0

config UART_NS16550_PORT_1
	def_bool y

if UART_NS16550_PORT_1

config UART_NS16550_PORT_1_NAME
	default "UART_1"
config UART_NS16550_PORT_1_BASE_ADDR
	default 0xB0020800
config UART_NS16550_PORT_1_IRQ
	default 43
config UART_NS16550_PORT_1_IRQ_PRI
	default 3
config UART_NS16550_PORT_1_BAUD_RATE
	default 115200
config UART_NS16550_PORT_1_CLK_FREQ
	default 120000000
config UART_NS16550_PORT_1_OPTIONS
	default 0
config UART_NS16550_PORT_1_DLF
	default 0x02

endif # UART_NS16550_PORT_1

endif # UART_NS16550

endif #SOC_QUARK_ATP2
```

## arch/x86/soc/quark_atp2/Kconfig.defconfig
```kconfig
# Kconfig - Quark ATP2 configuration options

#
# Copyright (c) 2015-2016 Intel Corporation
#
# Licensed under the Apache License, Version 2.0 (the "License");
# you may not use this file except in compliance with the License.
# You may obtain a copy of the License at
#
#     http://www.apache.org/licenses/LICENSE-2.0
#
# Unless required by applicable law or agreed to in writing, software
# distributed under the License is distributed on an "AS IS" BASIS,
# WITHOUT WARRANTIES OR CONDITIONS OF ANY KIND, either express or implied.
# See the License for the specific language governing permissions and
# limitations under the License.
#

if SOC_QUARK_ATP2

config SOC
        default quark_atp2

config  PHYS_RAM_ADDR
	default 0xA8000800

config  PHYS_LOAD_ADDR
	default 0x40008000 if XIP

config RAM_SIZE
        default 126

config ROM_SIZE
        default 256

config	SYS_CLOCK_HW_CYCLES_PER_SEC
	default 120000000

config IOAPIC_NUM_RTES
	default 64 if IOAPIC

config LOAPIC_TIMER_IRQ
	default 64 if LOAPIC_TIMER

config TOOLCHAIN_VARIANT
	default "iamcu"


if UART_NS16550

config UART_NS16550_DLF
        def_bool y

config UART_NS16550_PORT_0
	def_bool y

if UART_NS16550_PORT_0

config UART_NS16550_PORT_0_NAME
	default "UART_0"
config UART_NS16550_PORT_0_IRQ_PRI
	default 3
config UART_NS16550_PORT_0_BAUD_RATE
	default 115200
config UART_NS16550_PORT_0_OPTIONS
	default 0
config UART_NS16550_PORT_0_DLF
       default 0x02

endif # UART_NS16550_PORT_0

config UART_NS16550_PORT_1
	def_bool y

if UART_NS16550_PORT_1

config UART_NS16550_PORT_1_NAME
	default "UART_1"
config UART_NS16550_PORT_1_IRQ_PRI
	default 3
config UART_NS16550_PORT_1_BAUD_RATE
	default 115200
config UART_NS16550_PORT_1_OPTIONS
	default 0
config UART_NS16550_PORT_1_DLF
       default 0x02

endif # UART_NS16550_PORT_1

endif # UART_NS16550


endif # SOC_QUARK_ATP2
```

## arch/x86/soc/quark_atp2/Kconfig.soc
```kconfig
config  SOC_QUARK_ATP2
        bool "Intel Quark ATP2"
        select CPU_MINUTEIA
        select IOAPIC
        select LOAPIC
        select LOAPIC_TIMER
        select EOI_HANDLER_SUPPORTED
        select BOOTLOADER_UNKNOWN
        select XIP
	select X86_IAMCU
```

## arch/x86/soc/quark_se2/Kconfig.soc
```kconfig
config  SOC_QUARK_SE2
	bool "Intel Quark SE2"
	select CPU_MINUTEIA
	select IOAPIC
	select LOAPIC
	select LOAPIC_TIMER
	select EOI_HANDLER_SUPPORTED
	select BOOTLOADER_UNKNOWN
	select XIP
	select X86_IAMCU
```

## boards/quark_atp2_dvp/Kconfig
```kconfig
if BOARD_QUARK_ATP2_DVP

config BOARD
        default "quark_atp2_dvp"

endif # BOARD_QUARK_ATP2_DVP
```

## boards/quark_atp2_dvp/Kconfig.board
```kconfig
config  BOARD_QUARK_ATP2_DVP
        bool "Quark ATP2 Silicon Validation Board"
        depends on SOC_QUARK_ATP2
```

## boards/quark_atp2_dvp/quark_atp2_dvp_defconfig
```kconfig
CONFIG_X86=y
CONFIG_SOC_QUARK_ATP2=y
CONFIG_BOARD_QUARK_ATP2_DVP=y
CONFIG_CPU_MINUTEIA=y
CONFIG_CONSOLE=y
CONFIG_UART_CONSOLE=y
CONFIG_SERIAL=y
CONFIG_UART_IRQ_RISING_EDGE=y
CONFIG_UART_NS16550=y
CONFIG_PRINTK=y
```

## boards/quark_atp2_emu/Kconfig
```kconfig
if BOARD_QUARK_ATP2_EMU

config BOARD
        default "quark_atp2_emu"

endif # BOARD_QUARK_ATP2_EMU
```

## boards/quark_atp2_emu/Kconfig.board
```kconfig
config  BOARD_QUARK_ATP2_EMU
        bool "Quark ATP2 Emulation Board"
        select SOC_QUARK_ATP2
	depends on X86
```

## boards/quark_atp2_emu/quark_atp2_emu_defconfig
```kconfig
CONFIG_X86=y
CONFIG_SOC_QUARK_ATP2=y
CONFIG_BOARD_QUARK_ATP2_EMU=y
CONFIG_CPU_MINUTEIA=y
CONFIG_CONSOLE=y
CONFIG_UART_CONSOLE=y
CONFIG_SERIAL=y
CONFIG_UART_IRQ_RISING_EDGE=y
CONFIG_UART_NS16550=y
CONFIG_PRINTK=y

#>> BEGIN override of SoC defaults for emulation board.
CONFIG_SYS_CLOCK_HW_CYCLES_PER_SEC=16000000
CONFIG_CPU_CLOCK_FREQ_MHZ=16

CONFIG_UART_NS16550_PORT_0_CLK_FREQ=16000000
CONFIG_UART_NS16550_PORT_0_DLF=0x0B

CONFIG_UART_NS16550_PORT_1_CLK_FREQ=16000000
CONFIG_UART_NS16550_PORT_1_DLF=0x0B

#<< END override of SoC defaults for emulation board.
```

## boards/quark_atp2_prev_gen/Kconfig
```kconfig
if BOARD_QUARK_ATP2_PREV_GEN

config BOARD
        default "quark_atp2_prev_gen"

endif # BOARD_QUARK_ATP2_PREV_GEN
```
