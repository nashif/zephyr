## arch/arc/platforms/quark_se-arc/Kconfig
```kconfig
# bsp.kconf - Quark SE ARC BSP configuration options

#
# Copyright (c) 2014 Wind River Systems, Inc.
#
# Licensed under the Apache License, Version 2.0 (the "License");
# you may not use this file except in compliance with the License.
# You may obtain a copy of the License at
#
#     http://www.apache.org/licenses/LICENSE-2.0
#
# Unless required by applicable law or agreed to in writing, software
# distributed under the License is distributed on an "AS IS" BASIS,
# WITHOUT WARRANTIES OR CONDITIONS OF ANY KIND, either express or implied.
# See the License for the specific language governing permissions and
# limitations under the License.
#

config PLATFORM
        string
        default quark_se-arc
        help
        This option holds the directory name used by the build system to locate
        the correct linker file.

config NUM_IRQ_PRIO_LEVELS
	# This processor supports only 2 priority levels:
	# 0 for Fast Interrupts (FIRQs) and 1 for Regular Interrupts (IRQs).
	default 2

config NUM_REGULAR_IRQ_PRIO_LEVELS
	# This processor supports only 1 Regular Interrupt priority level (1).
	default 1

config  NUM_IRQS
	# must be >= the highest interrupt number used
	default 68


menu "Quark SE BSP Options"


config	SYS_CLOCK_HW_CYCLES_PER_SEC
	default 32000000

config RAM_START
	prompt "RAM start address"
	hex
	default 0x4000 if NSIM
	default 0xa8000400

config RAM_SIZE
	prompt "RAM size (in bytes)"
	hex
	default 0x4000 if NSIM
	default 0x6000

config NSIM
	prompt "Running on the MetaWare nSIM simulator"
	bool
	default n
	help
	  For running on nSIM simulator.

	  a) Uses non-XIP to run in RAM.
	  b) Linked at address 0x4000 with 0x4000 of RAM so that it works with
	     a pc_size of 16 (default).
	  c) Sets the entry point to __reset, since it seems nSIM ignores the
	     reset vector when starting (??).

endmenu

if GPIO_DW

config GPIO_DW_BOTHEDGES_SUPPORT
	default n

config GPIO_DW_0_BASE_ADDR
	default 0x80017800
config GPIO_DW_0_IRQ
	default 8

config GPIO_DW_1_BASE_ADDR
	default 0x80017900
config GPIO_DW_1_IRQ
	default 8

endif
```

## arch/arc/soc/quark_atp2_ss/Kconfig
```kconfig
#
# Copyright (c) 2014 Wind River Systems, Inc.
#
# Licensed under the Apache License, Version 2.0 (the "License");
# you may not use this file except in compliance with the License.
# You may obtain a copy of the License at
#
#     http://www.apache.org/licenses/LICENSE-2.0
#
# Unless required by applicable law or agreed to in writing, software
# distributed under the License is distributed on an "AS IS" BASIS,
# WITHOUT WARRANTIES OR CONDITIONS OF ANY KIND, either express or implied.
# See the License for the specific language governing permissions and
# limitations under the License.
#

if SOC_QUARK_ATP2_SS

config SOC
	default quark_atp2_ss

config NUM_IRQ_PRIO_LEVELS
	# This processor supports only 2 priority levels:
	# 0 for Fast Interrupts (FIRQs) and 1 for Regular Interrupts (IRQs).
	default 2

config NUM_REGULAR_IRQ_PRIO_LEVELS
	# This processor supports only 1 Regular Interrupt priority level (1).
	default 1

config  NUM_IRQS
	# must be > the highest interrupt number used
	default 116


config	SYS_CLOCK_HW_CYCLES_PER_SEC
	default 120000000

config RAM_START
	default 0x4000 if NSIM
	default 0xa8020000

config RAM_SIZE
	default 16 if NSIM
	default 128

config INTERNAL_FLASH_START
	prompt "Flash start address"
	hex
	default 0x400E8000

config INTERNAL_FLASH_SIZE
	prompt "Flash size (in bytes)"
	hex
	default 0x00040000


if UART_NS16550

config UART_NS16550_DLF
	def_bool y

config UART_NS16550_PORT_0
        def_bool y

if UART_NS16550_PORT_0

config UART_NS16550_PORT_0_NAME
	default "UART_0"
config UART_NS16550_PORT_0_BASE_ADDR
	default 0xB0000800
config UART_NS16550_PORT_0_IRQ
	default 69
config UART_NS16550_PORT_0_IRQ_PRI
	default 1
config UART_NS16550_PORT_0_BAUD_RATE
	default 115200
config UART_NS16550_PORT_0_CLK_FREQ
	default 120000000
config UART_NS16550_PORT_0_OPTIONS
	default 0
config UART_NS16550_PORT_0_DLF
	default 0x02

endif # UART_NS16550_PORT_0

config UART_NS16550_PORT_1
        def_bool n

if UART_NS16550_PORT_1

config UART_NS16550_PORT_1_NAME
	default "UART_1"
config UART_NS16550_PORT_1_BASE_ADDR
	default 0xB0020800
config UART_NS16550_PORT_1_IRQ
	default 97
config UART_NS16550_PORT_1_IRQ_PRI
	default 1
config UART_NS16550_PORT_1_BAUD_RATE
	default 115200
config UART_NS16550_PORT_1_CLK_FREQ
	default 120000000
config UART_NS16550_PORT_1_OPTIONS
	default 0
config UART_NS16550_PORT_1_DLF
	default 0x02

endif # UART_NS16550_PORT_1

endif # UART_NS16550


config KERNEL_INIT_PRIORITY_DEFAULT
	default 40

config KERNEL_INIT_PRIORITY_DEVICE
	default 50

config UART_CONSOLE_PRIORITY
	default 60

endif #SOC_QUARK_ATP2_SS
```

## arch/arc/soc/quark_se2_ss/Kconfig.defconfig
```kconfig
#
# Copyright (c) 2014 Wind River Systems, Inc.
# Copyright (c) 2015-2016 Intel Corporation
#
# Licensed under the Apache License, Version 2.0 (the "License");
# you may not use this file except in compliance with the License.
# You may obtain a copy of the License at
#
#     http://www.apache.org/licenses/LICENSE-2.0
#
# Unless required by applicable law or agreed to in writing, software
# distributed under the License is distributed on an "AS IS" BASIS,
# WITHOUT WARRANTIES OR CONDITIONS OF ANY KIND, either express or implied.
# See the License for the specific language governing permissions and
# limitations under the License.
#

if SOC_QUARK_SE2_SS

config HW_EXPECT_IVT_RAM_ADDR
	prompt "Arc expected IVT RAM address"
	hex
	default 0xA803FC00

config SOC
	default quark_se2_ss

config NUM_IRQ_PRIO_LEVELS
	# This processor supports only 2 priority levels:
	# 0 for Fast Interrupts (FIRQs) and 1 for Regular Interrupts (IRQs).
	default 2

config NUM_REGULAR_IRQ_PRIO_LEVELS
	# This processor supports only 1 Regular Interrupt priority level (1).
	default 1

config  NUM_IRQS
	# must be > the highest interrupt number used
	default 116


config	SYS_CLOCK_HW_CYCLES_PER_SEC
	default 120000000

config SRAM_BASE_ADDRESS
	default 0x4000 if NSIM
	default 0xa8020000

config SRAM_SIZE
	default 16 if NSIM
	default 127

config FLASH_BASE_ADDRESS
	default 0x400E8000

config FLASH_SIZE
	default 896

config DCCM_BASE_ADDRESS
	default 0x80000000

config DCCM_SIZE
	default 32

if UART_NS16550

config UART_NS16550_DLF
	def_bool y

config UART_NS16550_PORT_0
	def_bool y

if UART_NS16550_PORT_0

config UART_NS16550_PORT_0_NAME
	default "UART_0"
config UART_NS16550_PORT_0_IRQ_PRI
	default 1
config UART_NS16550_PORT_0_BAUD_RATE
	default 115200
config UART_NS16550_PORT_0_OPTIONS
	default 0
config UART_NS16550_PORT_0_DLF
	default 0x02

endif # UART_NS16550_PORT_0

config UART_NS16550_PORT_1
	def_bool n

if UART_NS16550_PORT_1

config UART_NS16550_PORT_1_NAME
	default "UART_1"
config UART_NS16550_PORT_1_IRQ_PRI
	default 1
config UART_NS16550_PORT_1_BAUD_RATE
	default 115200
config UART_NS16550_PORT_1_OPTIONS
	default 0
config UART_NS16550_PORT_1_DLF
	default 0x02

endif # UART_NS16550_PORT_1

endif # UART_NS16550

config KERNEL_INIT_PRIORITY_DEFAULT
	default 40

config KERNEL_INIT_PRIORITY_DEVICE
	default 50

endif #SOC_QUARK_SE2_SS
```

## arch/x86/atlas_peak-x86/Kconfig
```kconfig
# bsp.kconf - Atlas Peak BSP configuration options

# Copyright (c) 2014 Wind River Systems, Inc.
#
# The right to copy, distribute, modify or otherwise make use
# of this software may be licensed only pursuant to the terms
# of an applicable Wind River license agreement.

#
# modification history
# --------------------
# 25sep14,kdn  ported Quark configuration to Atlas Peak
#

# This BSP-specific file must do the following:
#
# 1) Define any configuration options that are unique to this BSP. At a minimum,
#    a hidden option of the form BSP_<name> must be defined.
# 2) Select any generic Intel architecture configuration options that apply
#    to this BSP, if they are not selected by default.
# 3) Provide a default value for any generic Intel architecture configuration
#    options that apply to this BSP, if no generic default value is defined
#    or if the generic default value is not appropriate.
# 4) Source the generic Intel architecture configuration options.

config BSP_DIR
        string
        default atlas_peak-x86
        help
        This option holds the directory name used by sysgen to identify
        the location of the config1p.vpf file and is used by the build system
        to locate the correct linker file.


config  LOAPIC_TIMER_FREQ
        default 32000000

config	SYS_CLOCK_HW_CYCLES_PER_SEC
	default 32000000

config  PHYS_LOAD_ADDR
	default 0x40010000 if XIP
	default 0xA8000000 if !XIP
menu "Serial Ports"

config EXTRA_SERIAL_PORT
        bool "Extra serial port"
        default n
        help
        This option signifies the number of serial ports the target has.

config SERIAL_INTERRUPT_LEVEL
        bool "Serial interrupt level"
        depends on IOAPIC && EXTRA_SERIAL_PORT
        default y
        help
        Option signifies that the serial controller uses level interrupts
        instead of edge

config SERIAL_INTERRUPT_LOW
        bool "Serial interrupt low"
        depends on IOAPIC && EXTRA_SERIAL_PORT
        default n
        help
        Option signifies that the serial controller uses low level interrupts
        instead of high

endmenu
```

## arch/x86/configs/micro_atlas_peak-x86_defconfig
```kconfig
CONFIG_X86_32=y
CONFIG_MICROKERNEL=y
CONFIG_PLATFORM_ATLASPEAK_X86=y
CONFIG_CPU_MINUTEIA=y
CONFIG_BOARD_CTB=y
CONFIG_CONSOLE=y
CONFIG_UART_CONSOLE=y
CONFIG_SERIAL=y
CONFIG_NS16550=y
```

## arch/x86/configs/nano_quark_se-x86_defconfig
```kconfig
CONFIG_X86_32=y
CONFIG_NANOKERNEL=y
CONFIG_PLATFORM_QUARK_SE_X86=y
CONFIG_CPU_MINUTEIA=y
CONFIG_BOARD_CTB=y
CONFIG_CONSOLE=y
CONFIG_UART_CONSOLE=y
CONFIG_SERIAL=y
CONFIG_NS16550=y
CONFIG_IPI=y
CONFIG_IPI_ATP=y
CONFIG_IPI_CONSOLE_RECEIVER=y
```

## arch/x86/platforms/atlas_peak-x86/Kconfig
```kconfig
# Kconfig - atlas peak configuration options

#
# Copyright (c) 2015 Intel Corp.
#
# Redistribution and use in source and binary forms, with or without
# modification, are permitted provided that the following conditions are met:
#
# 1) Redistributions of source code must retain the above copyright notice,
# this list of conditions and the following disclaimer.
#
# 2) Redistributions in binary form must reproduce the above copyright notice,
# this list of conditions and the following disclaimer in the documentation
# and/or other materials provided with the distribution.
#
# 3) Neither the name of Wind River Systems nor the names of its contributors
# may be used to endorse or promote products derived from this software without
# specific prior written permission.
#
# THIS SOFTWARE IS PROVIDED BY THE COPYRIGHT HOLDERS AND CONTRIBUTORS "AS IS"
# AND ANY EXPRESS OR IMPLIED WARRANTIES, INCLUDING, BUT NOT LIMITED TO, THE
# IMPLIED WARRANTIES OF MERCHANTABILITY AND FITNESS FOR A PARTICULAR PURPOSE
# ARE DISCLAIMED. IN NO EVENT SHALL THE COPYRIGHT HOLDER OR CONTRIBUTORS BE
# LIABLE FOR ANY DIRECT, INDIRECT, INCIDENTAL, SPECIAL, EXEMPLARY, OR
# CONSEQUENTIAL DAMAGES (INCLUDING, BUT NOT LIMITED TO, PROCUREMENT OF
# SUBSTITUTE GOODS OR SERVICES; LOSS OF USE, DATA, OR PROFITS; OR BUSINESS
# INTERRUPTION) HOWEVER CAUSED AND ON ANY THEORY OF LIABILITY, WHETHER IN
# CONTRACT, STRICT LIABILITY, OR TORT (INCLUDING NEGLIGENCE OR OTHERWISE)
# ARISING IN ANY WAY OUT OF THE USE OF THIS SOFTWARE, EVEN IF ADVISED OF THE
# POSSIBILITY OF SUCH DAMAGE.
#

config PLATFORM
        string
        default atlas_peak-x86
        help
        This option holds the directory name used by the build system to locate
        the correct linker file.

choice
        prompt "Board Type"
        depends on PLATFORM_ATLASPEAK_X86
        default BOARD_CTB

        config BOARD_CTB
        bool "CTB - Curie Platform"

        config BOARD_APP
        bool "APP - Atlas Peak Platform"

        config BOARD_AAE
        bool "AAE - AtlasPeak AtlasEdge"
endchoice

config  LOAPIC_TIMER_FREQ
        default 32000000

config	SYS_CLOCK_HW_CYCLES_PER_SEC
	default 32000000

config  PHYS_LOAD_ADDR
	default 0x40030000 if XIP
	default 0xA8000000 if !XIP

config IOAPIC_NUM_RTES
	default 64

config LOAPIC_TIMER_IRQ
	default 64

config PINMUX_BASE
        default 0xB0800930
	depends on PINMUX

config PINMUX_NUM_PINS
	default 69
	depends on PINMUX

config DW_AIO_COMPARATOR_BASE_ADDR
	hex
	depends on DW_AIO_COMPARATOR
	default 0xb0800300

config ARC_INIT
	bool "Atlas Peak ARC Kickoff"
	default n
	help
	Allows x86 processor to kickoff the ARC slave processor.

config ARC_INIT_DEBUG
	bool "Allows the usage of GDB with the ARC processor."
	depends on ARC_INIT
	default n
	help
	This option will stop the master processor from kicking-off
	the ARC slave processor. This will allow GDB to halt an
	engage the ARC processor.

menu "Platform clocking"
config  CLOCK_CONTROL_ATP
	bool
	prompt "AtlasPeak Clock controller support"
	depends on CLOCK_CONTROL && PLATFORM_ATLASPEAK_X86
	default n
	help
	  Enable support for the AtlasPeak clock driver.

config  CLOCK_CONTROL_ATP_PERIPHERAL
	bool
	prompt "AtlasPeak peripheral clock support"
	depends on CLOCK_CONTROL_ATP
	default n
	help
	  Enable support for AtlasPeak peripheral clock which controls the
	  clock of ATP's I2C, SPI, GPIO controllers and more.

config  CLOCK_CONTROL_ATP_PERIPHERAL_DRV_NAME
	string
	prompt "AtlasPeak peripheral clock device name"
	depends on CLOCK_CONTROL_ATP_PERIPHERAL
	default "atp_clock_peripheral"

config  CLOCK_CONTROL_ATP_EXTERNAL
	bool
	prompt "AtlasPeak external clock support"
	depends on CLOCK_CONTROL_ATP
	default n
	help
	  Enable support for AtlasPeak external sub-system clock.

config  CLOCK_CONTROL_ATP_EXTERNAL_DRV_NAME
	string
	prompt "AtlasPeak external clock device name"
	depends on CLOCK_CONTROL_ATP_PERIPHERAL
	default "atp_clock_external"

config  CLOCK_CONTROL_ATP_SENSOR
	bool
	prompt "AtlasPeak sensor clock support"
	depends on CLOCK_CONTROL_ATP
	default n
	help
	  Enable support for AtlasPeak sensor sub-system clock.

config  CLOCK_CONTROL_ATP_SENSOR_DRV_NAME
	string
	prompt "AtlasPeak sensor clock device name"
	depends on CLOCK_CONTROL_ATP_PERIPHERAL
	default "atp_clock_sensor"

endmenu
```
