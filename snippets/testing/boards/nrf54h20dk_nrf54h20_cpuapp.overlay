/*
 * Copyright (c) 2024 Nordic Semiconductor ASA
 *
 * SPDX-License-Identifier: Apache-2.0
 */
#include "nrf54h20dk_nrf54h20_common.dtsi"

&spi130 {
	memory-regions = <&cpuapp_dma_region>;
};

&dut {
	memory-regions = <&cpuapp_dma_region>;
};

&dut2 {
	status = "okay";
	memory-regions = <&dma_fast_region>;
};

&dma_fast_region {
	status = "okay";
};
