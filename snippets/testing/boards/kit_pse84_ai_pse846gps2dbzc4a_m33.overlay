/*
 * Copyright (c) 2026 Infineon Technologies AG,
 * or an affiliate of Infineon Technologies AG.
 *
 * SPDX-License-Identifier: Apache-2.0
 */

tst_dma0: &dma0 {
	status = "okay";
};

#include "kit_pse84_ai_common.overlay"

/ {
	resources {
		compatible = "test-gpio-basic-api";
		out-gpios = <&gpio_prt16 2 0>;
		in-gpios = <&gpio_prt16 1 0>;
	};
};

&gpio_prt16 {
	status = "okay";
};
