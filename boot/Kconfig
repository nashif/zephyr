## boot/sample.yaml
```yaml
sample:
  description: Zephyr bootloader build coverage
  name: Zephyr bootloader
common:
  tags: bootloader
  build_only: true
tests:
  sample.bootloader.zephyr:
    platform_allow:
      - nrf52840dk/nrf52840
    integration_platforms:
      - nrf52840dk/nrf52840
  sample.bootloader.zephyr.hash_only:
    platform_allow:
      - nrf52840dk/nrf52840
      - qemu_cortex_m0
    integration_platforms:
      - qemu_cortex_m0
    extra_configs:
      - CONFIG_BOOT_SIGNATURE_TYPE_NONE=y
```

## dts/bindings/cpu/arm,cortex-a8.yaml
```yaml
# Copyright The Zephyr Project Contributors
# SPDX-License-Identifier: Apache-2.0

description: ARM Cortex-A8 CPU

compatible: "arm,cortex-a8"

include: cpu.yaml
```

## dts/bindings/sensor/ams,tsl2561.yaml
```yaml
# Copyright (c) 2023, Gustavo Silva
# SPDX-License-Identifier: Apache-2.0

description: |
    OSRAM ams TSL2561 light sensor.

    Also supports the TSL2563, which has the same registers and lux equation and
    differs in its part number.

compatible: "ams,tsl2561"

include: [sensor-device.yaml, i2c-device.yaml]

properties:
  integration-time:
    type: int
    default: 402
    description: |
      ADC integration time in ms. The default value matches Timing Register's value at power on.
    enum:
      - 13
      - 101
      - 402
  glass-attenuation:
    type: int
    default: 100000
    description: |
      Light attenuation of the glass over the sensor: the reported
      illuminance is multiplied by it. Integer value with 5 decimals; the
      default (1.00000) is for an uncovered sensor. Example: 16 would be
      1600000.

  gain:
    type: int
    default: 16
    description: |
      ADC gain factor. The default value matches Timing Register's value at power on.
    enum:
      - 1
      - 16
```

## dts/bindings/spi/ti,omap2-mcspi.yaml
```yaml
# Copyright The Zephyr Project Contributors
# SPDX-License-Identifier: Apache-2.0

description: |
  TI Multi Channel SPI controller for OMAP2 and OMAP3 SoCs

  The registers start at the module base and the FIFO holds 64 bytes.

compatible: "ti,omap2-mcspi"

include: [spi-controller.yaml, pinctrl-device.yaml]

properties:
  reg:
    required: true

  clock-frequency:
    required: true

  ti,spi-num-cs:
    type: int
    default: 1
    description: |
      Number of chipselects supported by controller

  ti,d1-miso-d0-mosi:
    type: boolean
    description: |
      Sets d0 as MOSI and d1 as MISO if true, vice versa otherwise.
```

## lib/utils/Kconfig
```kconfig
# Copyright (c) 2016 Intel Corporation
# SPDX-License-Identifier: Apache-2.0

menu "Utility Library"

config JSON_LIBRARY
	bool "Build JSON library"
	help
	  Build a minimal JSON parsing/encoding library. Used by sample
	  applications such as the NATS client.

config JSON_LIBRARY_FP_SUPPORT
	bool "Floating point support in JSON library"
	depends on JSON_LIBRARY
	select CBPRINTF_FP_SUPPORT
	select REQUIRES_FULL_LIBC
	help
	  Build the JSON library with support for floating point types.

	  Requires a libc implementation with support for floating point
	  functions: strtof(), strtod(), isnan() and isinf().

config JSON_FLOAT_PRECISION
	int "Maximum number of decimal places for an encoded float value"
	depends on JSON_LIBRARY_FP_SUPPORT
	default 9
	help
	  Sets the precision value in the printf style format string
	  for a float.

config JSON_DOUBLE_PRECISION
	int "Maximum number of decimal places for an encoded double value"
	depends on JSON_LIBRARY_FP_SUPPORT
	default 16
	help
	  Sets the precision value in the printf style format string
	  for a double.

config RING_BUFFER
	bool "Deprecated claim/finish and item ring buffer APIs"
	default y
	help
	  Keep the deprecated ring_buf_put_claim()/ring_buf_put_finish(),
	  ring_buf_get_claim()/ring_buf_get_finish() and ring_buf_item_*() APIs
	  and the RING_BUF_ITEM_DECLARE*() macros available. They are built on
	  top of ring_buf_put_ptr()/ring_buf_commit() and
	  ring_buf_get_ptr()/ring_buf_consume() and add two index fields to every
	  struct ring_buf. The ring buffer itself is header-only and does not
	  need this option.

	  Disable it to drop the deprecated APIs and the extra fields once no
	  code in the image uses them. The option and the APIs it keeps are
	  scheduled for removal two releases after their deprecation.

config RING_BUFFER_LARGE
	bool "Allow large ring buffer sizes"
	help
	  Increase the maximum buffer size from 32KB to 1GB by using 32-bit
	  instead of 16-bit indices, which makes every struct ring_buf instance
	  4 bytes bigger (8 bytes with RING_BUFFER).

config NOTIFY
	bool "Asynchronous Notifications"
	help
	  Use this API to support async transactions.

config BASE64
	bool "Base64 encoding and decoding"
	help
	  Enable base64 encoding and decoding functionality

config ONOFF
	bool "On-Off Manager"
	select NOTIFY
	help
	  An on-off manager supports an arbitrary number of clients of a
	  service which has a binary state.  Example applications are power
	  rails, clocks, and binary device power management.

config WINSTREAM
	bool "Lockless shared memory window byte stream"
	help
	  Winstream is a byte stream IPC for use in shared memory
	  "windows", generally for transmit to non-Zephyr contexts that
	  can't share Zephyr APIs or data structures.

if WINSTREAM
config WINSTREAM_STDLIB_MEMCOPY
	bool "Use standard memcpy() in winstream"
	help
	  The sys_winstream utility is sometimes used in early boot
	  environments before the standard library is usable.  By
	  default it uses a simple internal bytewise memcpy().  Set
	  this to use the one from the standard library.
endif

config UTF8
	bool "UTF-8 string operation supported"
	help
	  Enable the utf8 API. The API implements functions to specifically
	  handle UTF-8 encoded strings.

config COBS
	bool "Consistent overhead byte stuffing"
	help
	  Enable consistent overhead byte stuffing

config GETOPT
	bool "Getopt library support"
	help
	  This option adds support of the sys_getopt API.

config GETOPT_LONG
	bool "Getopt long library support"
	depends on GETOPT
	help
	  This option adds support of the getopt long.
	  Different shell backends are using their own instance of getopt to
	  not interfere with each other.
	  All not shell threads share one global instance of getopt state, hence
	  apart from shell this library is not thread safe. User can add support
	  for other threads by extending function sys_getopt_state_get in
	  getopt_common.c file.

config TIMEUTIL_APPLY_SKEW
	bool "Support applying clock skew corrections in conversion functions"
	default y
	help
	  Accurately applying clock skew correction in timeutil_sync_ref_from_local
	  and timeutil_sync_local_from_ref requires double-precision floating point
	  operations. If this is the only usage of double precision logic in the
	  build, but clocks skews are not used, this can be a significant ROM
	  overhead. Disabling this option can save ~2.4 kB of ROM.

endmenu
```

## tests/benchmarks/interrupt_latency/testcase.yaml
```yaml
common:
  tags:
    - kernel
    - benchmark
    - interrupt
tests:
  benchmark.kernel.interrupt.latency:
    # FIXME: no DWT on qemu_cortex_m0, no timing support on m2gl025_miv
    platform_exclude:
      - qemu_cortex_m0
      - m2gl025_miv
    filter: CONFIG_PRINTK and not CONFIG_SOC_FAMILY_STM32
    harness: console
    integration_platforms:
      - qemu_cortex_m3
      - qemu_cortex_a53
      - qemu_x86
    harness_config:
      type: one_line
      record:
        regex:
          - "(?P<metric>.*) - (?P<description>.*):(?P<cycles>.*) cycles ,(?P<nanoseconds>.*) ns"
      regex:
        - "PROJECT EXECUTION SUCCESSFUL"

  # Cortex-M has a 24-bit systick, so the default of 1 tick per second
  # is achievable only if the frequency is below 16MHz.
  benchmark.kernel.interrupt.latency.stm32:
    arch_allow: arm
    filter: CONFIG_PRINTK and CONFIG_SOC_FAMILY_STM32
    extra_configs:
      - CONFIG_SYS_CLOCK_TICKS_PER_SEC=20
    harness: console
    harness_config:
      type: one_line
      record:
        regex:
          - "(?P<metric>.*) - (?P<description>.*):(?P<cycles>.*) cycles ,(?P<nanoseconds>.*) ns"
      regex:
        - "PROJECT EXECUTION SUCCESSFUL"

  # Additionally measure the dynamic interrupt connect cost on
  # platforms supporting runtime ISR installation.
  benchmark.kernel.interrupt.latency.dynamic:
    platform_allow:
      - qemu_cortex_m3
      - qemu_cortex_a53
    extra_configs:
      - CONFIG_DYNAMIC_INTERRUPTS=y
    harness: console
    harness_config:
      type: one_line
      record:
        regex:
          - "(?P<metric>.*) - (?P<description>.*):(?P<cycles>.*) cycles ,(?P<nanoseconds>.*) ns"
      regex:
        - "PROJECT EXECUTION SUCCESSFUL"
```

## tests/ztest/benchmark_manual/testcase.yaml
```yaml
common:
  tags:
    - test_framework
    - benchmark
tests:
  testing.ztest.benchmark_manual:
    integration_platforms:
      - qemu_x86
      - qemu_cortex_a53
  testing.ztest.benchmark_manual.csv:
    extra_configs:
      - CONFIG_ZTEST_BENCHMARK_OUTPUT_CSV=y
    integration_platforms:
      - qemu_x86
```
