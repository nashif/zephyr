## CMakeLists.txt
```
# SPDX-License-Identifier: Apache-2.0

cmake_minimum_required(VERSION 3.20.0)

if(BOARD MATCHES "qemu_.*")
    list(APPEND QEMU_EXTRA_FLAGS -serial file:channel0_0)
endif()

find_package(Zephyr REQUIRED HINTS $ENV{ZEPHYR_BASE})
project(hello_world)

target_sources(app PRIVATE src/main.c)
```

## prj.conf
```kconfig
# nothing here
CONFIG_POSIX_CLOCK=y
```

## app.overlay
```dts
/*
 * Copyright (c) 2024 Intel Corporation
 *
 * SPDX-License-Identifier: Apache-2.0
 */

&arduino_serial {
	status = "okay";
	current-speed = <115200>;
};
```

## boards/qemu_x86_64.overlay
```dts
/* SPDX-License-Identifier: Apache-2.0 */

/ {
       chosen {
               zephyr,mctp-uart = &uart1;
       };
};
```

## src/main.c
```c
/*
 * Copyright (c) 2012-2014 Wind River Systems, Inc.
 *
 * SPDX-License-Identifier: Apache-2.0
 */

#include <stdio.h>
#include <assert.h>
#include <unistd.h>
#include <zephyr/types.h>
#include <zephyr/mctp/mctp.h>
#include <zephyr/mctp/mctp-serial.h>

#include <zephyr/logging/log.h>
LOG_MODULE_DECLARE(mctp, CONFIG_MCTP_LOG_LEVEL);

static void rx_message(uint8_t eid, bool tag_owner,
                       uint8_t msg_tag, void *data, void *msg,
                       size_t len)
{
        ssize_t rc;

        rc = write(STDOUT_FILENO, msg, len);
        if (rc < 0) {
                LOG_WRN("Write failed");
	}
        else if ((size_t)rc < len) {
                LOG_WRN("Short write of length %zd, requested %zd", rc, len);
	}
}


int main(void)
{
	printf("Hello World! %s\n", CONFIG_BOARD_TARGET);

	struct mctp_binding_serial *serial;
	struct mctp *mctp;
	int rc;

	mctp = mctp_init();
	assert(mctp != NULL);

	serial = mctp_serial_init();
	assert(serial);

	mctp_register_bus(mctp, mctp_binding_serial_core(serial), 8);

	mctp_set_rx_all(mctp, rx_message, NULL);

        for (;;) {
                rc = mctp_serial_read(serial);
                if (rc) {
                        break;
		}
        }

	return 0;
}
```
