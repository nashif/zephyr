## Kconfig
```
# Copyright (c) 2019 Intel Corporation
# SPDX-License-Identifier: Apache-2.0

config USB_DEVICE_PID
	hex
	default 0x0004

source "Kconfig.zephyr"
```

## sample.yaml
```
sample:
  name: generic tracing framework
tests:
  sample.subsys.debug.tracing:
    platform_whitelist: reel_board sam_e70_xplained
    depends_on: usb_device usb_cdc
    tags: tracing
```

## prj.conf
```kconfig
CONFIG_GPIO=y
CONFIG_THREAD_NAME=y
CONFIG_THREAD_STACK_INFO=y
CONFIG_USB=y
CONFIG_USB_DEVICE_STACK=y
CONFIG_USB_DEVICE_VID=0x2FE9
CONFIG_USB_DEVICE_PRODUCT="Zephyr USB console sample"
CONFIG_USB_UART_CONSOLE=y

CONFIG_UART_INTERRUPT_DRIVEN=y
CONFIG_UART_LINE_CTRL=y
CONFIG_UART_CONSOLE_ON_DEV_NAME="CDC_ACM_0"

CONFIG_USB_UART_DTR_WAIT=y
CONFIG_THREAD_NAME=y
CONFIG_TRACING_CTF=y
CONFIG_TRACING_BACKEND_UART=y
CONFIG_TRACING_CTF_BOTTOM_GENERIC=y
CONFIG_TRACING_HANDLE_HOST_CMD=y
```

## src/main.c
```c
/*
 * Copyright (c) 2019 Intel Corporation.
 *
 * SPDX-License-Identifier: Apache-2.0
 */

#include <zephyr.h>
#include <sys/printk.h>

void main(void)
{
	u8_t count = 0;

	while (1) {
		printk("%c\n", (count++) % 2 ? 'A' : 'B');

		k_sleep(K_SECONDS(2));
	}
}
```
