## tests/kernel/mbox/mbox_usage/testcase.yaml
```yaml
common:
  cases:
    - msg_receiver
    - msg_receiver_unlimited
tests:
  kernel.mailbox:
    tags: kernel
```

## tests/kernel/mem_heap/mheap_api_concept/testcase.yaml
```yaml
common:
  cases:
    - mheap_malloc_free
    - mheap_calloc
    - mheap_malloc_align4
    - mheap_min_block_size
    - mheap_block_desc
tests:
  kernel.memory_heap:
    tags: kernel
```

## tests/kernel/mem_pool/mem_pool/testcase.yaml
```yaml
common:
  cases:
    - pool_block_get
    - pool_block_get_timeout
    - pool_block_get_wait
    - pool_malloc
tests:
  kernel.memory_pool:
    min_ram: 32
    tags: bat_commit core mem_pool
```

## tests/kernel/mem_pool/mem_pool_api/testcase.yaml
```yaml
common:
  cases:
    - mpool_alloc_free_thread
    - mpool_alloc_free_isr
    - mpool_kdefine_extern
    - mpool_alloc_size
    - mpool_alloc_timeout
tests:
  kernel.memory_pool:
    tags: kernel mem_pool
```

## tests/kernel/mem_pool/mem_pool_concept/testcase.yaml
```yaml
common:
  cases:
    - mpool_alloc_wait_prio
    - mpool_alloc_size_roundup
    - mpool_alloc_merge_failed_diff_size
    - mpool_alloc_merge_failed_diff_parent
tests:
  kernel.memory_pool:
    tags: kernel mem_pool
```

## tests/kernel/mem_pool/mem_pool_threadsafe/testcase.yaml
```yaml
common:
  cases:
    - mpool_threadsafe
tests:
  kernel.memory_pool:
    tags: kernel mem_pool
```

## tests/kernel/mem_pool/sys_mem_pool/testcase.yaml
```yaml
common:
  cases:
    - sys_mem_pool_alloc_free
    - sys_mem_pool_alloc_align4
    - sys_mem_pool_min_block_size
tests:
  kernel.sys_mem_pool:
    min_ram: 32
    tags: kernel userspace mem_pool
    cases:
      - sys_mem_pool_alloc_free
      - sys_mem_pool_alloc_align4
      - sys_mem_pool_min_block_size
```

## tests/kernel/mem_protect/app_memory/testcase.yaml
```yaml
tests:
  kernel.memory_protection:
    arch_whitelist: x86 arm arc
    tags: memory_protection
    cases:
      - app_memory
```

## tests/kernel/mem_protect/obj_validation/testcase.yaml
```yaml
common:
  cases:
    - generic_object
tests:
  kernel.memory_protection.obj_validation:
    filter: CONFIG_ARCH_HAS_USERSPACE
    tags: core security userspace
```

## tests/kernel/mem_protect/protection/testcase.yaml
```yaml
tests:
  kernel.memory_protection.protection:
    filter: CONFIG_CPU_HAS_MPU or CONFIG_X86_MMU
    tags: core security ignore_faults
    cases:
      - exec_data
      - exec_stack
      - exec_heap
      - write_ro
      - write_text
```

## tests/kernel/mem_protect/stack_random/testcase.yaml
```yaml
tests:
  kernel.memory_protection.stack_random:
    arch_exclude: posix
    tags: memory_protection
    cases:
      - stack_pt_randomization
```

## tests/kernel/mem_protect/userspace/testcase.yaml
```yaml
common:
  cases:
    - is_usermode
    - write_control
    - disable_mmu_mpu
    - read_kernram
    - write_kernram
    - write_kernro
    - write_kerntext
    - read_kernel_data
    - write_kernel_data
    - read_priv_stack
    - write_priv_stack
    - pass_user_object
    - pass_noperms_object
    - start_kernel_thread
    - read_other_stack
    - write_other_stack
    - revoke_noperms_object
    - access_after_revoke
    - revoke_other_thread
    - write_kobject_user_pipe
tests:
  kernel.memory_protection.userspace:
    filter: CONFIG_ARCH_HAS_USERSPACE
    tags: core security userspace ignore_faults
```

## tests/kernel/mem_protect/x86_mmu_api/testcase.yaml
```yaml
tests:
  kernel.memory_protection.mmu:
    platform_whitelist: qemu_x86
    tags: kernel
    cases:
      - buffer_rw_read
      - buffer_writeable_write
      - buffer_readable_read
      - buffer_readable_write
      - buffer_supervisor_rw
      - buffer_supervisor_w
      - buffer_user_rw_user
      - buffer_user_rw_supervisor
      - multi_page_buffer_user
      - multi_page_buffer_write_user
      - multi_page_buffer_read_user
      - multi_page_buffer_read
      - multi_pde_buffer_rw
      - multi_pde_buffer_writeable_write
      - multi_pde_buffer_readable_read
```

## tests/kernel/mem_slab/mslab_api/testcase.yaml
```yaml
common:
  cases:
    - mslab_kinit
    - mslab_kdefine
    - mslab_kdefine_extern
    - mslab_alloc_free_thread
    - mslab_alloc_align
    - mslab_alloc_timeout
    - mslab_used_get
tests:
  kernel.memory_slabs:
    tags: kernel
```

## tests/kernel/mem_slab/mslab_concept/testcase.yaml
```yaml
common:
  cases:
    - mslab_alloc_wait_prio
tests:
  kernel.memory_slabs:
    tags: kernel
```

## tests/kernel/mem_slab/mslab_threadsafe/testcase.yaml
```yaml
common:
  cases:
    - mslab_threadsafe
tests:
  kernel.memory_slabs:
    tags: kernel
```

## tests/kernel/mp/testcase.yaml
```yaml
common:
  cases:
    - mp_start
tests:
  kernel.multiprocessing:
    platform_whitelist: esp32
```

## tests/kernel/msgq/msgq_api/testcase.yaml
```yaml
common:
  cases:
    - msgq_thread
    - msgq_thread_overflow
    - msgq_isr
    - msgq_put_fail
    - msgq_get_fail
    - msgq_attrs_get
    - msgq_purge_when_put
tests:
  kernel.message_queue:
    tags: kernel userspace
```

## tests/kernel/mutex/mutex/testcase.yaml
```yaml
common:
  cases:
    - mutex
tests:
  kernel.mutex:
    tags: bat_commit core userspace
```

## tests/kernel/mutex/mutex_api/testcase.yaml
```yaml
common:
  cases:
    - mutex_lock_unlock
    - mutex_reent_lock_forever
    - mutex_reent_lock_no_wait
    - mutex_reent_lock_timeout_fail
    - mutex_reent_lock_timeout_pass
tests:
  kernel.mutex:
    tags: kernel
```

## tests/kernel/pending/testcase.yaml
```yaml
common:
  cases:
    - pending
tests:
  kernel.timing:
    min_ram: 16
    tags: core bat_commit
```

## tests/kernel/pipe/pipe/testcase.yaml
```yaml
common:
  cases:
    - pipe_on_single_elements
    - pipe_on_multiple_elements
    - pipe_forever_wait
    - pipe_timeout
    - pipe_get_on_empty_pipe
    - pipe_forever_timeout
    - pipe_get_timeout
tests:
  kernel.pipe:
      tags: kernel userspace
```

## tests/kernel/pipe/pipe_api/testcase.yaml
```yaml
common:
  cases:
    - pipe_thread2thread
    - pipe_put_fail
    - pipe_get_fail
    - pipe_block_put
    - pipe_block_put_sema
    - pipe_get_put
tests:
  kernel.pipe:
      tags: kernel userspace
```

## tests/kernel/poll/testcase.yaml
```yaml
common:
  cases:
    - poll_no_wait
    - poll_wait
    - poll_multi
tests:
  kernel.poll:
    tags: kernel
```

## tests/kernel/profiling/profiling_api/testcase.yaml
```yaml
common:
  cases:
    - call_stacks_analyze_main
    - call_stacks_analyze_idle
    - call_stacks_analyze_workq
tests:
  kernel.profiling:
    arch_exclude: nios2 riscv32
    platform_exclude: em_starterkit
    tags: kernel
```
