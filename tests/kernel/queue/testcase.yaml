## tests/kernel/queue/testcase.yaml
```yaml
common:
  cases:
    - queue_thread2thread
    - queue_thread2isr
    - queue_isr2thread
    - queue_get_2threads
    - queue_get_fail
    - queue_loop
tests:
  kernel.queue:
    tags: kernel
  kernel.queue.poll:
    extra_args: CONF_FILE="prj_poll.conf"
    tags: kernel
```

## tests/kernel/semaphore/sema_api/testcase.yaml
```yaml
common:
  cases:
    - sema_thread2thread
    - sema_thread2isr
    - sema_reset
    - sema_count_get
tests:
  kernel.semaphore:
    tags: kernel userspace
```

## tests/kernel/semaphore/semaphore/testcase.yaml
```yaml
common:
  cases:
    - simple_sem_from_isr
    - simple_sem_from_task
    - sem_take_no_wait
    - sem_take_no_wait_fails
    - sem_take_timeout_fails
    - sem_take_timeout
    - sem_take_timeout_forever
    - sem_take_timeout_isr
    - sem_take_multiple
    - sem_give_take_from_isr
    - sem_multiple_threads_wait
    - sem_measure_timeouts
    - sem_measure_timeout_from_thread
    - sem_multiple_take_and_timeouts
    - sem_multi_take_timeout_diff_sem
tests:
  kernel.semaphore:
    min_ram: 32
    tags: kernel userspace
```

## tests/kernel/smp/testcase.yaml
```yaml
common:
  cases:
    - scheduling
tests:
  kernel.multiprocessing:
    platform_whitelist: esp32
```

## tests/kernel/spinlock/testcase.yaml
```yaml
common:
  cases:
    - spinlock_basic
    - spinlock_bounce
tests:
  kernel.multiprocessing:
    platform_whitelist: esp32
```

## tests/kernel/stack/stack_api/testcase.yaml
```yaml
common:
  cases:
    - stack_thread2thread
    - stack_thread2isr
    - stack_pop_fail
tests:
  kernel.stack:
    tags: kernel userspace
```

## tests/kernel/stack/stack_usage/testcase.yaml
```yaml
common:
  cases:
    - single_stack_play
    - dual_stack_play
    - isr_stack_play
tests:
  kernel.stack.usage:
    tags: kernel userspace
```

## tests/kernel/static_idt/testcase.yaml
```yaml
common:
  cases:
    - idt_stub
    - static_idt
tests:
  arch.interrupt:
    arch_whitelist: x86
    tags: ignore_faults interrupt idt
```

## tests/kernel/systhreads/testcase.yaml
```yaml
common:
  cases:
    - systhreads_main
    - systhreads_idle
tests:
  kernel.threads.sys:
    arch_exclude: nios2 riscv32
    tags: kernel
```

## tests/kernel/threads/custom_data/custom_data_api/testcase.yaml
```yaml
common:
  cases:
    - customdata_get_set_coop
    - customdata_get_set_preempt
tests:
  kernel.threads:
    tags: kernel threads userspace
```

## tests/kernel/threads/lifecycle/lifecycle_api/testcase.yaml
```yaml
common:
  cases:
    - threads_spawn_params
    - threads_spawn_priority
    - threads_spawn_delay
    - threads_spawn_forever
    - thread_start
    - threads_suspend_resume_cooperative
    - threads_suspend_resume_preemptible
    - threads_cancel_undelayed
    - threads_cancel_delayed
    - threads_cancel_started
    - threads_abort_self
    - threads_abort_others
    - threads_abort_repeat
    - abort_handler
    - essential_thread_operation
tests:
  kernel.threads:
    tags: kernel threads userspace
```

## tests/kernel/threads/lifecycle/thread_init/testcase.yaml
```yaml
common:
  cases:
    - kdefine_preempt_thread
    - kdefine_coop_thread
    - kinit_preempt_thread
    - kinit_coop_thread
tests:
  kernel.threads:
    tags: kernel threads userspace
```

## tests/kernel/threads/scheduling/schedule_api/testcase.yaml
```yaml
common:
  cases:
    - priority_cooperative
    - priority_preemptible
    - yield_cooperative
    - sleep_cooperative
    - sleep_wakeup_preemptible
    - time_slicing_preemptible
    - time_slicing_disable_preemptible
    - lock_preemptible
    - unlock_preemptible
    - sched_is_preempt_thread
    - slice_reset
    - slice_scheduling
    - priority_scheduling
tests:
  kernel.threads.scheduling:
    min_ram: 20
    tags: kernel threads sched
```

## tests/kernel/tickless/tickless_concept/testcase.yaml
```yaml
common:
  cases:
    - tickless_sysclock
    - tickless_slice
tests:
  kernel.tickless:
    arch_exclude: riscv32 nios2
    tags: kernel
```

## tests/kernel/timer/timer_api/testcase.yaml
```yaml
common:
  cases:
    - timer_duration_period
    - timer_period_0
    - timer_expirefn_null
    - timer_periodicity
    - timer_status_get
    - timer_status_get_anytime
    - timer_status_sync
    - timer_k_define
    - timer_user_data
tests:
  kernel.timer:
    tags: kernel
  kernel.timer.tickless:
    build_only: true
    extra_args: CONF_FILE="prj_tickless.conf"
    arch_exclude: riscv32 nios2 posix
    tags: kernel
```

## tests/kernel/workq/work_queue/testcase.yaml
```yaml
common:
  cases:
    - sequence
    - resubmit
    - delayed
    - delayed_resubmit
    - delayed_resubmit_thread
    - delayed_cancel
tests:
  kernel.workqueue:
    tags: core bat_commit
  kernel.workqueue.poll:
    tags: core bat_commit
    extra_configs:
      - CONFIG_POLL=y
```

## tests/kernel/workq/work_queue_api/testcase.yaml
```yaml
common:
  cases:
    - workq_start_before_submit
    - work_submit_to_multipleq
    - work_resubmit_to_queue
    - work_submit_to_queue_thread
    - work_submit_to_queue_isr
    - work_submit_thread
    - work_submit_isr
    - delayed_work_submit_to_queue_thread
    - delayed_work_submit_to_queue_isr
    - delayed_work_submit_thread
    - delayed_work_submit_isr
    - delayed_work_cancel_from_queue_thread
    - delayed_work_cancel_from_queue_isr
    - delayed_work_cancel_thread
    - delayed_work_cancel_isr
tests:
  kernel.workqueue:
    tags: kernel
```

## tests/lib/base64/testcase.yaml
```yaml
common:
  cases:
    - base64_codec
tests:
  libraries.encoding:
    tags: base64
```

## tests/lib/c_lib/testcase.yaml
```yaml
common:
  cases:
    - limits
    - stdbool
    - stddef
    - stdint
    - memcmp
    - strchr
    - strcpy
    - strncpy
    - memset
    - strlen
    - strcmp
tests:
  libraries.libc:
    tags: clib
```

## tests/lib/json/testcase.yaml
```yaml
common:
  cases:
    - json_encoding
    - json_decoding
    - json_obj_arr_encoding
    - json_obj_arr_decoding
    - json_invalid_unicode
    - json_missing_quote
    - json_wrong_token
    - json_item_wrong_type
    - json_key_not_in_descr
    - json_escape
    - json_escape_one
    - json_escape_empty
    - json_escape_no_op
    - json_escape_bounds_check
tests:
  libraries.encoding:
    filter: not CONFIG_NEWLIB_LIBC
    tags: json
```

## tests/lib/rbtree/testcase.yaml
```yaml
common:
  cases:
    - rbtree_spam
tests:
  libraries.data_structures.rbtree:
    tags: rbtree
```

## tests/lib/ringbuffer/testcase.yaml
```yaml
common:
  cases:
    - ringbuffer_init/*keep
    - init
    - first!*/
    - ringbuffer_declare_pow2
    - ringbuffer_declare_size
    - ringbuffer_put_get_thread
    - ringbuffer_put_get_isr
    - ringbuffer_put_get_thread_isr
    - ringbuffer_pow2_put_get_thread_isr
    - ringbuffer_size_put_get_thread_isr
    - ring_buffer_main_test
tests:
  libraries.ringbuffer:
    tags: ring_buffer circular_buffer
```
