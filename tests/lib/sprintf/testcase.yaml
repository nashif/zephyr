## tests/lib/sprintf/testcase.yaml
```yaml
common:
  cases:
    - sprintf_double
    - sprintf_integer
    - vsprintf
    - vsnprintf
    - sprintf_string
    - sprintf_misc
tests:
  libraries.libc:
    tags: libc
```

## tests/net/app/testcase.yaml
```yaml
common:
  depends_on: netif
  cases:
    - iface_setup
    - app_init
    - app_udp_server_init
    - app_tcp_server_init
    - app_udp_server_listen
    - app_tcp_server_listen
    - app_tcp6_client_peer
    - app_udp6_client_peer
    - app_tcp4_client_peer
    - app_udp4_client_peer
    - app_tcp6_client_peer_with_port
    - app_tcp4_client_peer_with_port
    - app_udp6_client_peer_with_port
    - app_udp4_client_peer_with_port
    - app_tcp6_client_peer_addr
    - app_tcp4_client_peer_addr
    - app_udp6_client_peer_addr
    - app_udp4_client_peer_addr
    - app_tcp6_client_hostname_fail
    - app_tcp4_client_hostname_fail
    - app_udp6_client_hostname_fail
    - app_udp4_client_hostname_fail
    - app_tcp6_client_hostname
    - app_tcp4_client_hostname
    - app_udp6_client_hostname
    - app_udp4_client_hostname
    - app_close_server
tests:
  net.app:
    min_ram: 32
    tags: net
  net.app.no-ipv4:
    extra_args: CONF_FILE=prj-no-ipv4.conf
    min_ram: 32
    tags: net
  net.app.no-ipv6:
    extra_args: CONF_FILE=prj-no-ipv6.conf
    min_ram: 32
    tags: net
  net.app.with-dns:
    extra_args: CONF_FILE=prj-with-dns.conf
    min_ram: 32
    tags: net dns
```

## tests/net/arp/testcase.yaml
```yaml
common:
  depends_on: netif
  cases:
    - run_tests
tests:
  net.arp:
    min_ram: 16
    tags: net arp
```

## tests/net/buf/testcase.yaml
```yaml
common:
  cases:
    - net_buf_test_1
    - net_buf_test_2
    - net_buf_test_3
    - net_buf_test_4
    - net_buf_test_big_buf
    - net_buf_test_multi_frags
    - net_buf_test_clone
    - net_buf_test_fixed_pool
    - net_buf_test_var_pool
tests:
  net.buf:
    min_ram: 16
    tags: net buf
```

## tests/net/checksum_offload/testcase.yaml
```yaml
common:
  depends_on: netif
  cases:
    - eth_setup
    - address_setup
    - tx_chksum_offload_disabled_test_v6
    - tx_chksum_offload_disabled_test_v4
    - tx_chksum_offload_enabled_test_v6
    - tx_chksum_offload_enabled_test_v4
    - rx_chksum_offload_disabled_test_v6
    - rx_chksum_offload_disabled_test_v4
    - rx_chksum_offload_enabled_test_v6
    - rx_chksum_offload_enabled_test_v4
tests:
  net.offload:
    min_ram: 16
    tags: net checksum_offload
```

## tests/net/context/testcase.yaml
```yaml
common:
  depends_on: netif
  cases:
    - init
    - net_ctx_get_fail
    - net_ctx_get_all
    - net_ctx_get_success
    - net_ctx_create
    - net_ctx_bind_fail
    - net_ctx_bind_uni_success_v6
    - net_ctx_bind_uni_success_v4
    - net_ctx_bind_mcast_success
    - net_ctx_listen_v6
    - net_ctx_listen_v4
    - net_ctx_connect_v6
    - net_ctx_connect_v4
    - net_ctx_accept_v6
    - net_ctx_accept_v4
    - net_ctx_send_v6
    - net_ctx_send_v4
    - net_ctx_sendto_v6
    - net_ctx_sendto_v4
    - net_ctx_recv_v6
    - net_ctx_recv_v4
    - net_ctx_recv_v6_fail
    - net_ctx_recv_v4_fail
    - net_ctx_recv_v6_again
    - net_ctx_recv_v4_again
    - net_ctx_recv_v6_reconfig
    - net_ctx_recv_v4_reconfig
    - net_ctx_recv_v6_timeout
    - net_ctx_recv_v4_timeout
    - net_ctx_recv_v6_timeout_forever
    - net_ctx_recv_v4_timeout_forever
    - net_ctx_put
tests:
  net.context:
    min_ram: 16
    tags: net
```

## tests/net/dhcpv4/testcase.yaml
```yaml
common:
  depends_on: netif
  cases:
    - dhcp
tests:
  net.dhcp:
    tags: net dhcpv4
```

## tests/net/ethernet_mgmt/testcase.yaml
```yaml
common:
  depends_on: netif
  cases:
    - change_mac_when_up
    - change_mac_when_down
    - change_auto_neg
    - change_to_same_auto_neg
    - change_link
    - change_same_link
    - change_unsupported_link
    - change_duplex
    - change_same_duplex
tests:
  net.ethernet_mgmt:
    min_ram: 32
    tags: net ethernet_mgmt
```

## tests/net/icmpv6/testcase.yaml
```yaml
common:
  cases:
    - run_tests
tests:
  net.icmpv6:
    min_ram: 16
    tags: net icmpv6
```

## tests/net/ieee802154/l2/testcase.yaml
```yaml
common:
  cases:
    - init
    - parsing_ns_pkt
    - sending_ns_pkt
    - parsing_ack_pkt
    - replying_ack_pkt
    - parsing_beacon_pkt
    - parsing_sec_data_pkt
tests:
  net.ieee802154.l2:
    min_ram: 16
    tags: net ieee802154 l2
    depends_on: ieee802154
```

## tests/net/iface/testcase.yaml
```yaml
common:
  cases:
    - iface_setup
    - send_iface1
    - send_iface2
    - send_iface3
    - send_iface1_down
    - send_iface1_up
tests:
  net.iface:
    min_ram: 16
    tags: net iface
    depends_on: netif
```

## tests/net/ip-addr/testcase.yaml
```yaml
common:
  depends_on: netif
  cases:
    - run_tests
tests:
  net.ip-addr:
    min_ram: 16
    tags: net ip-addr
```

## tests/net/ipv6_fragment/testcase.yaml
```yaml
common:
  depends_on: netif
  cases:
    - setup
    - find_last_ipv6_fragment_udp
    - find_last_ipv6_fragment_hbho_udp
    - find_last_ipv6_fragment_hbho_frag
    - send_ipv6_fragment
    - recv_ipv6_fragment
tests:
  net.ipv6.fragment:
    tags: net ipv6 fragment
```

## tests/net/lib/dns_packet/testcase.yaml
```yaml
common:
  depends_on: netif
  cases:
    - dns_query
    - dns_response
tests:
  net.dns:
    min_ram: 16
    tags: dns net
    timeout: 200
```

## tests/net/lib/dns_resolve/testcase.yaml
```yaml
common:
  cases:
    - init
    - dns_query_invalid_timeout
    - dns_query_invalid_context
    - dns_query_invalid_callback
    - dns_query_invalid_query
    - dns_query_too_many
    - dns_query_server_count
    - dns_query_ipv4_server_count
    - dns_query_ipv6_server_count
    - dns_query_ipv4_timeout
    - dns_query_ipv6_timeout
    - dns_query_ipv4_cancel
    - dns_query_ipv6_cancel
    - dns_query_ipv4
    - dns_query_ipv6
    - dns_query_ipv4_numeric
    - dns_query_ipv6_numeric
  tags: dns net
  depends_on: netif
tests:
  net.dns:
    min_ram: 21
    timeout: 600
  net.dns.no_ipv6:
    extra_args: CONF_FILE=prj-no-ipv6.conf
    min_ram: 16
    timeout: 600
```

## tests/net/lib/http_header_fields/testcase.yaml
```yaml
common:
  cases:
    - http_header_fields
  tags: http net
  depends_on: netif
tests:
  net.http:
    min_ram: 16
```

## tests/net/lib/mqtt_packet/testcase.yaml
```yaml
common:
  depends_on: netif
  cases:
    - run_tests
tests:
  net.mqtt.packet:
    min_ram: 16
    tags: mqtt net
```

## tests/net/lib/mqtt_publisher/testcase.yaml
```yaml
common:
  cases:
    - mqtt_init
    - mqtt_connect
    - mqtt_pingreq
    - mqtt_publish
    - mqtt_disconnect
common:
  tags: net mqtt
  harness: net
  depends_on: netif
tests:
  net.mqtt:
    min_ram: 16
  net.mqtt.tls:
    platform_whitelist: frdm_k64f qemu_x86
    extra_args: CONF_FILE="prj_tls.conf"
```

## tests/net/lib/mqtt_subscriber/testcase.yaml
```yaml
common:
  cases:
    - mqtt_init
    - mqtt_connect
    - mqtt_subscribe
    - mqtt_unsubscribe
    - mqtt_disconnect
tests:
  net.mqtt.subscriber:
    min_ram: 16
    tags: net mqtt
    harness: net
    depends_on: netif
```

## tests/net/mgmt/testcase.yaml
```yaml
common:
  depends_on: netif
  cases:
    - mgmt
tests:
  net.management:
    min_ram: 16
    tags: net mgmt
```

## tests/net/mld/testcase.yaml
```yaml
common:
  depends_on: netif
  cases:
    - mld_setup
    - join_group
    - leave_group
    - catch_join_group
    - catch_leave_group
    - verify_join_group
    - verify_leave_group
    - catch_query
    - verify_send_report
    - allnodes
    - solicit_node
tests:
  net.mld:
    tags: net mld
```

## tests/net/neighbor/testcase.yaml
```yaml
common:
  depends_on: netif
  cases:
    - neighbor
tests:
  net.neighbour:
    min_ram: 16
    tags: net neighbour
```

## tests/net/net_pkt/testcase.yaml
```yaml
common:
  depends_on: netif
  cases:
    - ipv6_multi_frags
    - fragment_copy
    - pkt_read_append
    - pkt_read_write_insert
    - fragment_compact
    - fragment_split
tests:
  net.packet:
    min_ram: 20
    tags: net
```

## tests/net/route/testcase.yaml
```yaml
common:
  depends_on: netif
  cases:
    - init
    - net_ctx_create
    - populate_nbr_cache
    - route_add
    - route_update
    - route_get_nexthop
    - route_lookup_ok
    - route_lookup_fail
    - route_del
    - route_add
    - route_del_nexthop
    - route_del_again
    - route_del_nexthop_again
    - populate_nbr_cache
    - route_add_many
    - route_del_many
tests:
  net.route:
    min_ram: 16
    tags: net route
```
