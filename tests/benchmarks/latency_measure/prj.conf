## prj.conf
```kconfig
CONFIG_TEST=y
# needed for printf output sent to console
CONFIG_STDOUT_CONSOLE=y

# eliminate timer interrupts during the benchmark
CONFIG_SYS_CLOCK_TICKS_PER_SEC=1
CONFIG_TICKLESS_KERNEL=n

# We use irq_offload(), enable it
CONFIG_IRQ_OFFLOAD=y

# Reduce memory/code footprint
CONFIG_BT=n
CONFIG_FORCE_NO_ASSERT=y

CONFIG_TEST_HW_STACK_PROTECTION=n
CONFIG_COVERAGE=n

# Disable system power management
CONFIG_SYS_POWER_MANAGEMENT=n

# Can only run under 1 CPU
CONFIG_MP_NUM_CPUS=1
CONFIG_TIMING_FUNCTIONS=y
```

## src/main.c
```c
/*
 * Copyright (c) 2012-2015 Wind River Systems, Inc.
 *
 * SPDX-License-Identifier: Apache-2.0
 */

/*
 * @file
 * This file contains the main testing module that invokes all the tests.
 */

#include <timestamp.h>
#include "utils.h"
#include <tc_util.h>
#include "timing_info.h"

#define STACK_SIZE (1024 + CONFIG_TEST_EXTRA_STACKSIZE)

uint32_t tm_off;        /* time necessary to read the time */
int error_count;        /* track number of errors */


extern void thread_switch_yield(void);
extern void int_to_thread(void);
extern void int_to_thread_evt(void);
extern void sema_lock_unlock(void);
extern void mutex_lock_unlock(void);
extern int coop_ctx_switch(void);
void test_thread(void *arg1, void *arg2, void *arg3)
{
	PRINT_BANNER();
	PRINT_TIME_BANNER();

	bench_test_init();
	timing_init();

	int_to_thread();
	print_dash_line();

	int_to_thread_evt();
	print_dash_line();

	sema_lock_unlock();
	print_dash_line();

	mutex_lock_unlock();
	print_dash_line();

	thread_switch_yield();
	print_dash_line();

	coop_ctx_switch();
	print_dash_line();

	TC_END_REPORT(error_count);
}

K_THREAD_DEFINE(tt_id, STACK_SIZE,
		test_thread, NULL, NULL, NULL,
		10, 0, 0);


void main(void)
{
}
```

## src/coop_ctx_switch.c
```c
/*
 * Copyright (c) 2012-2014 Wind River Systems, Inc.
 *
 * SPDX-License-Identifier: Apache-2.0
 */

/**
 * @file
 *
 * @brief Measure context switch time between cooperative threads
 *
 * This file contains thread (coop) context switch time measurement.
 * The thread starts two cooperative thread. One thread waits on a semaphore. The other,
 * after starting, releases a semaphore which enable the first thread to run.
 * Each thread increases a common global counter and context switch back and
 * forth by yielding the cpu. When counter reaches the maximal value, threads
 * stop and the average time of context switch is displayed.
 */
#include <kernel.h>
#include <timing/timing.h>
#include "utils.h"
#include "timing_info.h"

/* number of context switches */
#define NCTXSWITCH   10000
#ifndef STACKSIZE
#define STACKSIZE    (512 + CONFIG_TEST_EXTRA_STACKSIZE)
#endif

/* stack used by the threads */
static K_THREAD_STACK_DEFINE(thread_one_stack, STACKSIZE);
static K_THREAD_STACK_DEFINE(thread_two_stack, STACKSIZE);
static struct k_thread thread_one_data;
static struct k_thread thread_two_data;

static uint32_t timestamp_start;
static uint32_t timestamp_end;

/* context switches counter */
static volatile uint32_t ctx_switch_counter;

/* context switch balancer. Incremented by one thread, decremented by another*/
static volatile int ctx_switch_balancer;

K_SEM_DEFINE(sync_sema, 0, 1);

/**
 *
 * thread_onne
 *
 * Fiber makes all the test preparations: registers the interrupt handler,
 * gets the first timestamp and invokes the software interrupt.
 *
 * @return N/A
 */
static void thread_one(void)
{
	k_sem_take(&sync_sema, K_FOREVER);

	timestamp_start = timing_counter_get();

	while (ctx_switch_counter < NCTXSWITCH) {
		k_yield();
		ctx_switch_counter++;
		ctx_switch_balancer--;
	}

	timestamp_end = timing_counter_get();
}

/**
 *
 * @brief Check the time when it gets executed after the semaphore
 *
 * Fiber starts, waits on semaphore. When the interrupt handler releases
 * the semaphore, thread  measures the time.
 *
 * @return 0 on success
 */
static void thread_two(void)
{
	k_sem_give(&sync_sema);
	while (ctx_switch_counter < NCTXSWITCH) {
		k_yield();
		ctx_switch_counter++;
		ctx_switch_balancer++;
	}
}

/**
 *
 * @brief The test main function
 *
 * @return 0 on success
 */
int coop_ctx_switch(void)
{
	PRINT_FORMAT(" 6 - Measure average context switch time between threads (coop)");
	ctx_switch_counter = 0U;
	ctx_switch_balancer = 0;

	timing_start();
	bench_test_start();

	k_thread_create(&thread_one_data, thread_one_stack, STACKSIZE,
			(k_thread_entry_t) thread_one, NULL, NULL, NULL,
			6, 0, K_NO_WAIT);
	k_thread_create(&thread_two_data, thread_two_stack, STACKSIZE,
			(k_thread_entry_t) thread_two, NULL, NULL, NULL,
			6, 0, K_NO_WAIT);

	if (ctx_switch_balancer > 3 || ctx_switch_balancer < -3) {
		PRINT_FORMAT(" Balance is %d. FAILED", ctx_switch_balancer);
	} else if (bench_test_end() != 0) {
		error_count++;
		PRINT_OVERFLOW_ERROR();
	} else {
		uint32_t diff;

		diff = TIMING_INFO_GET_DELTA(timestamp_start, timestamp_end);

		PRINT_FORMAT(" Average context switch time is %u tcs = %u"
			     " nsec",
			     diff / ctx_switch_counter,
			     (uint32_t)timing_cycles_to_ns_avg(diff, ctx_switch_counter));
	}

	timing_stop();

	return 0;
}
```

## src/int_to_thread.c
```c
/*
 * Copyright (c) 2012-2014 Wind River Systems, Inc.
 * Copyright (c) 2017 Intel Corporation.
 *
 * SPDX-License-Identifier: Apache-2.0
 */

/**
 * @file
 *
 * @brief Measure time from ISR back to interrupted thread
 *
 * This file contains test that measures time to switch from the interrupt
 * handler back to the interrupted thread.
 */

#include <kernel.h>
#include "utils.h"
#include "timing_info.h"

#include <arch/cpu.h>
#include <irq_offload.h>

static volatile int flag_var;

static uint32_t timestamp_start;
static uint32_t timestamp_end;

/**
 *
 * @brief Test ISR used to measure best case interrupt latency
 *
 * The interrupt handler gets the second timestamp.
 *
 * @return N/A
 */
static void latency_test_isr(void *unused)
{
	ARG_UNUSED(unused);

	flag_var = 1;


	timestamp_start = timing_counter_get();
}

/**
 *
 * @brief Interrupt preparation function
 *
 * Function makes all the test preparations: registers the interrupt handler,
 * gets the first timestamp and invokes the software interrupt.
 *
 * @return N/A
 */
static void make_int(void)
{
	flag_var = 0;
	irq_offload(latency_test_isr, NULL);
	if (flag_var != 1) {
		PRINT_FORMAT(" Flag variable has not changed. FAILED\n");
	} else {

		timestamp_end = timing_counter_get();
	}
}

/**
 *
 * @brief The test main function
 *
 * @return 0 on success
 */
int int_to_thread(void)
{
	uint32_t diff;

	PRINT_FORMAT(" 1 - Measure time to switch from ISR back to"
		     " interrupted thread");
	timing_start();
	TICK_SYNCH();
	make_int();
	if (flag_var == 1) {
		diff = TIMING_INFO_GET_DELTA(timestamp_start, timestamp_end);
		PRINT_FORMAT(" switching time is %u tcs = %u nsec",
			     diff, (uint32_t)timing_cycles_to_ns(diff));
	}
	timing_stop();
	return 0;
}
```

## src/int_to_thread_evt.c
```c
/*
 * Copyright (c) 2012-2014 Wind River Systems, Inc.
 *
 * SPDX-License-Identifier: Apache-2.0
 */

/**
 * @file
 *
 * @brief measure time from ISR to a rescheduled thread
 *
 * This file contains test that measures time to switch from an interrupt
 * handler to executing a thread after rescheduling. In other words, execution
 * after interrupt handler resume in a different thread than the one which got
 * interrupted.
 */

#include <zephyr.h>
#include <irq_offload.h>

#include "utils.h"
#include "timing_info.h"

#include <arch/cpu.h>

static uint32_t timestamp_start;
static uint32_t timestamp_end;
static struct k_work work;

K_SEM_DEFINE(INTSEMA, 0, 1);
K_SEM_DEFINE(WORKSEMA, 0, 1);


/**
 *
 * @brief Test ISR used to measure best case interrupt latency
 *
 * The interrupt handler gets the second timestamp.
 *
 * @return N/A
 */
static void latency_test_isr(void *unused)
{
	ARG_UNUSED(unused);

	k_work_submit(&work);


	timestamp_start = timing_counter_get();
}

static void worker(struct k_work *item)
{
	(void)item;


	timestamp_end = timing_counter_get();

	k_sem_give(&WORKSEMA);
}

/**
 *
 * @brief Software interrupt generating thread
 *
 * Lower priority thread that, when it starts, it waits for a semaphore. When
 * it gets it, released by the main thread, sets up the interrupt handler and
 * generates the software interrupt
 *
 * @return 0 on success
 */
void int_thread(void)
{
	k_sem_take(&INTSEMA, K_FOREVER);
	irq_offload(latency_test_isr, NULL);
	k_thread_suspend(k_current_get());
}


K_THREAD_DEFINE(int_thread_id, 512,
		(k_thread_entry_t) int_thread, NULL, NULL, NULL,
		11, 0, 0);

/**
 *
 * @brief The test main function
 *
 * @return 0 on success
 */
int int_to_thread_evt(void)
{
	uint32_t diff;

	PRINT_FORMAT(" 2 - Measure time from ISR to executing a different thread"
		     " (rescheduled)");
	k_work_init(&work, worker);

	timing_start();
	TICK_SYNCH();
	k_sem_give(&INTSEMA);
	k_sem_take(&WORKSEMA, K_FOREVER);
	timing_stop();

	diff = TIMING_INFO_GET_DELTA(timestamp_start, timestamp_end);

	PRINT_FORMAT(" switch time is %u tcs = %u nsec",
		     diff, (uint32_t)timing_cycles_to_ns(diff));
	return 0;
}
```

## src/sema_lock_release.c
```c
/*
 * Copyright (c) 2012-2015 Wind River Systems, Inc.
 *
 * SPDX-License-Identifier: Apache-2.0
 */

/*
 * @file measure time for sema lock and release
 *
 * This file contains the test that measures semaphore and mutex lock and
 * release time in the kernel. There is no contention on the sema nor the
 * mutex being tested.
 */

#include <zephyr.h>
#include <timing/timing.h>
#include "utils.h"
#include "timing_info.h"

#include <arch/cpu.h>

/* the number of semaphore give/take cycles */
#define N_TEST_SEMA 1000

/* the number of mutex lock/unlock cycles */
#define N_TEST_MUTEX 1000

static uint32_t timestamp_start;
static uint32_t timestamp_end;

K_SEM_DEFINE(lock_unlock_sema, 0, N_TEST_SEMA);
K_MUTEX_DEFINE(TEST_MUTEX);

/**
 *
 * @brief The function tests semaphore lock/unlock time
 *
 * The routine performs unlock the quite amount of semaphores and then
 * acquires them in order to measure the necessary time.
 *
 * @return 0 on success
 */
int sema_lock_unlock(void)
{
	int i;
	uint32_t diff;

	PRINT_FORMAT(" 3 - Measure average time to signal a semaphore then test"
		     " that semaphore");
	bench_test_start();
	timing_start();

	timestamp_start = timing_counter_get();

	for (i = 0; i < N_TEST_SEMA; i++) {
		k_sem_give(&lock_unlock_sema);
	}

	timestamp_end = timing_counter_get();
	timing_stop();

	if (bench_test_end() == 0) {
		diff = TIMING_INFO_GET_DELTA(timestamp_start, timestamp_end);
		PRINT_FORMAT(" Average semaphore signal time %u tcs = %u"
			     " nsec",
			     diff / N_TEST_SEMA,
			     (uint32_t)timing_cycles_to_ns_avg(diff, N_TEST_SEMA));
	} else {
		error_count++;
		PRINT_OVERFLOW_ERROR();
	}

	bench_test_start();
	timing_start();

	timestamp_start = timing_counter_get();

	for (i = 0; i < N_TEST_SEMA; i++) {
		k_sem_take(&lock_unlock_sema, K_FOREVER);
	}

	timestamp_end = timing_counter_get();
	timing_stop();

	if (bench_test_end() == 0) {
		diff = TIMING_INFO_GET_DELTA(timestamp_start, timestamp_end);
		PRINT_FORMAT(" Average semaphore test time %u tcs = %u "
			     "nsec",
			     diff / N_TEST_SEMA,
			     (uint32_t)timing_cycles_to_ns_avg(diff, N_TEST_SEMA));
	} else {
		error_count++;
		PRINT_OVERFLOW_ERROR();
	}
	return 0;
}

/**
 *
 * @brief Test for the multiple mutex lock/unlock time
 *
 * The routine performs multiple mutex locks and then multiple mutex
 * unlocks to measure the necessary time.
 *
 * @return 0 on success
 */
int mutex_lock_unlock(void)
{
	int i;
	uint32_t diff;

	timing_start();
	PRINT_FORMAT(" 4- Measure average time to lock a mutex then"
		     " unlock that mutex");


	timestamp_start = timing_counter_get();

	for (i = 0; i < N_TEST_MUTEX; i++) {
		k_mutex_lock(&TEST_MUTEX, K_FOREVER);
	}

	timestamp_end = timing_counter_get();

	diff = TIMING_INFO_GET_DELTA(timestamp_start, timestamp_end);
	PRINT_FORMAT(" Average time to lock the mutex %u tcs = %u nsec",
		     diff / N_TEST_MUTEX,
		     (uint32_t)timing_cycles_to_ns_avg(diff, N_TEST_MUTEX));

	timestamp_start = timing_counter_get();

	for (i = 0; i < N_TEST_MUTEX; i++) {
		k_mutex_unlock(&TEST_MUTEX);
	}

	timestamp_end = timing_counter_get();

	diff = TIMING_INFO_GET_DELTA(timestamp_start, timestamp_end);
	PRINT_FORMAT(" Average time to unlock the mutex %u tcs = %u nsec",
		     diff / N_TEST_MUTEX,
		     (uint32_t)timing_cycles_to_ns_avg(diff, N_TEST_MUTEX));
	timing_stop();
	return 0;
}
```

## src/thread_switch_yield.c
```c
/*
 * Copyright (c) 2012-2014 Wind River Systems, Inc.
 *
 * SPDX-License-Identifier: Apache-2.0
 */

/**
 * @file
 * This file contains the benchmark that measure the average time it takes to
 * do context switches between threads using k_yield () to force
 * context switch.
 */

#include <zephyr.h>
#include <timing/timing.h>
#include <stdlib.h>
#include "timestamp.h"
#include "utils.h"      /* PRINT () and other macros */
#include "timing_info.h"

/* context switch enough time so our measurement is precise */
#define NB_OF_YIELD     1000

static uint32_t helper_thread_iterations;

#define Y_STACK_SIZE    (512 + CONFIG_TEST_EXTRA_STACKSIZE)
#define Y_PRIORITY      10

K_THREAD_STACK_DEFINE(y_stack_area, Y_STACK_SIZE);
static struct k_thread y_thread;

/**
 *
 * @brief Helper thread for measuring thread switch latency using yield
 *
 * @return N/A
 */
void yielding_thread(void *arg1, void *arg2, void *arg3)
{
	while (helper_thread_iterations < NB_OF_YIELD) {
		k_yield();
		helper_thread_iterations++;
	}
}

/**
 *
 * @brief Entry point for thread context switch using yield test
 *
 * @return N/A
 */
void thread_switch_yield(void)
{
	uint32_t iterations = 0U;
	int32_t delta;
	uint32_t timestamp_start;
	uint32_t timestamp_end;
	uint32_t ts_diff;

	PRINT_FORMAT(" 5 - Measure average context switch time between threads"
		     " using (k_yield)");

	timing_start();
	bench_test_start();

	/* launch helper thread of the same priority than this routine */
	k_thread_create(&y_thread, y_stack_area, Y_STACK_SIZE,
			yielding_thread, NULL, NULL, NULL,
			Y_PRIORITY, 0, K_NO_WAIT);

	/* get initial timestamp */

	timestamp_start = timing_counter_get();

	/* loop until either helper or this routine reaches number of yields */
	while (iterations < NB_OF_YIELD &&
	       helper_thread_iterations < NB_OF_YIELD) {
		k_yield();
		iterations++;
	}

	/* get the number of cycles it took to do the test */

	timestamp_end = timing_counter_get();

	/* Ensure both helper and this routine were context switching back &
	 * forth.
	 * For execution to reach the line below, either this routine or helper
	 * routine reached NB_OF_YIELD. The other loop must be at most one
	 * iteration away from reaching NB_OF_YIELD if execute was switching
	 * back and forth.
	 */
	delta = iterations - helper_thread_iterations;
	if (bench_test_end() < 0) {
		error_count++;
		PRINT_OVERFLOW_ERROR();
	} else if (abs(delta) > 1) {
		/* expecting even alternating context switch, seems one routine
		 * called yield without the other having chance to execute
		 */
		error_count++;
		PRINT_FORMAT(" Error, iteration:%u, helper iteration:%u",
			     iterations, helper_thread_iterations);
	} else {
		/* thread_yield is called (iterations + helper_thread_iterations)
		 * times in total.
		 */
		ts_diff = TIMING_INFO_GET_DELTA(timestamp_start, timestamp_end);
		PRINT_FORMAT(" Average thread context switch using "
			     "yield %u tcs = %u nsec",
			     ts_diff / (iterations + helper_thread_iterations),
			     (uint32_t)timing_cycles_to_ns_avg(ts_diff,
							   (iterations + helper_thread_iterations)));
	}

	timing_stop();
}
```

## src/timing_info.h
```c
/*
 * Copyright (c) 2017 Intel Corporation.
 *
 * SPDX-License-Identifier: Apache-2.0
 */

#ifndef _TIMING_INFO_H_
#define _TIMING_INFO_H_

#include <timestamp.h>

static inline uint32_t TIMING_INFO_GET_DELTA(uint32_t start, uint32_t end)
{
	return (end >= start) ? (end - start) : (ULONG_MAX - start + end);
}

#endif /* _TIMING_INFO_H_ */
```

## src/utils.h
```c
/*
 * Copyright (c) 2012-2014 Wind River Systems, Inc.
 *
 * SPDX-License-Identifier: Apache-2.0
 */

/*
 * @brief This file contains function declarations, macroses and inline functions
 * used in latency measurement.
 */

#include <timing/timing.h>
#include "timing_info.h"

#define INT_IMM8_OFFSET   1
#define IRQ_PRIORITY      3

#ifdef CONFIG_PRINTK
#include <sys/printk.h>
#include <stdio.h>
#include "timestamp.h"
extern char tmp_string[];
extern int error_count;

#define TMP_STRING_SIZE  100

#define PRINT(fmt, ...) printk(fmt, ##__VA_ARGS__)
#define PRINTF(fmt, ...) printf(fmt, ##__VA_ARGS__)

#define PRINT_FORMAT(fmt, ...)						\
	do {                                                            \
		snprintf(tmp_string, TMP_STRING_SIZE, fmt, ##__VA_ARGS__); \
		PRINTF("|%-77s|\n", tmp_string);				\
	} while (0)

/**
 *
 * @brief Print dash line
 *
 * @return N/A
 */
static inline void print_dash_line(void)
{
	PRINTF("|-------------------------------------------------------"
	       "----------------------|\n");
}

#define PRINT_END_BANNER()						\
	do {								\
	PRINTF("|                                    E N D             " \
	       "                       |\n");				\
	print_dash_line();						\
	} while (0)


#define PRINT_BANNER()						\
	do {								\
	print_dash_line();						\
	PRINTF("|                            Latency Benchmark         " \
	       "                       |\n");				\
	print_dash_line();						\
	} while (0)


#define PRINT_TIME_BANNER()						\
	do {								\
	PRINT_FORMAT("  tcs = timer clock cycles: 1 tcs is %u nsec",	\
		     (uint32_t)(uint32_t)timing_cycles_to_ns(1));					\
	print_dash_line();						\
	} while (0)

#define PRINT_OVERFLOW_ERROR()			\
	PRINT_FORMAT(" Error: tick occurred")

#else
#error PRINTK configuration option needs to be enabled
#endif

void raiseIntFunc(void);
extern void raiseInt(uint8_t id);

/* pointer to the ISR */
typedef void (*ptestIsr) (void *unused);
```
