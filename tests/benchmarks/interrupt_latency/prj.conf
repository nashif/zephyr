## CMakeLists.txt
```
# SPDX-FileCopyrightText: Copyright The Zephyr Project Contributors
# SPDX-License-Identifier: Apache-2.0

cmake_minimum_required(VERSION 3.28.0)
find_package(Zephyr REQUIRED HINTS $ENV{ZEPHYR_BASE})
project(interrupt_latency)

target_sources(app PRIVATE
  src/main.c
  src/stats.c
)

target_sources_ifdef(CONFIG_INT_BENCH_TRIGGER_SW_IRQ app PRIVATE src/trigger_sw_irq.c)
target_sources_ifdef(CONFIG_INT_BENCH_TRIGGER_OFFLOAD app PRIVATE src/trigger_offload.c)

target_sources_ifdef(CONFIG_INT_BENCH_SCENARIO_ENTRY app PRIVATE src/sc_entry.c)
target_sources_ifdef(CONFIG_INT_BENCH_SCENARIO_EXIT app PRIVATE src/sc_exit.c)
target_sources_ifdef(CONFIG_INT_BENCH_SCENARIO_LOCKED app PRIVATE src/sc_locked.c)
target_sources_ifdef(CONFIG_INT_BENCH_SCENARIO_DYNAMIC app PRIVATE src/sc_dynamic.c)
target_sources_ifdef(CONFIG_INT_BENCH_SCENARIO_THROUGHPUT app PRIVATE src/sc_throughput.c)
```

## Kconfig
```
# SPDX-FileCopyrightText: Copyright The Zephyr Project Contributors
# SPDX-License-Identifier: Apache-2.0

mainmenu "Interrupt Handling Benchmark"

menu "Interrupt benchmark options"

config INT_BENCH_NUM_ITERATIONS
	int "Number of iterations per scenario"
	default 1000
	help
	  Number of samples collected for each measured scenario. Larger
	  values give more stable statistics at the cost of runtime.

config INT_BENCH_WARMUP_ITERATIONS
	int "Number of warmup iterations per scenario"
	default 10
	help
	  Number of iterations run and discarded before sampling starts.
	  The first interrupt of a scenario is served with cold caches,
	  branch predictors and TLBs, and is typically an order of
	  magnitude slower than the steady state; without warmup it
	  dominates the reported maximum and standard deviation. Set to 0
	  to include cold-start costs in the statistics.

choice INT_BENCH_TRIGGER
	prompt "Interrupt trigger backend"
	default INT_BENCH_TRIGGER_SW_IRQ if CPU_CORTEX_M || GIC || ARC || X86 || \
		(RISCV && !SMP)
	default INT_BENCH_TRIGGER_OFFLOAD

config INT_BENCH_TRIGGER_SW_IRQ
	bool "Software-triggered hardware interrupt"
	depends on CPU_CORTEX_M || GIC || ARC || X86 || (RISCV && !SMP)
	help
	  Raise a real asynchronous interrupt through the platform
	  interrupt controller (NVIC STIR/ISPR on Cortex-M, a GIC SGI on
	  Arm GIC platforms, IRQ_HINT on ARC, a local APIC self IPI on
	  x86, and a CLIC pending bit or a CLINT machine software
	  interrupt on RISC-V). This exercises the full
	  hardware interrupt entry path and is required for the entry
	  latency, critical section and throughput scenarios.

config INT_BENCH_TRIGGER_OFFLOAD
	bool "irq_offload() software trap"
	depends on IRQ_OFFLOAD
	help
	  Run the benchmark ISRs synchronously via irq_offload(). This
	  works on every architecture but does not go through the
	  interrupt controller: only the interrupt *exit* paths are
	  measured. Entry latency numbers are not available with this
	  backend.

endchoice

config INT_BENCH_IRQ_LINE
	int "IRQ line used by the benchmark (-1 = auto-select)"
	depends on INT_BENCH_TRIGGER_SW_IRQ
	default -1
	help
	  IRQ line the benchmark connects its ISR to and then triggers
	  from software. The default of -1 selects a platform-appropriate
	  line automatically: an SGI on GIC platforms, the machine
	  software interrupt on RISC-V platforms without a CLIC, a line
	  known to be free on selected QEMU boards and on x86, and the
	  last available line (CONFIG_NUM_IRQS - 1) otherwise. Override
	  this on SoCs where the automatic choice is not an implemented
	  or free line.

config INT_BENCH_IRQ_LINE_ALT
	int "Second IRQ line used by the benchmark (-1 = auto-select)"
	depends on INT_BENCH_TRIGGER_SW_IRQ
	default -1
	help
	  Scenarios that compare how an interrupt is connected need a
	  second line, because the connection method is fixed at build
	  time. Selected the same way as CONFIG_INT_BENCH_IRQ_LINE, one
	  line below it where that is derived from CONFIG_NUM_IRQS.

config INT_BENCH_IRQ_PRIO
	int "Priority of the benchmark IRQ"
	depends on INT_BENCH_TRIGGER_SW_IRQ
	default 1
	help
	  Interrupt priority for the benchmark IRQ line, using the same
	  convention as the priority argument of IRQ_CONNECT() on the
	  target architecture.

config INT_BENCH_LOCK_HOLD_US
	int "Critical section hold time (microseconds)"
	depends on INT_BENCH_SCENARIO_LOCKED
	default 10
	help
	  How long the critical section scenario keeps interrupts locked
	  with the benchmark interrupt pending before unlocking and
	  measuring the unlock-to-ISR-entry latency.

menuconfig INT_BENCH_LOAD
	bool "Run the scenarios under background system load"
	help
	  Interrupt latency measured on an otherwise idle system is a
	  best case: caches hold the benchmark's own working set, no
	  other interrupt is in service and nothing else competes for the
	  memory system. Enable background load so that the reported
	  maximum and standard deviation describe something closer to
	  what an application will see. The individual load sources are
	  selected below.

if INT_BENCH_LOAD

config INT_BENCH_LOAD_CACHE
	bool "Evict caches between samples"
	default y
	help
	  Walk a working set larger than the benchmark's own between
	  samples, outside the measured span, so that each measured
	  interrupt is served with cold caches and TLBs. Runs in the
	  benchmark thread and therefore affects every scenario on every
	  platform.

config INT_BENCH_LOAD_CACHE_KB
	int "Working set size (KB)"
	depends on INT_BENCH_LOAD_CACHE
	default 8
	help
	  Size of the buffer walked between samples. To be effective this
	  should exceed the size of the last level cache; to be usable it
	  has to fit in RAM alongside the benchmark.

config INT_BENCH_LOAD_TIMER
	bool "Competing periodic timer interrupts"
	default y
	help
	  Run a periodic timer whose handler executes in the system clock
	  ISR, so that it competes with the benchmark interrupt for the
	  interrupt controller and for the interrupt-disabled windows of
	  the kernel timeout code. Affects every platform.

config INT_BENCH_LOAD_TIMER_PERIOD_US
	int "Timer load period (microseconds)"
	depends on INT_BENCH_LOAD_TIMER
	default 1000
	help
	  Period of the competing timer. Values below the tick period of
	  the system clock are rounded up, so raise
	  CONFIG_SYS_CLOCK_TICKS_PER_SEC accordingly.

config INT_BENCH_LOAD_THREADS
	bool "Background CPU and memory load threads"
	default y
	help
	  Run threads of lower priority than the benchmark that
	  continuously write to memory. On SMP these run on the other
	  CPUs and contend for the memory system throughout. On a
	  uniprocessor they only run while the benchmark blocks, so their
	  effect is limited to the rescheduling scenario.

config INT_BENCH_LOAD_NUM_THREADS
	int "Number of background load threads"
	depends on INT_BENCH_LOAD_THREADS
	default 2
	help
	  On SMP this should be at least the number of CPUs other than
	  the one running the benchmark.

endif # INT_BENCH_LOAD

comment "Scenarios"

config INT_BENCH_SCENARIO_ENTRY
	bool "Interrupt entry latency"
	depends on INT_BENCH_TRIGGER_SW_IRQ
	default y
	help
	  Measure the time from the software trigger of a hardware
	  interrupt to the first instruction of its ISR.

config INT_BENCH_SCENARIO_EXIT
	bool "Interrupt exit latency"
	default y
	help
	  Measure the time from the end of the ISR body back to the
	  interrupted thread, and the time from the end of an ISR that
	  wakes a higher priority thread to that thread running.

config INT_BENCH_SCENARIO_END_TO_END
	bool "Interrupt to awakened thread latency"
	depends on INT_BENCH_TRIGGER_SW_IRQ
	default y
	help
	  Measure the whole path an application waits on, from raising
	  the interrupt to the high priority thread it wakes running.

	  The entry and exit scenarios measure the pieces of this span,
	  but they cannot be added together: they are measured in
	  separate runs and neither covers the ISR body or the handoff
	  between them.

config INT_BENCH_SCENARIO_LOCKED
	bool "Entry latency after a critical section"
	depends on INT_BENCH_TRIGGER_SW_IRQ
	default y
	help
	  Trigger the benchmark interrupt while interrupts are locked,
	  hold the lock for a configurable window, then measure the time
	  from irq_unlock() to ISR entry. This approximates the latency
	  an interrupt experiences when it arrives during a kernel or
	  application critical section.

config INT_BENCH_SCENARIO_DYNAMIC
	bool "Dynamic interrupt connect cost"
	depends on INT_BENCH_TRIGGER_SW_IRQ
	depends on DYNAMIC_INTERRUPTS
	depends on !SHARED_INTERRUPTS
	# On x86, arch_irq_connect_dynamic() is a one shot allocation
	# rather than a rebindable install: it allocates a new IDT vector
	# and consumes an entry from a fixed pool of interrupt stubs on
	# every call, and asserts that the line is not already
	# configured. Repeatedly connecting the same line to gather
	# samples exhausts that pool.
	depends on !X86
	default y
	help
	  Measure the cost of installing an ISR at runtime with
	  irq_connect_dynamic(), by repeatedly reinstalling the handler
	  on the benchmark IRQ line. This requires the architecture to
	  support rebinding a line that is already connected.

config INT_BENCH_SCENARIO_MASKING
	bool "Delay inflicted on a periodic interrupt"
	# A sample is taken on every tick, so the tick has to be frequent
	# enough to sample the windows of interest. The base configuration
	# deliberately runs at one tick per second; the load overlay
	# raises it.
	depends on SYS_CLOCK_TICKS_PER_SEC >= 100
	default y
	help
	  Run a periodic timer at the tick rate while exercising kernel
	  primitives, and measure how much later than its period each
	  timer interrupt is actually served. This is the delay an
	  application sees when the kernel or a driver masks interrupts.

	  This is a sampling technique and cannot attribute the delay: a
	  masked window that does not overlap a tick is never seen, and
	  the measured delay also contains time spent in interrupts
	  served earlier. The maximum is a sampled lower bound on the
	  longest interrupt-disabled window, not proof of one.

config INT_BENCH_MASK_INJECT_US
	int "Inject a known interrupt-disabled window (microseconds)"
	depends on INT_BENCH_SCENARIO_MASKING
	default 0
	help
	  Mask interrupts for this long inside the scenario's work loop,
	  to check on a new platform that the measurement responds to a
	  known window. Keep the value well below the tick period: a
	  window comparable to it masks nearly continuously, and the
	  timer then re-anchors to when it was last serviced, so the
	  measured delay falls short of the injected one. Zero measures
	  only the windows the kernel creates by itself.

config INT_BENCH_SCENARIO_DIRECT
	bool "Direct ISR entry latency"
	depends on INT_BENCH_TRIGGER_SW_IRQ
	# Needs both a second triggerable line and IRQ_DIRECT_CONNECT().
	# There is no capability symbol for the latter, so the
	# architectures that implement ARCH_ISR_DIRECT_DECLARE() are
	# listed explicitly: Arm64 has no direct interrupts, x86 has them
	# only on IA32, and RISC-V without a CLIC has only the one
	# interrupt a hart can raise on itself.
	depends on CPU_CORTEX_M || ARC || (X86 && !X86_64)
	depends on !INT_BENCH_SCENARIO_ZLI
	default y
	help
	  Measure entry latency for an interrupt connected with
	  IRQ_DIRECT_CONNECT(), which is dispatched straight from the
	  vector table instead of through the software ISR table. Run
	  alongside the regular entry latency scenario, the pair shows
	  what the common interrupt entry code costs.

config INT_BENCH_SCENARIO_ZLI
	bool "Zero-latency interrupt entry while interrupts are locked"
	depends on INT_BENCH_TRIGGER_SW_IRQ
	depends on ZERO_LATENCY_IRQS
	default n
	help
	  Connect the second line as a zero-latency interrupt and trigger
	  it with interrupts locked. A zero-latency interrupt is not
	  masked by irq_lock(), so it is served during the critical
	  section rather than after it, which the regular critical
	  section scenario can be compared against.

	  This claims the same line as the direct ISR scenario, so only
	  one of the two can be built at a time.

config INT_BENCH_SCENARIO_THROUGHPUT
	bool "Sustained interrupt round-trip cost"
	depends on INT_BENCH_TRIGGER_SW_IRQ
	default y
	help
	  Re-trigger the benchmark interrupt from within its own ISR so
	  interrupts are serviced back to back, and report the average
	  cost of one full entry + ISR + exit round trip. The inverse of
	  this number is the maximum sustainable interrupt rate.

endmenu

config SYS_CLOCK_TICKS_PER_SEC
	int "Number of ticks per second"
	default 20 if SOC_FAMILY_STM32
	default 1

source "Kconfig.zephyr"
```

## prj.conf
```kconfig
# SPDX-FileCopyrightText: Copyright The Zephyr Project Contributors
# SPDX-License-Identifier: Apache-2.0

CONFIG_TEST=y

# Eliminate timer interrupts during the benchmark
CONFIG_SYS_CLOCK_TICKS_PER_SEC=1

# Fallback trigger backend for architectures without a sw-irq trigger
CONFIG_IRQ_OFFLOAD=y

# Cycle-accurate timestamping
CONFIG_TIMING_FUNCTIONS=y

# Reduce measurement noise
CONFIG_FORCE_NO_ASSERT=y
CONFIG_TEST_HW_STACK_PROTECTION=n
CONFIG_HW_STACK_PROTECTION=n
CONFIG_COVERAGE=n
CONFIG_PM=n
CONFIG_TIMESLICING=n
CONFIG_BT=n
```

## prj.load.conf
```kconfig
# SPDX-FileCopyrightText: Copyright The Zephyr Project Contributors
# SPDX-License-Identifier: Apache-2.0
#
# Run the benchmark scenarios under background system load. Use with
# EXTRA_CONF_FILE="prj.load.conf".

CONFIG_INT_BENCH_LOAD=y

# The base configuration reduces the tick rate to one tick per second
# to keep timer interrupts out of the measurements. Under load the
# competing timer is part of the point, so give the system clock a
# resolution the load period can actually use. Kept moderate so that
# the benchmark stays practical on slow emulated targets.
CONFIG_SYS_CLOCK_TICKS_PER_SEC=1000
```

## src/main.c
```c
/*
 * SPDX-FileCopyrightText: Copyright The Zephyr Project Contributors
 * SPDX-License-Identifier: Apache-2.0
 */

/*
 * Interrupt handling benchmark.
 *
 * Measures the individual components of interrupt handling (entry
 * latency, exit latency with and without rescheduling, latency after a
 * critical section, dynamic connection cost and sustained round-trip
 * cost) using a portable trigger backend abstraction; see README.rst.
 */

#include <zephyr/kernel.h>
#include <zephyr/sys/printk.h>
#include <zephyr/tc_util.h>
#include <zephyr/timing/timing.h>

#include "bench.h"
#include "trigger.h"

int bench_error_count;

int main(void)
{
	timing_init();
	timing_start();

	bench_calibrate();

#ifdef CONFIG_INT_BENCH_TRIGGER_SW_IRQ
	printk("Interrupt benchmark: trigger=sw-irq (line %u), %u iterations\n",
	       bench_trigger_irq_line(), CONFIG_INT_BENCH_NUM_ITERATIONS);
#else
	printk("Interrupt benchmark: trigger=irq_offload (exit paths only), %u iterations\n",
	       CONFIG_INT_BENCH_NUM_ITERATIONS);
#endif

	if (bench_trigger_init() != 0) {
		printk("Failed to initialize trigger backend\n");
		bench_error_count++;
	}

#ifdef CONFIG_INT_BENCH_SCENARIO_ENTRY
	int_bench_entry();
#endif

#ifdef CONFIG_INT_BENCH_SCENARIO_EXIT
	int_bench_exit();
#endif

#ifdef CONFIG_INT_BENCH_SCENARIO_LOCKED
	int_bench_locked();
#endif

#ifdef CONFIG_INT_BENCH_SCENARIO_THROUGHPUT
	int_bench_throughput();
#endif

#ifdef CONFIG_INT_BENCH_SCENARIO_DYNAMIC
	int_bench_dynamic();
#endif

	timing_stop();

	TC_END_REPORT((bench_error_count == 0) ? TC_PASS : TC_FAIL);

	return 0;
}
```

## src/bench.h
```c
/*
 * SPDX-FileCopyrightText: Copyright The Zephyr Project Contributors
 * SPDX-License-Identifier: Apache-2.0
 */

#ifndef ZEPHYR_TESTS_BENCHMARKS_INTERRUPT_LATENCY_SRC_BENCH_H_
#define ZEPHYR_TESTS_BENCHMARKS_INTERRUPT_LATENCY_SRC_BENCH_H_

#include <zephyr/kernel.h>
#include <zephyr/timing/timing.h>

/*
 * Sample recording and reporting.
 *
 * Each scenario resets the sample buffer, records one cycle count per
 * iteration and finally reports min/avg/max/p99 statistics as one line
 * per statistic in the same "metric - description : cycles , ns" format
 * used by the latency_measure benchmark, so that twister can harvest
 * the values with a "record:" regex.
 */
void bench_samples_reset(void);
void bench_sample_add(uint64_t cycles);
void bench_report(const char *metric, const char *description);
void bench_report_avg(const char *metric, const char *description,
		      uint64_t total_cycles, uint32_t count);

/*
 * Measure the average overhead of one timing_counter_get() call so
 * that scenarios can subtract it from measured deltas.
 */
void bench_calibrate(void);
uint64_t bench_adjust(uint64_t cycles);

/* Scenario entry points */
void int_bench_entry(void);
void int_bench_exit(void);
void int_bench_locked(void);
void int_bench_dynamic(void);
void int_bench_throughput(void);

extern int bench_error_count;

#endif /* ZEPHYR_TESTS_BENCHMARKS_INTERRUPT_LATENCY_SRC_BENCH_H_ */
```

## src/sc_dynamic.c
```c
/*
 * SPDX-FileCopyrightText: Copyright The Zephyr Project Contributors
 * SPDX-License-Identifier: Apache-2.0
 */

/*
 * Cost of installing an interrupt handler at runtime with
 * irq_connect_dynamic(). The benchmark line is disabled while the
 * handler is (re)installed because z_isr_install() requires the line
 * to be disabled on most architectures.
 */

#include <zephyr/kernel.h>
#include <zephyr/irq.h>

#include "bench.h"
#include "trigger.h"

void int_bench_dynamic(void)
{
	timing_t start;
	timing_t finish;
	unsigned int line = bench_trigger_irq_line();

	bench_samples_reset();

	irq_disable(line);

	for (uint32_t i = 0U; i < CONFIG_INT_BENCH_NUM_ITERATIONS; i++) {
		start = timing_counter_get();
		(void)irq_connect_dynamic(line, CONFIG_INT_BENCH_IRQ_PRIO,
					  bench_trigger_isr, NULL, 0);
		finish = timing_counter_get();

		bench_sample_add(bench_adjust(timing_cycles_get(&start, &finish)));
	}

	irq_enable(line);

	bench_report("int.dynamic.connect", "irq_connect_dynamic install cost");
}
```

## src/sc_entry.c
```c
/*
 * SPDX-FileCopyrightText: Copyright The Zephyr Project Contributors
 * SPDX-License-Identifier: Apache-2.0
 */

/*
 * Interrupt entry latency: time from the software write that raises
 * the interrupt to the first timestamp taken inside the ISR. Requires
 * the sw-irq trigger backend (a real asynchronous interrupt).
 */

#include <zephyr/kernel.h>

#include "bench.h"
#include "trigger.h"

static volatile bool fired;
static volatile timing_t isr_timestamp;

static void entry_handler(void)
{
	isr_timestamp = timing_counter_get();
	fired = true;
}

void int_bench_entry(void)
{
	timing_t start;
	timing_t finish;

	bench_samples_reset();
	bench_trigger_set_handler(entry_handler);

	for (uint32_t i = 0U; i < CONFIG_INT_BENCH_NUM_ITERATIONS; i++) {
		fired = false;

		start = timing_counter_get();
		bench_trigger();

		while (!fired) {
		}

		finish = isr_timestamp;
		bench_sample_add(bench_adjust(timing_cycles_get(&start, &finish)));
	}

	bench_trigger_set_handler(NULL);

	bench_report("int.entry.trigger_to_isr", "Trigger write to ISR entry");
}
```

## src/sc_exit.c
```c
/*
 * SPDX-FileCopyrightText: Copyright The Zephyr Project Contributors
 * SPDX-License-Identifier: Apache-2.0
 */

/*
 * Interrupt exit latency, two flavors:
 *
 * 1. ISR returns to the thread it interrupted: time from the last
 *    instruction of the ISR body to the interrupted thread resuming.
 * 2. ISR wakes a higher priority thread: time from the last
 *    instruction of the ISR body to the woken thread running (i.e.
 *    interrupt exit plus context switch).
 *
 * Both work with either trigger backend; with irq_offload() they
 * measure the offload trap exit path, as latency_measure does.
 */

#include <zephyr/kernel.h>

#include "bench.h"
#include "trigger.h"

#define WAITER_STACK_SIZE (1024 + CONFIG_TEST_EXTRA_STACK_SIZE)

static K_SEM_DEFINE(wake_sem, 0, 1);
static K_SEM_DEFINE(sync_sem, 0, 1);
static K_THREAD_STACK_DEFINE(waiter_stack, WAITER_STACK_SIZE);
static struct k_thread waiter_thread;

static volatile bool fired;
static volatile timing_t isr_exit_timestamp;

static void resume_handler(void)
{
	fired = true;
	isr_exit_timestamp = timing_counter_get();
}

static void measure_resume_interrupted(void)
{
	timing_t start;
	timing_t finish;

	bench_samples_reset();
	bench_trigger_set_handler(resume_handler);

	for (uint32_t i = 0U; i < CONFIG_INT_BENCH_NUM_ITERATIONS; i++) {
		fired = false;

		bench_trigger();

		while (!fired) {
		}

		finish = timing_counter_get();
		start = isr_exit_timestamp;
		bench_sample_add(bench_adjust(timing_cycles_get(&start, &finish)));
	}

	bench_trigger_set_handler(NULL);

	bench_report("int.exit.resume_interrupted", "ISR exit to interrupted thread");
}

static void resched_handler(void)
{
	k_sem_give(&wake_sem);
	isr_exit_timestamp = timing_counter_get();
}

static void waiter_entry(void *p1, void *p2, void *p3)
{
	uint32_t num_iterations = (uint32_t)(uintptr_t)p1;
	timing_t start;
	timing_t finish;

	ARG_UNUSED(p2);
	ARG_UNUSED(p3);

	for (uint32_t i = 0U; i < num_iterations; i++) {
		k_sem_take(&wake_sem, K_FOREVER);

		finish = timing_counter_get();
		start = isr_exit_timestamp;
		bench_sample_add(bench_adjust(timing_cycles_get(&start, &finish)));

		k_sem_give(&sync_sem);
	}
}

static void measure_resched(void)
{
	int priority = k_thread_priority_get(k_current_get());

	bench_samples_reset();
	bench_trigger_set_handler(resched_handler);

	k_thread_create(&waiter_thread, waiter_stack, K_THREAD_STACK_SIZEOF(waiter_stack),
			waiter_entry, (void *)(uintptr_t)CONFIG_INT_BENCH_NUM_ITERATIONS,
			NULL, NULL, priority - 1, 0, K_NO_WAIT);

	for (uint32_t i = 0U; i < CONFIG_INT_BENCH_NUM_ITERATIONS; i++) {
		bench_trigger();
		k_sem_take(&sync_sem, K_FOREVER);
	}

	k_thread_join(&waiter_thread, K_FOREVER);
	bench_trigger_set_handler(NULL);

	bench_report("int.exit.reschedule", "ISR exit to woken higher prio thread");
}

void int_bench_exit(void)
{
	measure_resume_interrupted();
	measure_resched();
}
```

## src/sc_locked.c
```c
/*
 * SPDX-FileCopyrightText: Copyright The Zephyr Project Contributors
 * SPDX-License-Identifier: Apache-2.0
 */

/*
 * Entry latency after a critical section: the benchmark interrupt is
 * raised while interrupts are locked, the lock is held for
 * CONFIG_INT_BENCH_LOCK_HOLD_US, then the time from irq_unlock() to
 * ISR entry is measured. This is the latency an interrupt experiences
 * when it arrives during a critical section, minus the remaining hold
 * time. Requires the sw-irq trigger backend.
 */

#include <zephyr/kernel.h>

#include "bench.h"
#include "trigger.h"

static volatile bool fired;
static volatile timing_t isr_timestamp;

static void locked_handler(void)
{
	isr_timestamp = timing_counter_get();
	fired = true;
}

void int_bench_locked(void)
{
	timing_t start;
	timing_t finish;
	unsigned int key;

	bench_samples_reset();
	bench_trigger_set_handler(locked_handler);

	for (uint32_t i = 0U; i < CONFIG_INT_BENCH_NUM_ITERATIONS; i++) {
		fired = false;

		key = irq_lock();

		bench_trigger();
		k_busy_wait(CONFIG_INT_BENCH_LOCK_HOLD_US);

		start = timing_counter_get();
		irq_unlock(key);

		while (!fired) {
		}

		finish = isr_timestamp;
		bench_sample_add(bench_adjust(timing_cycles_get(&start, &finish)));
	}

	bench_trigger_set_handler(NULL);

	bench_report("int.locked.unlock_to_isr", "irq_unlock of pended IRQ to ISR entry");
}
```

## src/sc_throughput.c
```c
/*
 * SPDX-FileCopyrightText: Copyright The Zephyr Project Contributors
 * SPDX-License-Identifier: Apache-2.0
 */

/*
 * Sustained interrupt round-trip cost: the ISR re-triggers the
 * benchmark interrupt from within its own handler so that interrupts
 * are serviced back to back (tail-chained where the hardware supports
 * it). The reported average is the cost of one full entry + ISR body +
 * exit round trip; its inverse is the maximum sustainable interrupt
 * rate. Requires the sw-irq trigger backend.
 */

#include <zephyr/kernel.h>

#include "bench.h"
#include "trigger.h"

static volatile bool done;
static volatile uint32_t isr_count;
static volatile timing_t end_timestamp;

static void throughput_handler(void)
{
	isr_count++;

	if (isr_count < CONFIG_INT_BENCH_NUM_ITERATIONS) {
		bench_trigger();
	} else {
		end_timestamp = timing_counter_get();
		done = true;
	}
}

void int_bench_throughput(void)
{
	timing_t start;
	timing_t finish;

	isr_count = 0U;
	done = false;

	bench_trigger_set_handler(throughput_handler);

	start = timing_counter_get();
	bench_trigger();

	while (!done) {
	}

	bench_trigger_set_handler(NULL);

	finish = end_timestamp;
	bench_report_avg("int.throughput.round_trip", "Back to back interrupt round trip",
			 timing_cycles_get(&start, &finish), CONFIG_INT_BENCH_NUM_ITERATIONS);
}
```

## src/stats.c
```c
/*
 * SPDX-FileCopyrightText: Copyright The Zephyr Project Contributors
 * SPDX-License-Identifier: Apache-2.0
 */

#include <zephyr/kernel.h>
#include <zephyr/sys/printk.h>

#include "bench.h"

static uint32_t samples[CONFIG_INT_BENCH_NUM_ITERATIONS];
static uint32_t sample_count;
static uint64_t timestamp_overhead;

void bench_calibrate(void)
{
	timing_t start;
	timing_t finish;
	uint64_t sum = 0ULL;
	const uint32_t loops = 1000U;

	for (uint32_t i = 0U; i < loops; i++) {
		start = timing_counter_get();
		finish = timing_counter_get();
		sum += timing_cycles_get(&start, &finish);
	}

	timestamp_overhead = sum / loops;
}

uint64_t bench_adjust(uint64_t cycles)
{
	return (cycles > timestamp_overhead) ? (cycles - timestamp_overhead) : 0ULL;
}

void bench_samples_reset(void)
{
	sample_count = 0U;
}

void bench_sample_add(uint64_t cycles)
{
	if (sample_count < ARRAY_SIZE(samples)) {
		samples[sample_count] = (cycles > UINT32_MAX) ? UINT32_MAX : (uint32_t)cycles;
		sample_count++;
	}
}

static void sort_samples(void)
{
	/* Shell sort; small fixed data set, no libc dependency */
	for (uint32_t gap = sample_count / 2U; gap > 0U; gap /= 2U) {
		for (uint32_t i = gap; i < sample_count; i++) {
			uint32_t val = samples[i];
			uint32_t j = i;

			while ((j >= gap) && (samples[j - gap] > val)) {
				samples[j] = samples[j - gap];
				j -= gap;
			}
			samples[j] = val;
		}
	}
}

static void print_line(const char *metric, const char *stat, const char *description,
		       uint64_t cycles, uint64_t nsec)
{
	char summary[96];

	snprintk(summary, sizeof(summary), "%s.%s - %s (%s)", metric, stat, description, stat);
	printk("%-94s:%8u cycles , %8u ns :\n", summary, (uint32_t)cycles, (uint32_t)nsec);
}

void bench_report(const char *metric, const char *description)
{
	uint64_t sum = 0ULL;
	uint32_t min;
	uint32_t max;
	uint32_t p99;

	if (sample_count == 0U) {
		printk("%s - %s: no samples recorded\n", metric, description);
		bench_error_count++;
		return;
	}

	sort_samples();

	min = samples[0];
	max = samples[sample_count - 1U];
	p99 = samples[((sample_count * 99U) / 100U < sample_count) ?
		      ((sample_count * 99U) / 100U) : (sample_count - 1U)];

	for (uint32_t i = 0U; i < sample_count; i++) {
		sum += samples[i];
	}

	print_line(metric, "min", description, min, timing_cycles_to_ns(min));
	print_line(metric, "avg", description, sum / sample_count,
		   timing_cycles_to_ns_avg(sum, sample_count));
	print_line(metric, "max", description, max, timing_cycles_to_ns(max));
	print_line(metric, "p99", description, p99, timing_cycles_to_ns(p99));
}

void bench_report_avg(const char *metric, const char *description,
		      uint64_t total_cycles, uint32_t count)
{
	if (count == 0U) {
		bench_error_count++;
		return;
	}

	print_line(metric, "avg", description, total_cycles / count,
		   timing_cycles_to_ns_avg(total_cycles, count));
}
```

## src/trigger_sw_irq.c
```c
/*
 * SPDX-FileCopyrightText: Copyright The Zephyr Project Contributors
 * SPDX-License-Identifier: Apache-2.0
 */

/*
 * Trigger backend raising a real asynchronous interrupt through the
 * platform interrupt controller. The per-architecture trigger methods
 * are adapted from subsys/testsuite/include/zephyr/interrupt_util.h,
 * which is the mechanism proven by tests/arch/common/interrupt.
 */

#include <zephyr/kernel.h>
#include <zephyr/irq.h>

#include "trigger.h"

/*
 * Benchmark IRQ line selection. CONFIG_INT_BENCH_IRQ_LINE overrides;
 * otherwise pick a platform-appropriate default.
 */
#if CONFIG_INT_BENCH_IRQ_LINE >= 0
#define BENCH_IRQ_LINE CONFIG_INT_BENCH_IRQ_LINE
#elif defined(CONFIG_GIC)
/*
 * Use an SGI (software generated interrupt) line. SGI 0-2 are used by
 * Zephyr for SMP IPIs and SGI 8-15 may be inaccessible from the
 * Non-Secure state, so use SGI 6.
 */
#define BENCH_IRQ_LINE 6
#elif defined(CONFIG_BOARD_QEMU_CORTEX_M3)
/*
 * QEMU's NVIC model for this board does not implement all
 * CONFIG_NUM_IRQS lines; line 42 is implemented and unused (same line
 * used by tests/arch/common/interrupt).
 */
#define BENCH_IRQ_LINE 42
#elif defined(CONFIG_X86)
/*
 * x86 has no CONFIG_NUM_IRQS; IRQ lines are mapped to IDT vectors at
 * build time. Use the same line as tests/arch/common/interrupt, which
 * is known not to collide with the platform's own IRQ assignments.
 */
#define BENCH_IRQ_LINE 27
#elif defined(CONFIG_INTC_ESP32)
/*
 * Reported for the banner only. The interrupt matrix assigns the CPU
 * interrupt when the source is allocated, so there is no line to pick.
 */
#define BENCH_IRQ_LINE 0
#elif defined(CONFIG_RISCV) && !defined(CONFIG_CLIC) && !defined(CONFIG_NRFX_CLIC)
/*
 * Without a CLIC, the only interrupt a RISC-V hart can raise on itself
 * is the machine software interrupt, asserted through the CLINT.
 */
#define BENCH_IRQ_LINE RISCV_IRQ_MSOFT
#else
#define BENCH_IRQ_LINE (CONFIG_NUM_IRQS - 1)
#endif

/*
 * Deassert a level triggered benchmark interrupt. Called at the very
 * start of the ISR, before the measurement handler, so that the
 * throughput scenario can reassert the interrupt from within its own
 * handler.
 */
static inline void bench_trigger_ack(void);

static bench_trigger_handler_t trigger_handler;

BENCH_ISR_FUNC void bench_trigger_isr(const void *arg)
{
	ARG_UNUSED(arg);

	bench_trigger_ack();

	if (trigger_handler != NULL) {
		trigger_handler();
	}
}

void bench_trigger_set_handler(bench_trigger_handler_t handler)
{
	trigger_handler = handler;
}

unsigned int bench_trigger_irq_line(void)
{
	return BENCH_IRQ_LINE;
}

#if defined(CONFIG_CPU_CORTEX_M)
#include <cmsis_core.h>

void bench_trigger(void)
{
#if defined(CONFIG_SOC_TI_LM3S6965_QEMU) || defined(CONFIG_CPU_CORTEX_M0) ||                       \
	defined(CONFIG_CPU_CORTEX_M0PLUS) || defined(CONFIG_CPU_CORTEX_M1) ||                      \
	defined(CONFIG_ARMV6_M_ARMV8_M_BASELINE)
	/* QEMU does not simulate the STIR register: this is a workaround */
	NVIC_SetPendingIRQ(BENCH_IRQ_LINE);
#else
	NVIC->STIR = BENCH_IRQ_LINE;
#endif
}

#ifdef BENCH_HAS_ALT_LINE
void bench_trigger_alt(void)
{
#if defined(CONFIG_SOC_TI_LM3S6965_QEMU) || defined(CONFIG_CPU_CORTEX_M0) ||                       \
	defined(CONFIG_CPU_CORTEX_M0PLUS) || defined(CONFIG_CPU_CORTEX_M1) ||                      \
	defined(CONFIG_ARMV6_M_ARMV8_M_BASELINE)
	NVIC_SetPendingIRQ(BENCH_IRQ_LINE_ALT);
#else
	NVIC->STIR = BENCH_IRQ_LINE_ALT;
#endif
}
#endif

#elif defined(CONFIG_GIC)
#include <zephyr/drivers/interrupt_controller/gic.h>
#include <zephyr/dt-bindings/interrupt-controller/arm-gic.h>

void bench_trigger(void)
{
#if CONFIG_GIC_VER <= 2
	sys_write32(GICD_SGIR_TGTFILT_REQONLY | GICD_SGIR_SGIINTID(BENCH_IRQ_LINE), GICD_SGIR);
#else
	uint64_t mpidr = GET_MPIDR();
	uint8_t aff0 = MPIDR_AFFLVL(mpidr, 0);

	gic_raise_sgi(BENCH_IRQ_LINE, mpidr, BIT(aff0));
#endif
}

#ifdef BENCH_HAS_ALT_LINE
void bench_trigger_alt(void)
{
#if CONFIG_GIC_VER <= 2
	sys_write32(GICD_SGIR_TGTFILT_REQONLY | GICD_SGIR_SGIINTID(BENCH_IRQ_LINE_ALT), GICD_SGIR);
#else
	uint64_t mpidr = GET_MPIDR();
	uint8_t aff0 = MPIDR_AFFLVL(mpidr, 0);

	gic_raise_sgi(BENCH_IRQ_LINE_ALT, mpidr, BIT(aff0));
#endif
}
#endif

#elif defined(CONFIG_ARC)

void bench_trigger(void)
{
	z_arc_v2_aux_reg_write(_ARC_V2_AUX_IRQ_HINT, BENCH_IRQ_LINE);
}

#ifdef BENCH_HAS_ALT_LINE
void bench_trigger_alt(void)
{
	z_arc_v2_aux_reg_write(_ARC_V2_AUX_IRQ_HINT, BENCH_IRQ_LINE_ALT);
}
#endif

#elif defined(CONFIG_X86)
#ifdef CONFIG_X2APIC
#include <zephyr/drivers/interrupt_controller/loapic.h>
#define VECTOR_MASK 0xFFU
#else
#include <zephyr/arch/arch_interface.h>
/*
 * LOAPIC ICR value for a self directed IPI: fixed delivery mode,
 * physical destination mode, level assert, edge triggered, no
 * destination shorthand.
 */
#define LOAPIC_ICR_IPI_TEST 0x00004000U
#endif

/*
 * The interrupt is emulated by sending an IPI from the local APIC to
 * the core itself. Note that unlike trigger_irq() in
 * <zephyr/interrupt_util.h>, no delay loop is added after the write:
 * the delay would be counted as interrupt entry latency. Callers spin
 * on a flag set by the ISR instead.
 */
static uint8_t bench_vector;
#ifdef BENCH_HAS_ALT_LINE
static uint8_t bench_vector_alt;
#endif

static inline void bench_send_self_ipi(uint8_t vector)
{
#ifdef CONFIG_X2APIC
	x86_write_x2apic(LOAPIC_SELF_IPI, vector & VECTOR_MASK);
#else
#ifdef CONFIG_SMP
	int cpu_id = arch_curr_cpu()->id;
#else
	int cpu_id = 0;
#endif
	z_loapic_ipi(cpu_id, LOAPIC_ICR_IPI_TEST, vector);
#endif /* CONFIG_X2APIC */
}

void bench_trigger(void)
{
	bench_send_self_ipi(bench_vector);
}

#ifdef BENCH_HAS_ALT_LINE
void bench_trigger_alt(void)
{
	bench_send_self_ipi(bench_vector_alt);
}
#endif

#elif defined(CONFIG_INTC_ESP32)
/*
 * Espressif SoCs route every interrupt through an interrupt matrix
 * rather than exposing lines the CPU can pend directly, so neither the
 * RISC-V nor the Xtensa mechanism below applies. What they do have is a
 * set of peripheral sources whose only job is to be raised by software,
 * intended for cross-core signalling: writing the register asserts a
 * real interrupt that arrives through the matrix like any other.
 *
 * Sources 0 and 1 are the ones ESP-IDF and Zephyr's own SMP code use,
 * so take source 2.
 *
 * The register lives in a different peripheral depending on the part,
 * and the interrupt is level triggered, so the ISR has to clear it.
 */
#include <zephyr/drivers/interrupt_controller/intc_esp32.h>
#include <soc/soc.h>
#include <soc/interrupts.h>

/* The registers moved peripheral, and name, more than once */
#if defined(CONFIG_SOC_SERIES_ESP32C6) || defined(CONFIG_SOC_SERIES_ESP32H2) ||                    \
	defined(CONFIG_SOC_SERIES_ESP32C5)
#include <soc/intpri_reg.h>
#define BENCH_FROM_CPU_REG INTPRI_CPU_INTR_FROM_CPU_2_REG
#define BENCH_FROM_CPU_BIT INTPRI_CPU_INTR_FROM_CPU_2
#elif defined(CONFIG_SOC_SERIES_ESP32)
#include <soc/dport_reg.h>
#define BENCH_FROM_CPU_REG DPORT_CPU_INTR_FROM_CPU_2_REG
#define BENCH_FROM_CPU_BIT DPORT_CPU_INTR_FROM_CPU_2
#elif defined(CONFIG_SOC_SERIES_ESP32S2)
/* The register moved to the system peripheral but kept the old prefix */
#include <soc/system_reg.h>
#define BENCH_FROM_CPU_REG DPORT_CPU_INTR_FROM_CPU_2_REG
#define BENCH_FROM_CPU_BIT DPORT_CPU_INTR_FROM_CPU_2
#else
#include <soc/system_reg.h>
#define BENCH_FROM_CPU_REG SYSTEM_CPU_INTR_FROM_CPU_2_REG
#define BENCH_FROM_CPU_BIT SYSTEM_CPU_INTR_FROM_CPU_2
#endif

#define BENCH_TRIGGER_LEVEL_ACK 1
#define BENCH_TRIGGER_OWN_CONNECT 1

void bench_trigger(void)
{
	WRITE_PERI_REG(BENCH_FROM_CPU_REG, BENCH_FROM_CPU_BIT);
}

static inline void bench_trigger_ack(void)
{
	WRITE_PERI_REG(BENCH_FROM_CPU_REG, 0);
}

/* The allocator hands the ISR a non-const argument */
static void bench_trigger_esp_isr(void *arg)
{
	bench_trigger_isr(arg);
}

/*
 * The matrix allocates a CPU interrupt for the source, so the line is
 * not known until then and IRQ_CONNECT() cannot be used.
 */
static int bench_trigger_connect(void)
{
	return esp_intr_alloc(ETS_FROM_CPU_INTR2_SOURCE, 0, bench_trigger_esp_isr, NULL, NULL);
}

#elif defined(CONFIG_RISCV)
#if defined(CONFIG_CLIC) || defined(CONFIG_NRFX_CLIC)
void riscv_clic_irq_set_pending(uint32_t irq);

void bench_trigger(void)
{
	riscv_clic_irq_set_pending(BENCH_IRQ_LINE);
}

#else
#include <zephyr/arch/riscv/csr.h>

/*
 * Without a CLIC, a hart cannot make one of its own external
 * interrupts pending: PLIC pending bits are driven by the interrupt
 * gateways, and the machine software, timer and external pending bits
 * of the mip CSR are read only. The machine software interrupt is
 * therefore asserted the same way the SMP IPI code does it, by writing
 * this hart's MSIP register in the CLINT.
 *
 * MSIP is level triggered, so the ISR has to deassert it; see
 * bench_trigger_ack() below.
 */
#define CLINT_NODE DT_NODELABEL(clint)
#if !DT_NODE_EXISTS(CLINT_NODE)
#error "No CLIC and no 'clint' devicetree node: cannot trigger an interrupt"
#endif

#define MSIP_BASE       DT_REG_ADDR_RAW(CLINT_NODE)
#define MSIP(hartid)    ((volatile uint32_t *)MSIP_BASE)[hartid]

#define BENCH_TRIGGER_LEVEL_ACK 1

void bench_trigger(void)
{
	MSIP(csr_read(mhartid)) = 1U;
}

static inline void bench_trigger_ack(void)
{
	MSIP(csr_read(mhartid)) = 0U;
}
#endif /* CONFIG_CLIC || CONFIG_NRFX_CLIC */

#else
#error "No software interrupt trigger available for this architecture"
#endif

#ifndef BENCH_TRIGGER_LEVEL_ACK
static inline void bench_trigger_ack(void)
{
	/* Edge triggered: nothing to deassert */
}
#endif

int bench_trigger_init(void)
{
#ifdef BENCH_TRIGGER_OWN_CONNECT
	return bench_trigger_connect();
#else
	IRQ_CONNECT(BENCH_IRQ_LINE, CONFIG_INT_BENCH_IRQ_PRIO, bench_trigger_isr, NULL, 0);

#ifdef CONFIG_X86
	/*
	 * The local APIC is addressed by IDT vector rather than by IRQ
	 * line. Resolve the vector assigned to the benchmark line once,
	 * so that triggering costs no more than the APIC write itself.
	 */
	bench_vector = (uint8_t)Z_IRQ_TO_INTERRUPT_VECTOR(BENCH_IRQ_LINE);
#ifdef BENCH_HAS_ALT_LINE
	bench_vector_alt = (uint8_t)Z_IRQ_TO_INTERRUPT_VECTOR(BENCH_IRQ_LINE_ALT);
#endif
#endif

	irq_enable(BENCH_IRQ_LINE);

	return 0;
#endif /* BENCH_TRIGGER_OWN_CONNECT */
}
```
