## tests/crypto/ctr_prng/testcase.yaml
```yaml
common:
  cases:
    - ctr_prng_vector
    - reseed
    - uninstantiate
    - robustness
tests:
  crypto.ctr_prng:
    tags: crypto ctr prng
```

## tests/crypto/hmac/testcase.yaml
```yaml
common:
  cases:
    - hmac_1
    - hmac_2
    - hmac_3
    - hmac_4
    - hmac_5
    - hmac_6
    - hmac_7
tests:
  crypto.hmac:
    min_ram: 20
    tags: crypto sha256 hmac
```

## tests/crypto/hmac_prng/testcase.yaml
```yaml
common:
  cases:
    - hmac_prng
tests:
  crypto.hmac_prng:
    min_ram: 48
    tags: crypto sha256 hmac prng
```

## tests/crypto/sha256/testcase.yaml
```yaml
common:
  cases:
    - sha256_1
    - sha256_2
    - sha256_3
    - sha256_4
    - sha256_5
    - sha256_6
    - sha256_7
    - sha256_7
    - sha256_9
    - sha256_10
    - sha256_11
    - sha256_12
    - sha256_13_and_14
tests:
  crypto.sha256:
    min_ram: 48
    tags: crypto sha256
    timeout: 600
```

## tests/drivers/build_all/sensor/testcase.yaml
```yaml
common:
  tags:
    - drivers
    - sensors
  platform_allow:
    - native_sim
  integration_platforms:
    - native_sim
  build_only: true
tests:
  drivers.sensors.sensorhub.build:
    extra_args: EXTRA_CONF_FILE=sensors_shub.conf;sensors_die_temp.conf
  drivers.sensors.trigger.own.build:
    extra_args: EXTRA_CONF_FILE=sensors_trigger_own.conf;sensors_die_temp.conf
  drivers.sensors.trigger.global.build:
    extra_args: EXTRA_CONF_FILE=sensors_trigger_global.conf;sensors_die_temp.conf
  drivers.sensors.trigger.none.build:
    extra_args: EXTRA_CONF_FILE=sensors_trigger_none.conf;sensors_die_temp.conf
  drivers.sensors.no_default.build:
    extra_args: EXTRA_CONF_FILE=sensors_no_default.conf
  drivers.sensors.build:
    tags: sensors
    extra_args: EXTRA_CONF_FILE=sensors_die_temp.conf
    extra_configs:
      - CONFIG_UART_INTERRUPT_DRIVEN=y
  drivers.sensors.pm.build:
    extra_configs:
      - CONFIG_PM=y
      - CONFIG_PM_DEVICE=y
      - CONFIG_UART_INTERRUPT_DRIVEN=y
  drivers.sensors.generic_test:
    build_only: false
    extra_configs:
      - CONFIG_GENERIC_SENSOR_TEST=y
      - CONFIG_ZTEST=y
      - CONFIG_ZTEST_THREAD_PRIORITY=1
      - CONFIG_EMUL=y
      - CONFIG_SENSOR_ASYNC_API=y
```

## tests/drivers/counter/counter_nrf_rtc/fixed_top/testcase.yaml
```yaml
tests:
  drivers.counter:
    tags: drivers
    pre-filter: subsys_dt_compat_enabled("COUNTER")
    platform_whitelist: nrf52840dk_nrf52840
```

## tests/drivers/dma/cyclic/testcase.yaml
```yaml
tests:
  drivers.dma.cyclic:
    required_snippets:
      - testing
    depends_on: dma
    tags:
      - drivers
      - dma
    platform_allow:
      - xmc47_relax_kit
      - xmc45_relax_kit
    filter: dt_nodelabel_enabled("tst_dma0")
```

## tests/kernel/alert/alert_api/testcase.yaml
```yaml
common:
  cases:
    - thread_alert_timeout
    - thread_alert_wait
    - thread_alert_handler
    - thread_alert_default
    - thread_alert_ignore
    - thread_alert_consumed
    - thread_alert_pending
    - isr_alert_default
    - isr_alert_ignore
    - isr_alert_consumed
    - isr_alert_pending
    - thread_kinit_alert
    - isr_kinit_alert
tests:
  kernel.alert:
    tags: kernel userspace
```

## tests/kernel/arm_runtime_nmi/testcase.yaml
```yaml
common:
  cases:
    - arm_runtime_nmi
tests:
  arch.interrupt:
    arch_whitelist: arm
    tags: nmi interrupt
```

## tests/kernel/common/testcase.yaml
```yaml
common:
  cases:
    - byteorder_memcpy_swap
    - byteorder_mem_swap
    - atomic
    - bitfield
    - printk
    - slist
    - dlist
    - intmath
    - timeout_order
    - clock_uptime
    - clock_cycle
    - version
    - multilib
tests:
  kernel.common:
    tags: kernel
    min_ram: 16
```

## tests/kernel/completion/testcase.yaml
```yaml
tests:
  kernel.completion:
    ignore_faults: true
    tags:
      - kernel
      - userspace
```

## tests/kernel/context/testcase.yaml
```yaml
common:
  cases:
    - context
tests:
  kernel.common:
    tags: core bat_commit
```

## tests/kernel/critical/testcase.yaml
```yaml
common:
  cases:
    - critical
tests:
  kernel.common:
    tags: core bat_commit
```

## tests/kernel/device/testcase.yaml
```yaml
common:
  cases:
    - dummy_device_pm
    - dummy_device
    - bogus_dynamic_name
    - dynamic_name
  tags: device
  platform_whitelist: native_posix qemu_x86
tests:
  kernel.device:
    tags: device
  kernel.device.pm:
    tags: device
    extra_configs:
      - CONFIG_DEVICE_POWER_MANAGEMENT=y
      - CONFIG_SYS_POWER_MANAGEMENT=y
```

## tests/kernel/early_sleep/testcase.yaml
```yaml
common:
  cases:
    - verify_early_sleep
tests:
  kernel.common:
    tags: core
```

## tests/kernel/fifo/fifo_api/testcase.yaml
```yaml
common:
  cases:
    - fifo_thread2thread
    - fifo_thread2isr
    - fifo_isr2thread
    - fifo_get_fail
    - fifo_loop
    - fifo_cancel_wait
    - fifo_is_empty_thread
    - fifo_is_empty_isr
tests:
  kernel.fifo:
    tags: kernel
  kernel.fifo.poll:
    extra_args: CONF_FILE="prj_poll.conf"
    tags: kernel
```

## tests/kernel/fifo/fifo_timeout/testcase.yaml
```yaml
common:
  cases:
    - timeout_empty_fifo
    - timeout_non_empty_fifo
    - timeout_fifo_thread
    - timeout_threads_pend_on_fifo
    - timeout_threads_pend_on_dual_fifos
    - timeout_threads_pend_fail_on_fifo
tests:
  kernel.fifo.timeout:
    min_ram: 32
    tags: kernel
  kernel.fifo.timeout.poll:
    min_ram: 32
    extra_args: CONF_FILE="prj_poll.conf"
    tags: kernel
```

## tests/kernel/fifo/fifo_usage/testcase.yaml
```yaml
common:
  cases:
    - single_fifo_play
    - dual_fifo_play
    - isr_fifo_play
tests:
  kernel.fifo.usage:
    tags: kernel
  kernel.fifo.usage.poll:
    extra_args: CONF_FILE="prj_poll.conf"
    tags: kernel
```

## tests/kernel/gen_isr_table/testcase.yaml
```yaml
common:
  cases:
    - gen_isr_table
tests:
  arch.interrupt:
    filter: CONFIG_GEN_ISR_TABLES and CONFIG_ARMV7_M_ARMV8_M_MAINLINE
    tags: interrupt isr_table
```

## tests/kernel/init/testcase.yaml
```yaml
common:
  cases:
    - verify_bootdelay
tests:
  kernel.common.init:
    tags: init bootdelay
```

## tests/kernel/irq_offload/testcase.yaml
```yaml
common:
  cases:
    - irq_offload
tests:
  arch.interrupt:
    tags: interrupts
```

## tests/kernel/lifo/lifo_api/testcase.yaml
```yaml
common:
  cases:
    - lifo_thread2thread
    - lifo_thread2isr
    - lifo_isr2thread
    - lifo_get_fail
    - lifo_loop
tests:
  kernel.lifo:
    tags: kernel
```

## tests/kernel/lifo/lifo_usage/testcase.yaml
```yaml
common:
  cases:
    - lifo_nowait
    - lifo_wait
    - timeout_empty_lifo
    - timeout_non_empty_lifo
    - timeout_lifo_thread
    - timeout_threads_pend_on_lifo
tests:
  kernel.lifo.usage:
    min_ram: 32
    tags: kernel userspace
```

## tests/kernel/mbox/mbox_api/testcase.yaml
```yaml
common:
  cases:
    - mbox_kinit
    - mbox_kdefine
    - mbox_put_get_null
    - mbox_put_get_buffer
    - mbox_async_put_get_buffer
    - mbox_async_put_get_block
    - mbox_target_source_thread_buffer
    - mbox_target_source_thread_block
    - mbox_incorrect_receiver_tid
    - mbox_incorrect_transmit_tid
    - mbox_timed_out_mbox_get
    - mbox_block_get_invalid_pool
    - mbox_msg_tid_mismatch
    - mbox_block_get_buff_to_pool
    - mbox_dispose_size_0_msg
    - mbox_clean_up_tx_pool
    - mbox_async_put_to_waiting_get
    - mbox_async_multiple_put
    - mbox_multiple_waiting_get
tests:
  kernel.mailbox:
    tags: kernel
    min_ram: 16
```
