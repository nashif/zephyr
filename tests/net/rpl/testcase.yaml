## tests/net/rpl/testcase.yaml
```yaml
common:
  cases:
    - init
    - net_ctx_create
    - rpl_mcast_addr
    - dio_dummy_input
    - dis_sending
    - dao_sending_fail
    - populate_nbr_cache
    - dio_receive_dest
tests:
  net.rpl:
    min_ram: 16
    tags: net rpl
```

## tests/net/socket/getaddrinfo/testcase.yaml
```yaml
common:
  depends_on: netif
  cases:
    - getaddrinfo_ok
    - getaddrinfo_no_host
tests:
  net.socket:
    min_ram: 21
    tags: net
```

## tests/net/socket/tcp/testcase.yaml
```yaml
common:
  depends_on: netif
  cases:
    - v4_send_recv
    - v6_send_recv
    - v4_sendto_recvfrom
    - v6_sendto_recvfrom
    - v4_sendto_recvfrom_null_dest
    - v6_sendto_recvfrom_null_dest
tests:
  net.socket.tcp:
    min_ram: 32
    tags: net
```

## tests/net/socket/udp/testcase.yaml
```yaml
common:
  depends_on: netif
  cases:
    - send_recv_2_sock
    - v4_sendto_recvfrom
    - v6_sendto_recvfrom
    - v4_bind_sendto
    - v6_bind_sendto
tests:
  net.socket.udp:
    extra_configs:
      - CONFIG_NET_TEST=y
      - CONFIG_NET_LOOPBACK=y
    min_ram: 21
    tags: net
```

## tests/net/traffic_class/testcase.yaml
```yaml
common:
  cases:
    - traffic_class_general_setup
    - traffic_class_setup_tx
    - traffic_class_send_data_prio_bk
    - traffic_class_send_data_prio_be
    - traffic_class_send_data_prio_ee
    - traffic_class_send_data_prio_ca
    - traffic_class_send_data_prio_vi
    - traffic_class_send_data_prio_vo
    - traffic_class_send_data_prio_ic
    - traffic_class_send_data_prio_nc
    - traffic_class_send_data_mix
    - traffic_class_send_data_mix_all_1
    - traffic_class_send_data_mix_all_2
    - traffic_class_cleanup_tx
    - traffic_class_setup_rx
    - traffic_class_setup_recv
    - traffic_class_recv_data_prio_bk
    - traffic_class_recv_data_prio_be
    - traffic_class_recv_data_prio_ee
    - traffic_class_recv_data_prio_ca
    - traffic_class_recv_data_prio_vi
    - traffic_class_recv_data_prio_vo
    - traffic_class_recv_data_prio_ic
    - traffic_class_recv_data_prio_nc
    - traffic_class_recv_data_mix
    - traffic_class_recv_data_mix_all_1
    - traffic_class_recv_data_mix_all_2
    - traffic_class_cleanup_rx
common:
    platform_whitelist: native_posix
    tags: net traffic_class
tests:
  test_tc_1:
    extra_configs:
      - CONFIG_NET_TC_TX_COUNT=1
      - CONFIG_NET_TC_RX_COUNT=1
  test_tc_2:
    extra_configs:
      - CONFIG_NET_TC_TX_COUNT=2
      - CONFIG_NET_TC_RX_COUNT=2
  test_tc_3:
    extra_configs:
      - CONFIG_NET_TC_TX_COUNT=3
      - CONFIG_NET_TC_RX_COUNT=3
  test_tc_4:
    extra_configs:
      - CONFIG_NET_TC_TX_COUNT=4
      - CONFIG_NET_TC_RX_COUNT=4
  test_tc_5:
    extra_configs:
      - CONFIG_NET_TC_TX_COUNT=5
      - CONFIG_NET_TC_RX_COUNT=5
  test_tc_6:
    extra_configs:
      - CONFIG_NET_TC_TX_COUNT=6
      - CONFIG_NET_TC_RX_COUNT=6
  test_tc_7:
    extra_configs:
      - CONFIG_NET_TC_TX_COUNT=7
      - CONFIG_NET_TC_RX_COUNT=7
  test_tc_8:
    extra_configs:
      - CONFIG_NET_TC_TX_COUNT=8
      - CONFIG_NET_TC_RX_COUNT=8
# TX multi queue, RX one queue
  test_tc_2_no_rx:
    extra_configs:
      - CONFIG_NET_TC_TX_COUNT=2
      - CONFIG_NET_TC_RX_COUNT=1
  test_tc_3_no_rx:
    extra_configs:
      - CONFIG_NET_TC_TX_COUNT=3
      - CONFIG_NET_TC_RX_COUNT=1
  test_tc_4_no_rx:
    extra_configs:
      - CONFIG_NET_TC_TX_COUNT=4
      - CONFIG_NET_TC_RX_COUNT=1
  test_tc_5_no_rx:
    extra_configs:
      - CONFIG_NET_TC_TX_COUNT=5
      - CONFIG_NET_TC_RX_COUNT=1
  test_tc_6_no_rx:
    extra_configs:
      - CONFIG_NET_TC_TX_COUNT=6
      - CONFIG_NET_TC_RX_COUNT=1
  test_tc_7_no_rx:
    extra_configs:
      - CONFIG_NET_TC_TX_COUNT=7
      - CONFIG_NET_TC_RX_COUNT=1
  test_tc_8_no_rx:
    extra_configs:
      - CONFIG_NET_TC_TX_COUNT=8
      - CONFIG_NET_TC_RX_COUNT=1
# TX one queue, RX multi queue
  test_tc_2_no_tx:
    extra_configs:
      - CONFIG_NET_TC_RX_COUNT=2
      - CONFIG_NET_TC_TX_COUNT=1
  test_tc_3_no_tx:
    extra_configs:
      - CONFIG_NET_TC_RX_COUNT=3
      - CONFIG_NET_TC_TX_COUNT=1
  test_tc_4_no_tx:
    extra_configs:
      - CONFIG_NET_TC_RX_COUNT=4
      - CONFIG_NET_TC_TX_COUNT=1
  test_tc_5_no_tx:
    extra_configs:
      - CONFIG_NET_TC_RX_COUNT=5
      - CONFIG_NET_TC_TX_COUNT=1
  test_tc_6_no_tx:
    extra_configs:
      - CONFIG_NET_TC_RX_COUNT=6
      - CONFIG_NET_TC_TX_COUNT=1
  test_tc_7_no_tx:
    extra_configs:
      - CONFIG_NET_TC_RX_COUNT=7
      - CONFIG_NET_TC_TX_COUNT=1
  test_tc_8_no_tx:
    extra_configs:
      - CONFIG_NET_TC_RX_COUNT=8
      - CONFIG_NET_TC_TX_COUNT=1
# Then test some hybrid combinations.
  test_tc_tx_2_rx_3:
    extra_configs:
      - CONFIG_NET_TC_RX_COUNT=3
      - CONFIG_NET_TC_TX_COUNT=2
  test_tc_tx_3_rx_8:
    extra_configs:
      - CONFIG_NET_TC_RX_COUNT=8
      - CONFIG_NET_TC_TX_COUNT=3
  test_tc_rx_4_tx_8:
    extra_configs:
      - CONFIG_NET_TC_RX_COUNT=4
      - CONFIG_NET_TC_TX_COUNT=8
  test_tc_rx_5_tx_7:
    extra_configs:
      - CONFIG_NET_TC_RX_COUNT=5
      - CONFIG_NET_TC_TX_COUNT=7
  test_tc_tx_6_rx_2:
    extra_configs:
      - CONFIG_NET_TC_RX_COUNT=2
      - CONFIG_NET_TC_TX_COUNT=6
  test_tc_tx_7_rx_5:
    extra_configs:
      - CONFIG_NET_TC_RX_COUNT=5
      - CONFIG_NET_TC_TX_COUNT=7
  test_tc_tx_8_rx_7:
    extra_configs:
      - CONFIG_NET_TC_RX_COUNT=7
      - CONFIG_NET_TC_TX_COUNT=8
```

## tests/net/trickle/testcase.yaml
```yaml
common:
  cases:
    - init
    - trickle_create
    - trickle_start
    - trickle_1_status
    - trickle_2_status
    - trickle_1_wait
    - trickle_2_wait
    - trickle_1_update
    - trickle_1_status
    - trickle_2_inc
    - trickle_2_status
    - trickle_1_status
    - trickle_1_wait_long
    - trickle_stop
    - trickle_1_stopped
tests:
  net.trickle:
    min_ram: 12
    tags: net
```

## tests/net/udp/testcase.yaml
```yaml
common:
  depends_on: netif
  cases:
    - run_tests
tests:
  net.udp:
    min_ram: 20
    tags: net
```

## tests/net/utils/testcase.yaml
```yaml
common:
  depends_on: netif
  cases:
    - run_tests
    - net_addr
    - addr_parse
    - net_pkt_addr_parse
tests:
  net.util:
    min_ram: 24
    tags: net
```

## tests/net/vlan/testcase.yaml
```yaml
common:
  depends_on: netif
  cases:
    - vlan_setup
    - address_setup
    - vlan_tci
    - vlan_enable
    - vlan_disable
    - vlan_enable_all
    - vlan_disable_all
    - vlan_send_data
tests:
  net.vlan:
    min_ram: 32
    tags: net vlan
```

## tests/net/websocket/testcase.yaml
```yaml
common:
  cases:
    - websocket_init_server
    - init
    - v6_init
    - v6_connect
    - v6_send_recv_1
    - v6_send_recv_2
    - v6_send_recv_3
    - v6_send_recv_4
    - v6_send_recv_5
    - v6_send_recv_6
    - v6_send_recv_7
    - v6_send_multi_msg
    - v6_close
    - websocket_cleanup_server
    - websocket_init_server
    - v4_init
    - v4_connect
    - v4_send_recv_1
    - v4_send_recv_2
    - v4_send_recv_3
    - v4_send_recv_4
    - v4_send_recv_5
    - v4_send_recv_6
    - v4_send_recv_7
    - v4_send_multi_msg
    - v4_close
    - websocket_cleanup_server
tests:
  net.websocket:
      min_ram: 46
      tags: net http websocket
      depends_on: netif
```

## tests/posix/mqueue/testcase.yaml
```yaml
common:
  cases:
    - mqueue
tests:
  portability.posix:
    min_ram: 16
    tags: posix
```

## tests/posix/posix_checks/testcase.yaml
```yaml
common:
  cases:
    - sched_policy
    - clock_support
    - timer_support
tests:
  portability.posix:
    tags: posix
```

## tests/posix/pthread_cancel/testcase.yaml
```yaml
common:
  cases:
    - pthread_cancel
tests:
  portability.posix:
    min_ram: 16
    tags: posix
```

## tests/posix/pthread_equal/testcase.yaml
```yaml
common:
  cases:
    - pthread_equal
tests:
  portability.posix:
    tags: posix
```

## tests/subsys/process/testcase.yaml
```yaml
common:
  tags:
    - process
    - llext
    - userspace
  platform_exclude:
    - numaker_pfm_m487
    - qemu_cortex_m0
    - mps2/an383
    - qemu_xtensa/dc233c/mmu
  integration_platforms:
    - qemu_cortex_a9
    - qemu_cortex_r5
    - mps2/an385
    - mps2/an521/cpu0
  min_ram: 128
  min_flash: 256
  extra_configs:
    - arch:arm64:CONFIG_LLEXT_HEAP_SIZE=128

tests:
  subsys.process.lifecycle:
    harness: ztest

  subsys.process.no_userspace:
    harness: ztest
    extra_configs:
      - CONFIG_USERSPACE=n
    tags:
      - process
      - llext
```

## tests/subsys/tracing/tracing_buffer/testcase.yaml
```yaml
common:
  tags: tracing_testing
  platform_allow: qemu_x86
tests:
  tracing.buffer.overflow:
    tags: tracing_testing
```

## tests/subsys/tracing/tracing_config/testcase.yaml
```yaml
common:
  build_only: true
  platform_allow: qemu_x86
  tags: tracing_testing
tests:
  tracing.config.none:
    extra_configs:
      - CONFIG_TRACING_NONE=y
  tracing.config.test_format:
    extra_configs:
      - CONFIG_TRACING_TEST=y
  tracing.config.ctf:
    extra_configs:
      - CONFIG_TRACING_CTF=y
      - CONFIG_TRACING_CTF_TIMESTAMP=n
  tracing.config.ctf_timestamp:
    extra_configs:
      - CONFIG_TRACING_CTF=y
  tracing.config.object_tracking:
    extra_configs:
      - CONFIG_TRACING_TEST=y
      - CONFIG_TRACING_OBJECT_TRACKING=y
  tracing.config.gpio:
    extra_configs:
      - CONFIG_TRACING_TEST=y
      - CONFIG_TRACING_GPIO=y
  tracing.config.subsystems_disabled:
    extra_configs:
      - CONFIG_TRACING_TEST=y
      - CONFIG_TRACING_SYSCALL=n
      - CONFIG_TRACING_THREAD=n
      - CONFIG_TRACING_WORK=n
      - CONFIG_TRACING_ISR=n
      - CONFIG_TRACING_SEMAPHORE=n
      - CONFIG_TRACING_MUTEX=n
      - CONFIG_TRACING_CONDVAR=n
      - CONFIG_TRACING_QUEUE=n
      - CONFIG_TRACING_FIFO=n
      - CONFIG_TRACING_LIFO=n
      - CONFIG_TRACING_STACK=n
      - CONFIG_TRACING_MESSAGE_QUEUE=n
      - CONFIG_TRACING_MAILBOX=n
      - CONFIG_TRACING_PIPE=n
      - CONFIG_TRACING_HEAP=n
      - CONFIG_TRACING_MEMORY_SLAB=n
      - CONFIG_TRACING_TIMER=n
      - CONFIG_TRACING_EVENT=n
      - CONFIG_TRACING_POLLING=n
      - CONFIG_TRACING_PM=n
      - CONFIG_TRACING_IDLE=n
```

## tests/subsys/tracing/tracing_ram_backend/testcase.yaml
```yaml
common:
  tags: tracing_testing
  platform_allow: qemu_x86
tests:
  tracing.backend.ram:
    tags: tracing_testing
```
